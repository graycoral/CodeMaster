AUTOSAR XML (schema 00043)
package /vwg/applications/ICAS1
  adaptive application sw component type ICAS1_Consumer
    require port Psd2_RPort: required-interface=Psd2
