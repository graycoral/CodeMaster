[part 1 of 2: packages /vwg to /vwg/applications/Basis__ICAS3_Sys_IVI_01/deployment]
AUTOSAR XML (schema 00043)
package /vwg
  mode declaration group MachineStates: initial-mode=Startup
    mode Startup: value=0
package /vwg/applications/Basis__ICAS3_Sys_IVI_01
  mode declaration group ApplicationStates: initial-mode=Running
    mode Running: value=0
    mode Terminating: value=1
  machine ICAS3Machine: service-discover-configs=someip-service-discovery={multicast-sd-ip-address=mySDNetworkEndpoint, someip-service-discovery-port=30490}
    ethernet communication connector myCommunicationConnector: unicast-network-endpoint=myNetworkEndpoint
    machine-mode-machines:
      mode declaration group prototype ICAS3MachineMode: type=MachineStates
    processor icas3_processor
      4 x processor core:
        core{0..3}
package /vwg/applications/Basis__ICAS3_Sys_IVI_01/deployment
  someip service interface deployment Positioning_Someip: service-interface=Positioning, service-interface-id=24603, service-interface-version={major-version=2, minor-version=0}
    someip field deployment positions: field=positions
      get getter: method-id=16400, transport-protocol=UDP
      notifier notifier: event-id=49168, transport-protocol=UDP
    someip field deployment posMapInfo: field=posMapInfo
      get getter: method-id=16416, transport-protocol=UDP
      notifier notifier: event-id=49184, transport-protocol=UDP
    someip event group positions_EventGroup: event-group-id=49168, event=positions/notifier
    someip event group posMapInfo_EventGroup: event-group-id=49184, event=posMapInfo/notifier
  someip data prototype transformation props Positioning_TLV
    data-prototypes:
      {data-prototype=Positioning_RPort.positions, element-in-impl-datatype={root-data-prototype=positions, target-data-prototype=posType}, tlv-data-id=0}
      {data-prototype=Positioning_RPort.positions, element-in-impl-datatype={root-data-prototype=positions, target-data-prototype=messageCounter}, tlv-data-id=1}
      {data-prototype=Positioning_RPort.positions, element-in-impl-datatype={root-data-prototype=positions, target-data-prototype=latitude}, tlv-data-id=2}
      {data-prototype=Positioning_RPort.positions, element-in-impl-datatype={root-data-prototype=positions, target-data-prototype=longitude}, tlv-data-id=3}
      {data-prototype=Positioning_RPort.positions, element-in-impl-datatype={root-data-prototype=positions, target-data-prototype=altitudeMeanSeaLevel}, tlv-data-id=4}
      {data-prototype=Positioning_RPort.positions, element-in-impl-datatype={root-data-prototype=positions, target-data-prototype=altitudeWGS84}, tlv-data-id=5}
      {data-prototype=Positioning_RPort.positions, element-in-impl-datatype={root-data-prototype=positions, target-data-prototype=headingVelocityDirection}, tlv-data-id=6}
      {data-prototype=Positioning_RPort.positions, element-in-impl-datatype={root-data-prototype=positions, target-data-prototype=headingYawAngle}, tlv-data-id=7}
      {data-prototype=Positioning_RPort.positions, element-in-impl-datatype={root-data-prototype=positions, target-data-prototype=accuracyHeadingVelocityDirection}, tlv-data-id=8}
      {data-prototype=Positioning_RPort.positions, element-in-impl-datatype={root-data-prototype=positions, target-data-prototype=accuracyHeadingYawAngle}, tlv-data-id=9}
      {data-prototype=Positioning_RPort.positions, element-in-impl-datatype={root-data-prototype=positions, target-data-prototype=speed3D}, tlv-data-id=10}
      {data-prototype=Positioning_RPort.positions, element-in-impl-datatype={root-data-prototype=positions, target-data-prototype=speed2D}, tlv-data-id=11}
      {data-prototype=Positioning_RPort.positions, element-in-impl-datatype={root-data-prototype=positions, target-data-prototype=velocityNorthDirection}, tlv-data-id=12}
      {data-prototype=Positioning_RPort.positions, element-in-impl-datatype={root-data-prototype=positions, target-data-prototype=velocityEastDirection}, tlv-data-id=13}
      {data-prototype=Positioning_RPort.positions, element-in-impl-datatype={root-data-prototype=positions, target-data-prototype=velocityUpwardDirection}, tlv-data-id=14}
      {data-prototype=Positioning_RPort.positions, element-in-impl-datatype={root-data-prototype=positions, target-data-prototype=accuracySpeed3D}, tlv-data-id=15}
      {data-prototype=Positioning_RPort.positions, element-in-impl-datatype={root-data-prototype=positions, target-data-prototype=accuracySpeed2D}, tlv-data-id=16}
      {data-prototype=Positioning_RPort.positions, element-in-impl-datatype={root-data-prototype=positions, target-data-prototype=accuracyHorizontal}, tlv-data-id=17}
      {data-prototype=Positioning_RPort.positions, element-in-impl-datatype={root-data-prototype=positions, target-data-prototype=accuracyEllipseSemiMajorAxis}, tlv-data-id=18}
      {data-prototype=Positioning_RPort.positions, element-in-impl-datatype={root-data-prototype=positions, target-data-prototype=accuracyEllipseSemiMajorAxisHeading}, tlv-data-id=19}
      {data-prototype=Positioning_RPort.positions, element-in-impl-datatype={root-data-prototype=positions, target-data-prototype=accuracyEllipseSemiMinorAxis}, tlv-data-id=20}
      {data-prototype=Positioning_RPort.positions, element-in-impl-datatype={root-data-prototype=positions, target-data-prototype=accuracyVertical}, tlv-data-id=21}
      {data-prototype=Positioning_RPort.positions, element-in-impl-datatype={root-data-prototype=positions, target-data-prototype=accuracyPitchAngle}, tlv-data-id=22}
      {data-prototype=Positioning_RPort.positions, element-in-impl-datatype={root-data-prototype=positions, target-data-prototype=accuracyRollAngle}, tlv-data-id=23}
      {data-prototype=Positioning_RPort.positions, element-in-impl-datatype={root-data-prototype=positions, target-data-prototype=pitchAngle}, tlv-data-id=24}
      {data-prototype=Positioning_RPort.positions, element-in-impl-datatype={root-data-prototype=positions, target-data-prototype=rollAngle}, tlv-data-id=25}
      {data-prototype=Positioning_RPort.positions, element-in-impl-datatype={root-data-prototype=positions, target-data-prototype=drivingDirection}, tlv-data-id=26}
      {data-prototype=Positioning_RPort.positions, element-in-impl-datatype={root-data-prototype=positions, target-data-prototype=statusFrontCamera}, tlv-data-id=27}
      {data-prototype=Positioning_RPort.positions, element-in-impl-datatype={root-data-prototype=positions, target-data-prototype=statusGNSS}, tlv-data-id=28}
      {data-prototype=Positioning_RPort.positions, element-in-impl-datatype={root-data-prototype=positions, target-data-prototype=statusLandmarks}, tlv-data-id=29}
      {data-prototype=Positioning_RPort.positions, element-in-impl-datatype={root-data-prototype=positions, target-data-prototype=statusTopView}, tlv-data-id=30}
      {data-prototype=Positioning_RPort.positions, element-in-impl-datatype={root-data-prototype=positions, target-data-prototype=statusLidar}, tlv-data-id=31}
      {data-prototype=Positioning_RPort.positions, element-in-impl-datatype={root-data-prototype=positions, target-data-prototype=statusSystem}, tlv-data-id=32}
      {data-prototype=Positioning_RPort.positions, element-in-impl-datatype={root-data-prototype=positions, target-data-prototype=latency}, tlv-data-id=33}
      {data-prototype=Positioning_RPort.positions, element-in-impl-datatype={root-data-prototype=positions, target-data-prototype=preciseLocalTimeSeconds}, tlv-data-id=34}
      {data-prototype=Positioning_RPort.positions, element-in-impl-datatype={root-data-prototype=positions, target-data-prototype=preciseLocalTimeNanoseconds}, tlv-data-id=35}
      {data-prototype=Positioning_RPort.posMapInfo, element-in-impl-datatype={root-data-prototype=posMapInfo, target-data-prototype=elementId}, tlv-data-id=0}
      {data-prototype=Positioning_RPort.posMapInfo, element-in-impl-datatype={root-data-prototype=posMapInfo, target-data-prototype=accuracyIsLaneAccurate}, tlv-data-id=1}
      {data-prototype=Positioning_RPort.posMapInfo, element-in-impl-datatype={root-data-prototype=posMapInfo, target-data-prototype=numberOfLanes}, tlv-data-id=2}
      {data-prototype=Positioning_RPort.posMapInfo, element-in-impl-datatype={root-data-prototype=posMapInfo, target-data-prototype=laneNumber}, tlv-data-id=3}
      {data-prototype=Positioning_RPort.posMapInfo, element-in-impl-datatype={root-data-prototype=posMapInfo, target-data-prototype=linkId}, tlv-data-id=4}
      {data-prototype=Positioning_RPort.posMapInfo, element-in-impl-datatype={root-data-prototype=posMapInfo, target-data-prototype=distanceOnLink}, tlv-data-id=5}
      {data-prototype=Positioning_RPort.posMapInfo, element-in-impl-datatype={root-data-prototype=posMapInfo, target-data-prototype=offsetOnLane}, tlv-data-id=6}
      {data-prototype=Positioning_RPort.posMapInfo, element-in-impl-datatype={root-data-prototype=posMapInfo, target-data-prototype=laneId}, tlv-data-id=7}
      {data-prototype=Positioning_RPort.posMapInfo, element-in-impl-datatype={root-data-prototype=posMapInfo, target-data-prototype=laneGroupId}, tlv-data-id=8}
      {data-prototype=Positioning_RPort.posMapInfo, element-in-impl-datatype={root-data-prototype=posMapInfo, target-data-prototype=tileId}, tlv-data-id=9}
      {data-prototype=Positioning_RPort.posMapInfo, element-in-impl-datatype={root-data-prototype=posMapInfo, target-data-prototype=updateRegionId}, tlv-data-id=10}
      {data-prototype=Positioning_RPort.posMapInfo, element-in-impl-datatype={root-data-prototype=posMapInfo, target-data-prototype=productId}, tlv-data-id=11}
      {data-prototype=Positioning_RPort.posMapInfo, element-in-impl-datatype={root-data-prototype=posMapInfo, target-data-prototype=distanceLeftMarking}, tlv-data-id=12}
      {data-prototype=Positioning_RPort.posMapInfo, element-in-impl-datatype={root-data-prototype=posMapInfo, target-data-prototype=distanceRightMarking}, tlv-data-id=13}
      {data-prototype=Positioning_RPort.posMapInfo, element-in-impl-datatype={root-data-prototype=posMapInfo, target-data-prototype=locationIsCarTrain}, tlv-data-id=14}
      {data-prototype=Positioning_RPort.posMapInfo, element-in-impl-datatype={root-data-prototype=posMapInfo, target-data-prototype=locationIsFerry}, tlv-data-id=15}
      {data-prototype=Positioning_RPort.posMapInfo, element-in-impl-datatype={root-data-prototype=posMapInfo, target-data-prototype=locationIsParkingStructure}, tlv-data-id=16}
      {data-prototype=Positioning_RPort.posMapInfo, element-in-impl-datatype={root-data-prototype=posMapInfo, target-data-prototype=locationIsParkingArea}, tlv-data-id=17}
      {data-prototype=Positioning_RPort.posMapInfo, element-in-impl-datatype={root-data-prototype=posMapInfo, target-data-prototype=offRoadStatus}, tlv-data-id=18}
      {data-prototype=Positioning_RPort.posMapInfo, element-in-impl-datatype={root-data-prototype=posMapInfo, target-data-prototype=gradient}, tlv-data-id=19}
      {data-prototype=Positioning_RPort.posMapInfo, element-in-impl-datatype={root-data-prototype=posMapInfo, target-data-prototype=slope}, tlv-data-id=20}
      {data-prototype=Positioning_RPort.posMapInfo, element-in-impl-datatype={root-data-prototype=posMapInfo, target-data-prototype=trafficDirection}, tlv-data-id=21}
      {data-prototype=Positioning_RPort.posMapInfo, element-in-impl-datatype={root-data-prototype=posMapInfo, target-data-prototype=laneType}, tlv-data-id=22}
      {data-prototype=Positioning_RPort.posMapInfo, element-in-impl-datatype={root-data-prototype=posMapInfo, target-data-prototype=isMotorwayRoad}, tlv-data-id=23}
      {data-prototype=Positioning_RPort.posMapInfo, element-in-impl-datatype={root-data-prototype=posMapInfo, target-data-prototype=isUrbanRoad}, tlv-data-id=24}
      {data-prototype=Positioning_RPort.posMapInfo, element-in-impl-datatype={root-data-prototype=posMapInfo, target-data-prototype=mapMatchingSource}, tlv-data-id=25}
      {data-prototype=Positioning_RPort.posMapInfo, element-in-impl-datatype={root-data-prototype=posMapInfo, target-data-prototype=preciseLocalTimeSeconds}, tlv-data-id=26}
      {data-prototype=Positioning_RPort.posMapInfo, element-in-impl-datatype={root-data-prototype=posMapInfo, target-data-prototype=preciseLocalTimeNanoseconds}, tlv-data-id=27}
  someip service interface deployment Psd2_Someip: service-interface=Psd2, service-interface-id=24866, service-interface-version={major-version=5, minor-version=1}
    8 x someip field deployment:
      linkLayerLongRange: field=linkLayerLongRange
        get getter: method-id=16400, transport-protocol=UDP
        notifier notifier: event-id=49168, transport-protocol=UDP
      linkLayerShortRange: field=linkLayerShortRange
        get getter: method-id=16416, transport-protocol=UDP
        notifier notifier: event-id=49184, transport-protocol=UDP
      laneLayer: field=laneLayer
        get getter: method-id=16432, transport-protocol=UDP
        notifier notifier: event-id=49200, transport-protocol=UDP
      positioningObjectsLayer: field=positioningObjectsLayer
        get getter: method-id=16448, transport-protocol=UDP
        notifier notifier: event-id=49216, transport-protocol=UDP
      egoPositionLayer: field=egoPositionLayer
        get getter: method-id=16464, transport-protocol=UDP
        notifier notifier: event-id=49232, transport-protocol=UDP
      dynamicContentLayer: field=dynamicContentLayer
        get getter: method-id=16480, transport-protocol=UDP
        notifier notifier: event-id=49248, transport-protocol=UDP
      automatedParkingLayer: field=automatedParkingLayer
        get getter: method-id=16496, transport-protocol=UDP
        notifier notifier: event-id=49264, transport-protocol=UDP
      timezoneInformation: field=timezoneInformation
        get getter: method-id=16512, transport-protocol=UDP
        notifier notifier: event-id=49280, transport-protocol=UDP
    8 x someip event group:
      linkLayerLongRange_EventGroup: event-group-id=49168, event=linkLayerLongRange/notifier
      linkLayerShortRange_EventGroup: event-group-id=49184, event=linkLayerShortRange/notifier
      laneLayer_EventGroup: event-group-id=49200, event=laneLayer/notifier
      positioningObjectsLayer_EventGroup: event-group-id=49216, event=positioningObjectsLayer/notifier
      egoPositionLayer_EventGroup: event-group-id=49232, event=egoPositionLayer/notifier
      dynamicContentLayer_EventGroup: event-group-id=49248, event=dynamicContentLayer/notifier
      automatedParkingLayer_EventGroup: event-group-id=49264, event=automatedParkingLayer/notifier
      timezoneInformation_EventGroup: event-group-id=49280, event=timezoneInformation/notifier
  someip data prototype transformation props Psd2_TLV
    data-prototypes:
      {data-prototype=Psd2_PPort.linkLayerLongRange, element-in-impl-datatype={root-data-prototype=linkLayerLongRange, target-data-prototype=id}, tlv-data-id=0}
      {data-prototype=Psd2_PPort.linkLayerLongRange, element-in-impl-datatype={root-data-prototype=linkLayerLongRange, target-data-prototype=linkLayerLongRange}, tlv-data-id=1}
      {data-prototype=Psd2_PPort.linkLayerLongRange, element-in-impl-datatype={root-data-prototype=linkLayerLongRange, target-data-prototype=layerInfo}, tlv-data-id=2}
      {data-prototype=Psd2_PPort.linkLayerLongRange, element-in-impl-datatype={root-data-prototype=linkLayerLongRange, target-data-prototype=metaDataIndex}, tlv-data-id=0}
      {data-prototype=Psd2_PPort.linkLayerLongRange, element-in-impl-datatype={root-data-prototype=linkLayerLongRange, target-data-prototype=fromLinkList}, tlv-data-id=1}
      {data-prototype=Psd2_PPort.linkLayerLongRange, element-in-impl-datatype={root-data-prototype=linkLayerLongRange, target-data-prototype=toLinkList}, tlv-data-id=2}
      {data-prototype=Psd2_PPort.linkLayerLongRange, element-in-impl-datatype={root-data-prototype=linkLayerLongRange, target-data-prototype=linkType}, tlv-data-id=3}
      {data-prototype=Psd2_PPort.linkLayerLongRange, element-in-impl-datatype={root-data-prototype=linkLayerLongRange, target-data-prototype=reference}, tlv-data-id=4}
      {data-prototype=Psd2_PPort.linkLayerLongRange, element-in-impl-datatype={root-data-prototype=linkLayerLongRange, target-data-prototype=controlledAccess}, tlv-data-id=5}
      {data-prototype=Psd2_PPort.linkLayerLongRange, element-in-impl-datatype={root-data-prototype=linkLayerLongRange, target-data-prototype=drivingDirection}, tlv-data-id=6}
      {data-prototype=Psd2_PPort.linkLayerLongRange, element-in-impl-datatype={root-data-prototype=linkLayerLongRange, target-data-prototype=functionalRoadClass}, tlv-data-id=7}
      {data-prototype=Psd2_PPort.linkLayerLongRange, element-in-impl-datatype={root-data-prototype=linkLayerLongRange, target-data-prototype=clothoidList}, tlv-data-id=8}
      {data-prototype=Psd2_PPort.linkLayerLongRange, element-in-impl-datatype={root-data-prototype=linkLayerLongRange, target-data-prototype=polyline}, tlv-data-id=9}
      {data-prototype=Psd2_PPort.linkLayerLongRange, element-in-impl-datatype={root-data-prototype=linkLayerLongRange, target-data-prototype=insideCityLimits}, tlv-data-id=10}
      {data-prototype=Psd2_PPort.linkLayerLongRange, element-in-impl-datatype={root-data-prototype=linkLayerLongRange, target-data-prototype=tollway}, tlv-data-id=11}
      {data-prototype=Psd2_PPort.linkLayerLongRange, element-in-impl-datatype={root-data-prototype=linkLayerLongRange, target-data-prototype=adas}, tlv-data-id=12}
      {data-prototype=Psd2_PPort.linkLayerLongRange, element-in-impl-datatype={root-data-prototype=linkLayerLongRange, target-data-prototype=urban}, tlv-data-id=13}
      {data-prototype=Psd2_PPort.linkLayerLongRange, element-in-impl-datatype={root-data-prototype=linkLayerLongRange, target-data-prototype=paved}, tlv-data-id=14}
      {data-prototype=Psd2_PPort.linkLayerLongRange, element-in-impl-datatype={root-data-prototype=linkLayerLongRange, target-data-prototype=attributeList}, tlv-data-id=15}
      {data-prototype=Psd2_PPort.linkLayerLongRange, element-in-impl-datatype={root-data-prototype=linkLayerLongRange, target-data-prototype=avgSpeed}, tlv-data-id=16}
      {data-prototype=Psd2_PPort.linkLayerLongRange, element-in-impl-datatype={root-data-prototype=linkLayerLongRange, target-data-prototype=rightOfWay}, tlv-data-id=17}
      {data-prototype=Psd2_PPort.linkLayerLongRange, element-in-impl-datatype={root-data-prototype=linkLayerLongRange, target-data-prototype=length}, tlv-data-id=18}
      {data-prototype=Psd2_PPort.linkLayerLongRange, element-in-impl-datatype={root-data-prototype=linkLayerLongRange, target-data-prototype=arrayMember}, tlv-data-id=0}
      {data-prototype=Psd2_PPort.linkLayerLongRange, element-in-impl-datatype={root-data-prototype=linkLayerLongRange, target-data-prototype=localId}, tlv-data-id=1}
      {data-prototype=Psd2_PPort.linkLayerLongRange, element-in-impl-datatype={root-data-prototype=linkLayerLongRange, target-data-prototype=referenceBaseIndex}, tlv-data-id=0}
      {data-prototype=Psd2_PPort.linkLayerLongRange, element-in-impl-datatype={root-data-prototype=linkLayerLongRange, target-data-prototype=inPositiveDirection}, tlv-data-id=2}
      {data-prototype=Psd2_PPort.linkLayerLongRange, element-in-impl-datatype={root-data-prototype=linkLayerLongRange, target-data-prototype=arrayMember}, tlv-data-id=0}
      {data-prototype=Psd2_PPort.linkLayerLongRange, element-in-impl-datatype={root-data-prototype=linkLayerLongRange, target-data-prototype=localId}, tlv-data-id=1}
      {data-prototype=Psd2_PPort.linkLayerLongRange, element-in-impl-datatype={root-data-prototype=linkLayerLongRange, target-data-prototype=referenceBaseIndex}, tlv-data-id=0}
      {data-prototype=Psd2_PPort.linkLayerLongRange, element-in-impl-datatype={root-data-prototype=linkLayerLongRange, target-data-prototype=inPositiveDirection}, tlv-data-id=2}
      {data-prototype=Psd2_PPort.linkLayerLongRange, element-in-impl-datatype={root-data-prototype=linkLayerLongRange, target-data-prototype=linkType}, tlv-data-id=0}
      {data-prototype=Psd2_PPort.linkLayerLongRange, element-in-impl-datatype={root-data-prototype=linkLayerLongRange, target-data-prototype=localId}, tlv-data-id=1}
      {data-prototype=Psd2_PPort.linkLayerLongRange, element-in-impl-datatype={root-data-prototype=linkLayerLongRange, target-data-prototype=referenceBaseIndex}, tlv-data-id=0}
      {data-prototype=Psd2_PPort.linkLayerLongRange, element-in-impl-datatype={root-data-prototype=linkLayerLongRange, target-data-prototype=inPositiveDirection}, tlv-data-id=2}
      {data-prototype=Psd2_PPort.linkLayerLongRange, element-in-impl-datatype={root-data-prototype=linkLayerLongRange, target-data-prototype=direction}, tlv-data-id=0}
      {data-prototype=Psd2_PPort.linkLayerLongRange, element-in-impl-datatype={root-data-prototype=linkLayerLongRange, target-data-prototype=functionalRoadClass}, tlv-data-id=0}
      {data-prototype=Psd2_PPort.linkLayerLongRange, element-in-impl-datatype={root-data-prototype=linkLayerLongRange, target-data-prototype=arrayMember}, tlv-data-id=0}
      {data-prototype=Psd2_PPort.linkLayerLongRange, element-in-impl-datatype={root-data-prototype=linkLayerLongRange, target-data-prototype=startCurvature}, tlv-data-id=0}
      {data-prototype=Psd2_PPort.linkLayerLongRange, element-in-impl-datatype={root-data-prototype=linkLayerLongRange, target-data-prototype=endCurvature}, tlv-data-id=1}
      {data-prototype=Psd2_PPort.linkLayerLongRange, element-in-impl-datatype={root-data-prototype=linkLayerLongRange, target-data-prototype=length}, tlv-data-id=2}
      {data-prototype=Psd2_PPort.linkLayerLongRange, element-in-impl-datatype={root-data-prototype=linkLayerLongRange, target-data-prototype=angle}, tlv-data-id=3}
      {data-prototype=Psd2_PPort.linkLayerLongRange, element-in-impl-datatype={root-data-prototype=linkLayerLongRange, target-data-prototype=ndsCoordinates}, tlv-data-id=4}
      {data-prototype=Psd2_PPort.linkLayerLongRange, element-in-impl-datatype={root-data-prototype=linkLayerLongRange, target-data-prototype=geometryQuality}, tlv-data-id=6}
      {data-prototype=Psd2_PPort.linkLayerLongRange, element-in-impl-datatype={root-data-prototype=linkLayerLongRange, target-data-prototype=longitude}, tlv-data-id=0}
      {data-prototype=Psd2_PPort.linkLayerLongRange, element-in-impl-datatype={root-data-prototype=linkLayerLongRange, target-data-prototype=latitude}, tlv-data-id=1}
      {data-prototype=Psd2_PPort.linkLayerLongRange, element-in-impl-datatype={root-data-prototype=linkLayerLongRange, target-data-prototype=height}, tlv-data-id=2}
      {data-prototype=Psd2_PPort.linkLayerLongRange, element-in-impl-datatype={root-data-prototype=linkLayerLongRange, target-data-prototype=arrayMember}, tlv-data-id=0}
      {data-prototype=Psd2_PPort.linkLayerLongRange, element-in-impl-datatype={root-data-prototype=linkLayerLongRange, target-data-prototype=longitude}, tlv-data-id=0}
      {data-prototype=Psd2_PPort.linkLayerLongRange, element-in-impl-datatype={root-data-prototype=linkLayerLongRange, target-data-prototype=latitude}, tlv-data-id=1}
      {data-prototype=Psd2_PPort.linkLayerLongRange, element-in-impl-datatype={root-data-prototype=linkLayerLongRange, target-data-prototype=height}, tlv-data-id=2}
      {data-prototype=Psd2_PPort.linkLayerLongRange, element-in-impl-datatype={root-data-prototype=linkLayerLongRange, target-data-prototype=adasAccuracyType}, tlv-data-id=0}
      {data-prototype=Psd2_PPort.linkLayerLongRange, element-in-impl-datatype={root-data-prototype=linkLayerLongRange, target-data-prototype=arrayMember}, tlv-data-id=0}
      {data-prototype=Psd2_PPort.linkLayerLongRange, element-in-impl-datatype={root-data-prototype=linkLayerLongRange, target-data-prototype=confidence}, tlv-data-id=0}
      {data-prototype=Psd2_PPort.linkLayerLongRange, element-in-impl-datatype={root-data-prototype=linkLayerLongRange, target-data-prototype=attributeType}, tlv-data-id=1}
      {data-prototype=Psd2_PPort.linkLayerLongRange, element-in-impl-datatype={root-data-prototype=linkLayerLongRange, target-data-prototype=direction}, tlv-data-id=2}
      {data-prototype=Psd2_PPort.linkLayerLongRange, element-in-impl-datatype={root-data-prototype=linkLayerLongRange, target-data-prototype=attributePointList}, tlv-data-id=3}
      {data-prototype=Psd2_PPort.linkLayerLongRange, element-in-impl-datatype={root-data-prototype=linkLayerLongRange, target-data-prototype=direction}, tlv-data-id=0}
      {data-prototype=Psd2_PPort.linkLayerLongRange, element-in-impl-datatype={root-data-prototype=linkLayerLongRange, target-data-prototype=arrayMember}, tlv-data-id=0}
      {data-prototype=Psd2_PPort.linkLayerLongRange, element-in-impl-datatype={root-data-prototype=linkLayerLongRange, target-data-prototype=offset}, tlv-data-id=0}
      {data-prototype=Psd2_PPort.linkLayerLongRange, element-in-impl-datatype={root-data-prototype=linkLayerLongRange, target-data-prototype=attributeValue}, tlv-data-id=1}
      {data-prototype=Psd2_PPort.linkLayerLongRange, element-in-impl-datatype={root-data-prototype=linkLayerLongRange, target-data-prototype=laneList}, tlv-data-id=2}
      {data-prototype=Psd2_PPort.linkLayerLongRange, element-in-impl-datatype={root-data-prototype=linkLayerLongRange, target-data-prototype=intValue}, tlv-data-id=0}
      {data-prototype=Psd2_PPort.linkLayerLongRange, element-in-impl-datatype={root-data-prototype=linkLayerLongRange, target-data-prototype=floatValue}, tlv-data-id=1}
      {data-prototype=Psd2_PPort.linkLayerLongRange, element-in-impl-datatype={root-data-prototype=linkLayerLongRange, target-data-prototype=blobValue}, tlv-data-id=2}
      {data-prototype=Psd2_PPort.linkLayerLongRange, element-in-impl-datatype={root-data-prototype=linkLayerLongRange, target-data-prototype=speedLimit}, tlv-data-id=3}
      {data-prototype=Psd2_PPort.linkLayerLongRange, element-in-impl-datatype={root-data-prototype=linkLayerLongRange, target-data-prototype=overtakingProhibition}, tlv-data-id=4}
      {data-prototype=Psd2_PPort.linkLayerLongRange, element-in-impl-datatype={root-data-prototype=linkLayerLongRange, target-data-prototype=arrayMember}, tlv-data-id=0}
      {data-prototype=Psd2_PPort.linkLayerLongRange, element-in-impl-datatype={root-data-prototype=linkLayerLongRange, target-data-prototype=speedValue}, tlv-data-id=0}
      {data-prototype=Psd2_PPort.linkLayerLongRange, element-in-impl-datatype={root-data-prototype=linkLayerLongRange, target-data-prototype=source}, tlv-data-id=1}
      {data-prototype=Psd2_PPort.linkLayerLongRange, element-in-impl-datatype={root-data-prototype=linkLayerLongRange, target-data-prototype=constraintList}, tlv-data-id=2}
      {data-prototype=Psd2_PPort.linkLayerLongRange, element-in-impl-datatype={root-data-prototype=linkLayerLongRange, target-data-prototype=online}, tlv-data-id=3}
      {data-prototype=Psd2_PPort.linkLayerLongRange, element-in-impl-datatype={root-data-prototype=linkLayerLongRange, target-data-prototype=speedLimitSource}, tlv-data-id=0}
      {data-prototype=Psd2_PPort.linkLayerLongRange, element-in-impl-datatype={root-data-prototype=linkLayerLongRange, target-data-prototype=arrayMember}, tlv-data-id=0}
      {data-prototype=Psd2_PPort.linkLayerLongRange, element-in-impl-datatype={root-data-prototype=linkLayerLongRange, target-data-prototype=daysOfWeek}, tlv-data-id=0}
      {data-prototype=Psd2_PPort.linkLayerLongRange, element-in-impl-datatype={root-data-prototype=linkLayerLongRange, target-data-prototype=timeRangeOfDay}, tlv-data-id=1}
      {data-prototype=Psd2_PPort.linkLayerLongRange, element-in-impl-datatype={root-data-prototype=linkLayerLongRange, target-data-prototype=weatherConstraint}, tlv-data-id=2}
      {data-prototype=Psd2_PPort.linkLayerLongRange, element-in-impl-datatype={root-data-prototype=linkLayerLongRange, target-data-prototype=timeClassifier}, tlv-data-id=3}
      {data-prototype=Psd2_PPort.linkLayerLongRange, element-in-impl-datatype={root-data-prototype=linkLayerLongRange, target-data-prototype=zoneClassifier}, tlv-data-id=4}
      {data-prototype=Psd2_PPort.linkLayerLongRange, element-in-impl-datatype={root-data-prototype=linkLayerLongRange, target-data-prototype=applicableVehicles}, tlv-data-id=5}
      {data-prototype=Psd2_PPort.linkLayerLongRange, element-in-impl-datatype={root-data-prototype=linkLayerLongRange, target-data-prototype=turnConstraint}, tlv-data-id=6}
      {data-prototype=Psd2_PPort.linkLayerLongRange, element-in-impl-datatype={root-data-prototype=linkLayerLongRange, target-data-prototype=arrayMember}, tlv-data-id=0}
      {data-prototype=Psd2_PPort.linkLayerLongRange, element-in-impl-datatype={root-data-prototype=linkLayerLongRange, target-data-prototype=startTimeHour}, tlv-data-id=0}
      {data-prototype=Psd2_PPort.linkLayerLongRange, element-in-impl-datatype={root-data-prototype=linkLayerLongRange, target-data-prototype=startTimeMinute}, tlv-data-id=1}
      {data-prototype=Psd2_PPort.linkLayerLongRange, element-in-impl-datatype={root-data-prototype=linkLayerLongRange, target-data-prototype=endTimeHour}, tlv-data-id=2}
      {data-prototype=Psd2_PPort.linkLayerLongRange, element-in-impl-datatype={root-data-prototype=linkLayerLongRange, target-data-prototype=endTimeMinute}, tlv-data-id=3}
      {data-prototype=Psd2_PPort.linkLayerLongRange, element-in-impl-datatype={root-data-prototype=linkLayerLongRange, target-data-prototype=Weather}, tlv-data-id=0}
      {data-prototype=Psd2_PPort.linkLayerLongRange, element-in-impl-datatype={root-data-prototype=linkLayerLongRange, target-data-prototype=timeConstraintType}, tlv-data-id=0}
      {data-prototype=Psd2_PPort.linkLayerLongRange, element-in-impl-datatype={root-data-prototype=linkLayerLongRange, target-data-prototype=zoneConstraintType}, tlv-data-id=0}
      {data-prototype=Psd2_PPort.linkLayerLongRange, element-in-impl-datatype={root-data-prototype=linkLayerLongRange, target-data-prototype=applicableVehiclesType}, tlv-data-id=0}
      {data-prototype=Psd2_PPort.linkLayerLongRange, element-in-impl-datatype={root-data-prototype=linkLayerLongRange, target-data-prototype=turnConstraint}, tlv-data-id=0}
      {data-prototype=Psd2_PPort.linkLayerLongRange, element-in-impl-datatype={root-data-prototype=linkLayerLongRange, target-data-prototype=online}, tlv-data-id=0}
      {data-prototype=Psd2_PPort.linkLayerLongRange, element-in-impl-datatype={root-data-prototype=linkLayerLongRange, target-data-prototype=constraintList}, tlv-data-id=1}
      {data-prototype=Psd2_PPort.linkLayerLongRange, element-in-impl-datatype={root-data-prototype=linkLayerLongRange, target-data-prototype=type}, tlv-data-id=2}
      {data-prototype=Psd2_PPort.linkLayerLongRange, element-in-impl-datatype={root-data-prototype=linkLayerLongRange, target-data-prototype=arrayMember}, tlv-data-id=0}
      {data-prototype=Psd2_PPort.linkLayerLongRange, element-in-impl-datatype={root-data-prototype=linkLayerLongRange, target-data-prototype=daysOfWeek}, tlv-data-id=0}
      {data-prototype=Psd2_PPort.linkLayerLongRange, element-in-impl-datatype={root-data-prototype=linkLayerLongRange, target-data-prototype=timeRangeOfDay}, tlv-data-id=1}
      {data-prototype=Psd2_PPort.linkLayerLongRange, element-in-impl-datatype={root-data-prototype=linkLayerLongRange, target-data-prototype=weatherConstraint}, tlv-data-id=2}
      {data-prototype=Psd2_PPort.linkLayerLongRange, element-in-impl-datatype={root-data-prototype=linkLayerLongRange, target-data-prototype=timeClassifier}, tlv-data-id=3}
      {data-prototype=Psd2_PPort.linkLayerLongRange, element-in-impl-datatype={root-data-prototype=linkLayerLongRange, target-data-prototype=zoneClassifier}, tlv-data-id=4}
      {data-prototype=Psd2_PPort.linkLayerLongRange, element-in-impl-datatype={root-data-prototype=linkLayerLongRange, target-data-prototype=applicableVehicles}, tlv-data-id=5}
      {data-prototype=Psd2_PPort.linkLayerLongRange, element-in-impl-datatype={root-data-prototype=linkLayerLongRange, target-data-prototype=turnConstraint}, tlv-data-id=6}
      {data-prototype=Psd2_PPort.linkLayerLongRange, element-in-impl-datatype={root-data-prototype=linkLayerLongRange, target-data-prototype=arrayMember}, tlv-data-id=0}
      {data-prototype=Psd2_PPort.linkLayerLongRange, element-in-impl-datatype={root-data-prototype=linkLayerLongRange, target-data-prototype=startTimeHour}, tlv-data-id=0}
      {data-prototype=Psd2_PPort.linkLayerLongRange, element-in-impl-datatype={root-data-prototype=linkLayerLongRange, target-data-prototype=startTimeMinute}, tlv-data-id=1}
      {data-prototype=Psd2_PPort.linkLayerLongRange, element-in-impl-datatype={root-data-prototype=linkLayerLongRange, target-data-prototype=endTimeHour}, tlv-data-id=2}
      {data-prototype=Psd2_PPort.linkLayerLongRange, element-in-impl-datatype={root-data-prototype=linkLayerLongRange, target-data-prototype=endTimeMinute}, tlv-data-id=3}
      {data-prototype=Psd2_PPort.linkLayerLongRange, element-in-impl-datatype={root-data-prototype=linkLayerLongRange, target-data-prototype=Weather}, tlv-data-id=0}
      {data-prototype=Psd2_PPort.linkLayerLongRange, element-in-impl-datatype={root-data-prototype=linkLayerLongRange, target-data-prototype=timeConstraintType}, tlv-data-id=0}
      {data-prototype=Psd2_PPort.linkLayerLongRange, element-in-impl-datatype={root-data-prototype=linkLayerLongRange, target-data-prototype=zoneConstraintType}, tlv-data-id=0}
      {data-prototype=Psd2_PPort.linkLayerLongRange, element-in-impl-datatype={root-data-prototype=linkLayerLongRange, target-data-prototype=applicableVehiclesType}, tlv-data-id=0}
      {data-prototype=Psd2_PPort.linkLayerLongRange, element-in-impl-datatype={root-data-prototype=linkLayerLongRange, target-data-prototype=turnConstraint}, tlv-data-id=0}
      {data-prototype=Psd2_PPort.linkLayerLongRange, element-in-impl-datatype={root-data-prototype=linkLayerLongRange, target-data-prototype=overtakingProhibitionType}, tlv-data-id=0}
      {data-prototype=Psd2_PPort.linkLayerLongRange, element-in-impl-datatype={root-data-prototype=linkLayerLongRange, target-data-prototype=arrayMember}, tlv-data-id=0}
      {data-prototype=Psd2_PPort.linkLayerLongRange, element-in-impl-datatype={root-data-prototype=linkLayerLongRange, target-data-prototype=rightOfWayRegulation}, tlv-data-id=0}
      {data-prototype=Psd2_PPort.linkLayerLongRange, element-in-impl-datatype={root-data-prototype=linkLayerLongRange, target-data-prototype=referenceBaseList}, tlv-data-id=0}
      {data-prototype=Psd2_PPort.linkLayerLongRange, element-in-impl-datatype={root-data-prototype=linkLayerLongRange, target-data-prototype=metaDataList}, tlv-data-id=1}
      {data-prototype=Psd2_PPort.linkLayerLongRange, element-in-impl-datatype={root-data-prototype=linkLayerLongRange, target-data-prototype=arrayMember}, tlv-data-id=0}
      {data-prototype=Psd2_PPort.linkLayerLongRange, element-in-impl-datatype={root-data-prototype=linkLayerLongRange, target-data-prototype=productId}, tlv-data-id=0}
      {data-prototype=Psd2_PPort.linkLayerLongRange, element-in-impl-datatype={root-data-prototype=linkLayerLongRange, target-data-prototype=updateRegion}, tlv-data-id=1}
      {data-prototype=Psd2_PPort.linkLayerLongRange, element-in-impl-datatype={root-data-prototype=linkLayerLongRange, target-data-prototype=tileId}, tlv-data-id=2}
      {data-prototype=Psd2_PPort.linkLayerLongRange, element-in-impl-datatype={root-data-prototype=linkLayerLongRange, target-data-prototype=arrayMember}, tlv-data-id=0}
      {data-prototype=Psd2_PPort.linkLayerLongRange, element-in-impl-datatype={root-data-prototype=linkLayerLongRange, target-data-prototype=countryCode}, tlv-data-id=0}
      {data-prototype=Psd2_PPort.linkLayerLongRange, element-in-impl-datatype={root-data-prototype=linkLayerLongRange, target-data-prototype=regionCode}, tlv-data-id=1}
      {data-prototype=Psd2_PPort.linkLayerLongRange, element-in-impl-datatype={root-data-prototype=linkLayerLongRange, target-data-prototype=mapAge}, tlv-data-id=2}
      {data-prototype=Psd2_PPort.linkLayerLongRange, element-in-impl-datatype={root-data-prototype=linkLayerLongRange, target-data-prototype=qualityIndicators}, tlv-data-id=3}
      {data-prototype=Psd2_PPort.linkLayerLongRange, element-in-impl-datatype={root-data-prototype=linkLayerLongRange, target-data-prototype=trafficDirection}, tlv-data-id=4}
      {data-prototype=Psd2_PPort.linkLayerLongRange, element-in-impl-datatype={root-data-prototype=linkLayerLongRange, target-data-prototype=generalSpeedLimits}, tlv-data-id=5}
      {data-prototype=Psd2_PPort.linkLayerLongRange, element-in-impl-datatype={root-data-prototype=linkLayerLongRange, target-data-prototype=speedUnit}, tlv-data-id=6}
      {data-prototype=Psd2_PPort.linkLayerLongRange, element-in-impl-datatype={root-data-prototype=linkLayerLongRange, target-data-prototype=month}, tlv-data-id=0}
      {data-prototype=Psd2_PPort.linkLayerLongRange, element-in-impl-datatype={root-data-prototype=linkLayerLongRange, target-data-prototype=year}, tlv-data-id=1}
      {data-prototype=Psd2_PPort.linkLayerLongRange, element-in-impl-datatype={root-data-prototype=linkLayerLongRange, target-data-prototype=arrayMember}, tlv-data-id=0}
      {data-prototype=Psd2_PPort.linkLayerLongRange, element-in-impl-datatype={root-data-prototype=linkLayerLongRange, target-data-prototype=type}, tlv-data-id=0}
      {data-prototype=Psd2_PPort.linkLayerLongRange, element-in-impl-datatype={root-data-prototype=linkLayerLongRange, target-data-prototype=quality}, tlv-data-id=1}
      {data-prototype=Psd2_PPort.linkLayerLongRange, element-in-impl-datatype={root-data-prototype=linkLayerLongRange, target-data-prototype=qualityIndicatorType}, tlv-data-id=0}
      {data-prototype=Psd2_PPort.linkLayerLongRange, element-in-impl-datatype={root-data-prototype=linkLayerLongRange, target-data-prototype=trafficDirection}, tlv-data-id=0}
      {data-prototype=Psd2_PPort.linkLayerLongRange, element-in-impl-datatype={root-data-prototype=linkLayerLongRange, target-data-prototype=arrayMember}, tlv-data-id=0}
      {data-prototype=Psd2_PPort.linkLayerLongRange, element-in-impl-datatype={root-data-prototype=linkLayerLongRange, target-data-prototype=type}, tlv-data-id=0}
      {data-prototype=Psd2_PPort.linkLayerLongRange, element-in-impl-datatype={root-data-prototype=linkLayerLongRange, target-data-prototype=speedValue}, tlv-data-id=1}
      {data-prototype=Psd2_PPort.linkLayerLongRange, element-in-impl-datatype={root-data-prototype=linkLayerLongRange, target-data-prototype=constraint}, tlv-data-id=3}
      {data-prototype=Psd2_PPort.linkLayerLongRange, element-in-impl-datatype={root-data-prototype=linkLayerLongRange, target-data-prototype=generalSpeedLimitType}, tlv-data-id=0}
      {data-prototype=Psd2_PPort.linkLayerLongRange, element-in-impl-datatype={root-data-prototype=linkLayerLongRange, target-data-prototype=arrayMember}, tlv-data-id=0}
      {data-prototype=Psd2_PPort.linkLayerLongRange, element-in-impl-datatype={root-data-prototype=linkLayerLongRange, target-data-prototype=daysOfWeek}, tlv-data-id=0}
      {data-prototype=Psd2_PPort.linkLayerLongRange, element-in-impl-datatype={root-data-prototype=linkLayerLongRange, target-data-prototype=timeRangeOfDay}, tlv-data-id=1}
      {data-prototype=Psd2_PPort.linkLayerLongRange, element-in-impl-datatype={root-data-prototype=linkLayerLongRange, target-data-prototype=weatherConstraint}, tlv-data-id=2}
      {data-prototype=Psd2_PPort.linkLayerLongRange, element-in-impl-datatype={root-data-prototype=linkLayerLongRange, target-data-prototype=timeClassifier}, tlv-data-id=3}
      {data-prototype=Psd2_PPort.linkLayerLongRange, element-in-impl-datatype={root-data-prototype=linkLayerLongRange, target-data-prototype=zoneClassifier}, tlv-data-id=4}
      {data-prototype=Psd2_PPort.linkLayerLongRange, element-in-impl-datatype={root-data-prototype=linkLayerLongRange, target-data-prototype=applicableVehicles}, tlv-data-id=5}
      {data-prototype=Psd2_PPort.linkLayerLongRange, element-in-impl-datatype={root-data-prototype=linkLayerLongRange, target-data-prototype=turnConstraint}, tlv-data-id=6}
      {data-prototype=Psd2_PPort.linkLayerLongRange, element-in-impl-datatype={root-data-prototype=linkLayerLongRange, target-data-prototype=arrayMember}, tlv-data-id=0}
      {data-prototype=Psd2_PPort.linkLayerLongRange, element-in-impl-datatype={root-data-prototype=linkLayerLongRange, target-data-prototype=startTimeHour}, tlv-data-id=0}
      {data-prototype=Psd2_PPort.linkLayerLongRange, element-in-impl-datatype={root-data-prototype=linkLayerLongRange, target-data-prototype=startTimeMinute}, tlv-data-id=1}
      {data-prototype=Psd2_PPort.linkLayerLongRange, element-in-impl-datatype={root-data-prototype=linkLayerLongRange, target-data-prototype=endTimeHour}, tlv-data-id=2}
      {data-prototype=Psd2_PPort.linkLayerLongRange, element-in-impl-datatype={root-data-prototype=linkLayerLongRange, target-data-prototype=endTimeMinute}, tlv-data-id=3}
      {data-prototype=Psd2_PPort.linkLayerLongRange, element-in-impl-datatype={root-data-prototype=linkLayerLongRange, target-data-prototype=Weather}, tlv-data-id=0}
      {data-prototype=Psd2_PPort.linkLayerLongRange, element-in-impl-datatype={root-data-prototype=linkLayerLongRange, target-data-prototype=timeConstraintType}, tlv-data-id=0}
      {data-prototype=Psd2_PPort.linkLayerLongRange, element-in-impl-datatype={root-data-prototype=linkLayerLongRange, target-data-prototype=zoneConstraintType}, tlv-data-id=0}
      {data-prototype=Psd2_PPort.linkLayerLongRange, element-in-impl-datatype={root-data-prototype=linkLayerLongRange, target-data-prototype=applicableVehiclesType}, tlv-data-id=0}
      {data-prototype=Psd2_PPort.linkLayerLongRange, element-in-impl-datatype={root-data-prototype=linkLayerLongRange, target-data-prototype=turnConstraint}, tlv-data-id=0}
      {data-prototype=Psd2_PPort.linkLayerLongRange, element-in-impl-datatype={root-data-prototype=linkLayerLongRange, target-data-prototype=speedUnit}, tlv-data-id=0}
      {data-prototype=Psd2_PPort.linkLayerShortRange, element-in-impl-datatype={root-data-prototype=linkLayerShortRange, target-data-prototype=id}, tlv-data-id=0}
      {data-prototype=Psd2_PPort.linkLayerShortRange, element-in-impl-datatype={root-data-prototype=linkLayerShortRange, target-data-prototype=linkLayerShortRange}, tlv-data-id=1}
      {data-prototype=Psd2_PPort.linkLayerShortRange, element-in-impl-datatype={root-data-prototype=linkLayerShortRange, target-data-prototype=layerInfo}, tlv-data-id=2}
      {data-prototype=Psd2_PPort.linkLayerShortRange, element-in-impl-datatype={root-data-prototype=linkLayerShortRange, target-data-prototype=metaDataIndex}, tlv-data-id=0}
      {data-prototype=Psd2_PPort.linkLayerShortRange, element-in-impl-datatype={root-data-prototype=linkLayerShortRange, target-data-prototype=fromLinkList}, tlv-data-id=1}
      {data-prototype=Psd2_PPort.linkLayerShortRange, element-in-impl-datatype={root-data-prototype=linkLayerShortRange, target-data-prototype=toLinkList}, tlv-data-id=2}
      {data-prototype=Psd2_PPort.linkLayerShortRange, element-in-impl-datatype={root-data-prototype=linkLayerShortRange, target-data-prototype=linkType}, tlv-data-id=3}
      {data-prototype=Psd2_PPort.linkLayerShortRange, element-in-impl-datatype={root-data-prototype=linkLayerShortRange, target-data-prototype=reference}, tlv-data-id=4}
      {data-prototype=Psd2_PPort.linkLayerShortRange, element-in-impl-datatype={root-data-prototype=linkLayerShortRange, target-data-prototype=controlledAccess}, tlv-data-id=5}
      {data-prototype=Psd2_PPort.linkLayerShortRange, element-in-impl-datatype={root-data-prototype=linkLayerShortRange, target-data-prototype=drivingDirection}, tlv-data-id=6}
      {data-prototype=Psd2_PPort.linkLayerShortRange, element-in-impl-datatype={root-data-prototype=linkLayerShortRange, target-data-prototype=functionalRoadClass}, tlv-data-id=7}
      {data-prototype=Psd2_PPort.linkLayerShortRange, element-in-impl-datatype={root-data-prototype=linkLayerShortRange, target-data-prototype=clothoidList}, tlv-data-id=8}
      {data-prototype=Psd2_PPort.linkLayerShortRange, element-in-impl-datatype={root-data-prototype=linkLayerShortRange, target-data-prototype=polyline}, tlv-data-id=9}
      {data-prototype=Psd2_PPort.linkLayerShortRange, element-in-impl-datatype={root-data-prototype=linkLayerShortRange, target-data-prototype=insideCityLimits}, tlv-data-id=10}
      {data-prototype=Psd2_PPort.linkLayerShortRange, element-in-impl-datatype={root-data-prototype=linkLayerShortRange, target-data-prototype=tollway}, tlv-data-id=11}
      {data-prototype=Psd2_PPort.linkLayerShortRange, element-in-impl-datatype={root-data-prototype=linkLayerShortRange, target-data-prototype=adas}, tlv-data-id=12}
      {data-prototype=Psd2_PPort.linkLayerShortRange, element-in-impl-datatype={root-data-prototype=linkLayerShortRange, target-data-prototype=urban}, tlv-data-id=13}
      {data-prototype=Psd2_PPort.linkLayerShortRange, element-in-impl-datatype={root-data-prototype=linkLayerShortRange, target-data-prototype=paved}, tlv-data-id=14}
      {data-prototype=Psd2_PPort.linkLayerShortRange, element-in-impl-datatype={root-data-prototype=linkLayerShortRange, target-data-prototype=attributeList}, tlv-data-id=15}
      {data-prototype=Psd2_PPort.linkLayerShortRange, element-in-impl-datatype={root-data-prototype=linkLayerShortRange, target-data-prototype=avgSpeed}, tlv-data-id=16}
      {data-prototype=Psd2_PPort.linkLayerShortRange, element-in-impl-datatype={root-data-prototype=linkLayerShortRange, target-data-prototype=rightOfWay}, tlv-data-id=17}
      {data-prototype=Psd2_PPort.linkLayerShortRange, element-in-impl-datatype={root-data-prototype=linkLayerShortRange, target-data-prototype=length}, tlv-data-id=18}
      {data-prototype=Psd2_PPort.linkLayerShortRange, element-in-impl-datatype={root-data-prototype=linkLayerShortRange, target-data-prototype=arrayMember}, tlv-data-id=0}
      {data-prototype=Psd2_PPort.linkLayerShortRange, element-in-impl-datatype={root-data-prototype=linkLayerShortRange, target-data-prototype=localId}, tlv-data-id=1}
      {data-prototype=Psd2_PPort.linkLayerShortRange, element-in-impl-datatype={root-data-prototype=linkLayerShortRange, target-data-prototype=referenceBaseIndex}, tlv-data-id=0}
      {data-prototype=Psd2_PPort.linkLayerShortRange, element-in-impl-datatype={root-data-prototype=linkLayerShortRange, target-data-prototype=inPositiveDirection}, tlv-data-id=2}
      {data-prototype=Psd2_PPort.linkLayerShortRange, element-in-impl-datatype={root-data-prototype=linkLayerShortRange, target-data-prototype=arrayMember}, tlv-data-id=0}
      {data-prototype=Psd2_PPort.linkLayerShortRange, element-in-impl-datatype={root-data-prototype=linkLayerShortRange, target-data-prototype=localId}, tlv-data-id=1}
      {data-prototype=Psd2_PPort.linkLayerShortRange, element-in-impl-datatype={root-data-prototype=linkLayerShortRange, target-data-prototype=referenceBaseIndex}, tlv-data-id=0}
      {data-prototype=Psd2_PPort.linkLayerShortRange, element-in-impl-datatype={root-data-prototype=linkLayerShortRange, target-data-prototype=inPositiveDirection}, tlv-data-id=2}
      {data-prototype=Psd2_PPort.linkLayerShortRange, element-in-impl-datatype={root-data-prototype=linkLayerShortRange, target-data-prototype=linkType}, tlv-data-id=0}
      {data-prototype=Psd2_PPort.linkLayerShortRange, element-in-impl-datatype={root-data-prototype=linkLayerShortRange, target-data-prototype=localId}, tlv-data-id=1}
      {data-prototype=Psd2_PPort.linkLayerShortRange, element-in-impl-datatype={root-data-prototype=linkLayerShortRange, target-data-prototype=referenceBaseIndex}, tlv-data-id=0}
      {data-prototype=Psd2_PPort.linkLayerShortRange, element-in-impl-datatype={root-data-prototype=linkLayerShortRange, target-data-prototype=inPositiveDirection}, tlv-data-id=2}
      {data-prototype=Psd2_PPort.linkLayerShortRange, element-in-impl-datatype={root-data-prototype=linkLayerShortRange, target-data-prototype=direction}, tlv-data-id=0}
      {data-prototype=Psd2_PPort.linkLayerShortRange, element-in-impl-datatype={root-data-prototype=linkLayerShortRange, target-data-prototype=functionalRoadClass}, tlv-data-id=0}
      {data-prototype=Psd2_PPort.linkLayerShortRange, element-in-impl-datatype={root-data-prototype=linkLayerShortRange, target-data-prototype=arrayMember}, tlv-data-id=0}
      {data-prototype=Psd2_PPort.linkLayerShortRange, element-in-impl-datatype={root-data-prototype=linkLayerShortRange, target-data-prototype=startCurvature}, tlv-data-id=0}
      {data-prototype=Psd2_PPort.linkLayerShortRange, element-in-impl-datatype={root-data-prototype=linkLayerShortRange, target-data-prototype=endCurvature}, tlv-data-id=1}
      {data-prototype=Psd2_PPort.linkLayerShortRange, element-in-impl-datatype={root-data-prototype=linkLayerShortRange, target-data-prototype=length}, tlv-data-id=2}
      {data-prototype=Psd2_PPort.linkLayerShortRange, element-in-impl-datatype={root-data-prototype=linkLayerShortRange, target-data-prototype=angle}, tlv-data-id=3}
      {data-prototype=Psd2_PPort.linkLayerShortRange, element-in-impl-datatype={root-data-prototype=linkLayerShortRange, target-data-prototype=ndsCoordinates}, tlv-data-id=4}
      {data-prototype=Psd2_PPort.linkLayerShortRange, element-in-impl-datatype={root-data-prototype=linkLayerShortRange, target-data-prototype=geometryQuality}, tlv-data-id=6}
      {data-prototype=Psd2_PPort.linkLayerShortRange, element-in-impl-datatype={root-data-prototype=linkLayerShortRange, target-data-prototype=longitude}, tlv-data-id=0}
      {data-prototype=Psd2_PPort.linkLayerShortRange, element-in-impl-datatype={root-data-prototype=linkLayerShortRange, target-data-prototype=latitude}, tlv-data-id=1}
      {data-prototype=Psd2_PPort.linkLayerShortRange, element-in-impl-datatype={root-data-prototype=linkLayerShortRange, target-data-prototype=height}, tlv-data-id=2}
      {data-prototype=Psd2_PPort.linkLayerShortRange, element-in-impl-datatype={root-data-prototype=linkLayerShortRange, target-data-prototype=arrayMember}, tlv-data-id=0}
      {data-prototype=Psd2_PPort.linkLayerShortRange, element-in-impl-datatype={root-data-prototype=linkLayerShortRange, target-data-prototype=longitude}, tlv-data-id=0}
      {data-prototype=Psd2_PPort.linkLayerShortRange, element-in-impl-datatype={root-data-prototype=linkLayerShortRange, target-data-prototype=latitude}, tlv-data-id=1}
      {data-prototype=Psd2_PPort.linkLayerShortRange, element-in-impl-datatype={root-data-prototype=linkLayerShortRange, target-data-prototype=height}, tlv-data-id=2}
      {data-prototype=Psd2_PPort.linkLayerShortRange, element-in-impl-datatype={root-data-prototype=linkLayerShortRange, target-data-prototype=adasAccuracyType}, tlv-data-id=0}
      {data-prototype=Psd2_PPort.linkLayerShortRange, element-in-impl-datatype={root-data-prototype=linkLayerShortRange, target-data-prototype=arrayMember}, tlv-data-id=0}
      {data-prototype=Psd2_PPort.linkLayerShortRange, element-in-impl-datatype={root-data-prototype=linkLayerShortRange, target-data-prototype=confidence}, tlv-data-id=0}
      {data-prototype=Psd2_PPort.linkLayerShortRange, element-in-impl-datatype={root-data-prototype=linkLayerShortRange, target-data-prototype=attributeType}, tlv-data-id=1}
      {data-prototype=Psd2_PPort.linkLayerShortRange, element-in-impl-datatype={root-data-prototype=linkLayerShortRange, target-data-prototype=direction}, tlv-data-id=2}
      {data-prototype=Psd2_PPort.linkLayerShortRange, element-in-impl-datatype={root-data-prototype=linkLayerShortRange, target-data-prototype=attributePointList}, tlv-data-id=3}
      {data-prototype=Psd2_PPort.linkLayerShortRange, element-in-impl-datatype={root-data-prototype=linkLayerShortRange, target-data-prototype=direction}, tlv-data-id=0}
      {data-prototype=Psd2_PPort.linkLayerShortRange, element-in-impl-datatype={root-data-prototype=linkLayerShortRange, target-data-prototype=arrayMember}, tlv-data-id=0}
      {data-prototype=Psd2_PPort.linkLayerShortRange, element-in-impl-datatype={root-data-prototype=linkLayerShortRange, target-data-prototype=offset}, tlv-data-id=0}
      {data-prototype=Psd2_PPort.linkLayerShortRange, element-in-impl-datatype={root-data-prototype=linkLayerShortRange, target-data-prototype=attributeValue}, tlv-data-id=1}
      {data-prototype=Psd2_PPort.linkLayerShortRange, element-in-impl-datatype={root-data-prototype=linkLayerShortRange, target-data-prototype=laneList}, tlv-data-id=2}
      {data-prototype=Psd2_PPort.linkLayerShortRange, element-in-impl-datatype={root-data-prototype=linkLayerShortRange, target-data-prototype=intValue}, tlv-data-id=0}
      {data-prototype=Psd2_PPort.linkLayerShortRange, element-in-impl-datatype={root-data-prototype=linkLayerShortRange, target-data-prototype=floatValue}, tlv-data-id=1}
      {data-prototype=Psd2_PPort.linkLayerShortRange, element-in-impl-datatype={root-data-prototype=linkLayerShortRange, target-data-prototype=blobValue}, tlv-data-id=2}
      {data-prototype=Psd2_PPort.linkLayerShortRange, element-in-impl-datatype={root-data-prototype=linkLayerShortRange, target-data-prototype=speedLimit}, tlv-data-id=3}
      {data-prototype=Psd2_PPort.linkLayerShortRange, element-in-impl-datatype={root-data-prototype=linkLayerShortRange, target-data-prototype=overtakingProhibition}, tlv-data-id=4}
      {data-prototype=Psd2_PPort.linkLayerShortRange, element-in-impl-datatype={root-data-prototype=linkLayerShortRange, target-data-prototype=arrayMember}, tlv-data-id=0}
      {data-prototype=Psd2_PPort.linkLayerShortRange, element-in-impl-datatype={root-data-prototype=linkLayerShortRange, target-data-prototype=speedValue}, tlv-data-id=0}
      {data-prototype=Psd2_PPort.linkLayerShortRange, element-in-impl-datatype={root-data-prototype=linkLayerShortRange, target-data-prototype=source}, tlv-data-id=1}
      {data-prototype=Psd2_PPort.linkLayerShortRange, element-in-impl-datatype={root-data-prototype=linkLayerShortRange, target-data-prototype=constraintList}, tlv-data-id=2}
      {data-prototype=Psd2_PPort.linkLayerShortRange, element-in-impl-datatype={root-data-prototype=linkLayerShortRange, target-data-prototype=online}, tlv-data-id=3}
      {data-prototype=Psd2_PPort.linkLayerShortRange, element-in-impl-datatype={root-data-prototype=linkLayerShortRange, target-data-prototype=speedLimitSource}, tlv-data-id=0}
      {data-prototype=Psd2_PPort.linkLayerShortRange, element-in-impl-datatype={root-data-prototype=linkLayerShortRange, target-data-prototype=arrayMember}, tlv-data-id=0}
      {data-prototype=Psd2_PPort.linkLayerShortRange, element-in-impl-datatype={root-data-prototype=linkLayerShortRange, target-data-prototype=daysOfWeek}, tlv-data-id=0}
      {data-prototype=Psd2_PPort.linkLayerShortRange, element-in-impl-datatype={root-data-prototype=linkLayerShortRange, target-data-prototype=timeRangeOfDay}, tlv-data-id=1}
      {data-prototype=Psd2_PPort.linkLayerShortRange, element-in-impl-datatype={root-data-prototype=linkLayerShortRange, target-data-prototype=weatherConstraint}, tlv-data-id=2}
      {data-prototype=Psd2_PPort.linkLayerShortRange, element-in-impl-datatype={root-data-prototype=linkLayerShortRange, target-data-prototype=timeClassifier}, tlv-data-id=3}
      {data-prototype=Psd2_PPort.linkLayerShortRange, element-in-impl-datatype={root-data-prototype=linkLayerShortRange, target-data-prototype=zoneClassifier}, tlv-data-id=4}
      {data-prototype=Psd2_PPort.linkLayerShortRange, element-in-impl-datatype={root-data-prototype=linkLayerShortRange, target-data-prototype=applicableVehicles}, tlv-data-id=5}
      {data-prototype=Psd2_PPort.linkLayerShortRange, element-in-impl-datatype={root-data-prototype=linkLayerShortRange, target-data-prototype=turnConstraint}, tlv-data-id=6}
      {data-prototype=Psd2_PPort.linkLayerShortRange, element-in-impl-datatype={root-data-prototype=linkLayerShortRange, target-data-prototype=arrayMember}, tlv-data-id=0}
      {data-prototype=Psd2_PPort.linkLayerShortRange, element-in-impl-datatype={root-data-prototype=linkLayerShortRange, target-data-prototype=startTimeHour}, tlv-data-id=0}
      {data-prototype=Psd2_PPort.linkLayerShortRange, element-in-impl-datatype={root-data-prototype=linkLayerShortRange, target-data-prototype=startTimeMinute}, tlv-data-id=1}
      {data-prototype=Psd2_PPort.linkLayerShortRange, element-in-impl-datatype={root-data-prototype=linkLayerShortRange, target-data-prototype=endTimeHour}, tlv-data-id=2}
      {data-prototype=Psd2_PPort.linkLayerShortRange, element-in-impl-datatype={root-data-prototype=linkLayerShortRange, target-data-prototype=endTimeMinute}, tlv-data-id=3}
      {data-prototype=Psd2_PPort.linkLayerShortRange, element-in-impl-datatype={root-data-prototype=linkLayerShortRange, target-data-prototype=Weather}, tlv-data-id=0}
      {data-prototype=Psd2_PPort.linkLayerShortRange, element-in-impl-datatype={root-data-prototype=linkLayerShortRange, target-data-prototype=timeConstraintType}, tlv-data-id=0}
      {data-prototype=Psd2_PPort.linkLayerShortRange, element-in-impl-datatype={root-data-prototype=linkLayerShortRange, target-data-prototype=zoneConstraintType}, tlv-data-id=0}
      {data-prototype=Psd2_PPort.linkLayerShortRange, element-in-impl-datatype={root-data-prototype=linkLayerShortRange, target-data-prototype=applicableVehiclesType}, tlv-data-id=0}
      {data-prototype=Psd2_PPort.linkLayerShortRange, element-in-impl-datatype={root-data-prototype=linkLayerShortRange, target-data-prototype=turnConstraint}, tlv-data-id=0}
      {data-prototype=Psd2_PPort.linkLayerShortRange, element-in-impl-datatype={root-data-prototype=linkLayerShortRange, target-data-prototype=online}, tlv-data-id=0}
      {data-prototype=Psd2_PPort.linkLayerShortRange, element-in-impl-datatype={root-data-prototype=linkLayerShortRange, target-data-prototype=constraintList}, tlv-data-id=1}
      {data-prototype=Psd2_PPort.linkLayerShortRange, element-in-impl-datatype={root-data-prototype=linkLayerShortRange, target-data-prototype=type}, tlv-data-id=2}
      {data-prototype=Psd2_PPort.linkLayerShortRange, element-in-impl-datatype={root-data-prototype=linkLayerShortRange, target-data-prototype=arrayMember}, tlv-data-id=0}
      {data-prototype=Psd2_PPort.linkLayerShortRange, element-in-impl-datatype={root-data-prototype=linkLayerShortRange, target-data-prototype=daysOfWeek}, tlv-data-id=0}
      {data-prototype=Psd2_PPort.linkLayerShortRange, element-in-impl-datatype={root-data-prototype=linkLayerShortRange, target-data-prototype=timeRangeOfDay}, tlv-data-id=1}
      {data-prototype=Psd2_PPort.linkLayerShortRange, element-in-impl-datatype={root-data-prototype=linkLayerShortRange, target-data-prototype=weatherConstraint}, tlv-data-id=2}
      {data-prototype=Psd2_PPort.linkLayerShortRange, element-in-impl-datatype={root-data-prototype=linkLayerShortRange, target-data-prototype=timeClassifier}, tlv-data-id=3}
      {data-prototype=Psd2_PPort.linkLayerShortRange, element-in-impl-datatype={root-data-prototype=linkLayerShortRange, target-data-prototype=zoneClassifier}, tlv-data-id=4}
      {data-prototype=Psd2_PPort.linkLayerShortRange, element-in-impl-datatype={root-data-prototype=linkLayerShortRange, target-data-prototype=applicableVehicles}, tlv-data-id=5}
      {data-prototype=Psd2_PPort.linkLayerShortRange, element-in-impl-datatype={root-data-prototype=linkLayerShortRange, target-data-prototype=turnConstraint}, tlv-data-id=6}
      {data-prototype=Psd2_PPort.linkLayerShortRange, element-in-impl-datatype={root-data-prototype=linkLayerShortRange, target-data-prototype=arrayMember}, tlv-data-id=0}
      {data-prototype=Psd2_PPort.linkLayerShortRange, element-in-impl-datatype={root-data-prototype=linkLayerShortRange, target-data-prototype=startTimeHour}, tlv-data-id=0}
      {data-prototype=Psd2_PPort.linkLayerShortRange, element-in-impl-datatype={root-data-prototype=linkLayerShortRange, target-data-prototype=startTimeMinute}, tlv-data-id=1}
      {data-prototype=Psd2_PPort.linkLayerShortRange, element-in-impl-datatype={root-data-prototype=linkLayerShortRange, target-data-prototype=endTimeHour}, tlv-data-id=2}
      {data-prototype=Psd2_PPort.linkLayerShortRange, element-in-impl-datatype={root-data-prototype=linkLayerShortRange, target-data-prototype=endTimeMinute}, tlv-data-id=3}
      {data-prototype=Psd2_PPort.linkLayerShortRange, element-in-impl-datatype={root-data-prototype=linkLayerShortRange, target-data-prototype=Weather}, tlv-data-id=0}
      {data-prototype=Psd2_PPort.linkLayerShortRange, element-in-impl-datatype={root-data-prototype=linkLayerShortRange, target-data-prototype=timeConstraintType}, tlv-data-id=0}
      {data-prototype=Psd2_PPort.linkLayerShortRange, element-in-impl-datatype={root-data-prototype=linkLayerShortRange, target-data-prototype=zoneConstraintType}, tlv-data-id=0}
      {data-prototype=Psd2_PPort.linkLayerShortRange, element-in-impl-datatype={root-data-prototype=linkLayerShortRange, target-data-prototype=applicableVehiclesType}, tlv-data-id=0}
      {data-prototype=Psd2_PPort.linkLayerShortRange, element-in-impl-datatype={root-data-prototype=linkLayerShortRange, target-data-prototype=turnConstraint}, tlv-data-id=0}
      {data-prototype=Psd2_PPort.linkLayerShortRange, element-in-impl-datatype={root-data-prototype=linkLayerShortRange, target-data-prototype=overtakingProhibitionType}, tlv-data-id=0}
      {data-prototype=Psd2_PPort.linkLayerShortRange, element-in-impl-datatype={root-data-prototype=linkLayerShortRange, target-data-prototype=arrayMember}, tlv-data-id=0}
      {data-prototype=Psd2_PPort.linkLayerShortRange, element-in-impl-datatype={root-data-prototype=linkLayerShortRange, target-data-prototype=rightOfWayRegulation}, tlv-data-id=0}
      {data-prototype=Psd2_PPort.linkLayerShortRange, element-in-impl-datatype={root-data-prototype=linkLayerShortRange, target-data-prototype=referenceBaseList}, tlv-data-id=0}
      {data-prototype=Psd2_PPort.linkLayerShortRange, element-in-impl-datatype={root-data-prototype=linkLayerShortRange, target-data-prototype=metaDataList}, tlv-data-id=1}
      {data-prototype=Psd2_PPort.linkLayerShortRange, element-in-impl-datatype={root-data-prototype=linkLayerShortRange, target-data-prototype=arrayMember}, tlv-data-id=0}
      {data-prototype=Psd2_PPort.linkLayerShortRange, element-in-impl-datatype={root-data-prototype=linkLayerShortRange, target-data-prototype=productId}, tlv-data-id=0}
      {data-prototype=Psd2_PPort.linkLayerShortRange, element-in-impl-datatype={root-data-prototype=linkLayerShortRange, target-data-prototype=updateRegion}, tlv-data-id=1}
      {data-prototype=Psd2_PPort.linkLayerShortRange, element-in-impl-datatype={root-data-prototype=linkLayerShortRange, target-data-prototype=tileId}, tlv-data-id=2}
      {data-prototype=Psd2_PPort.linkLayerShortRange, element-in-impl-datatype={root-data-prototype=linkLayerShortRange, target-data-prototype=arrayMember}, tlv-data-id=0}
      {data-prototype=Psd2_PPort.linkLayerShortRange, element-in-impl-datatype={root-data-prototype=linkLayerShortRange, target-data-prototype=countryCode}, tlv-data-id=0}
      {data-prototype=Psd2_PPort.linkLayerShortRange, element-in-impl-datatype={root-data-prototype=linkLayerShortRange, target-data-prototype=regionCode}, tlv-data-id=1}
      {data-prototype=Psd2_PPort.linkLayerShortRange, element-in-impl-datatype={root-data-prototype=linkLayerShortRange, target-data-prototype=mapAge}, tlv-data-id=2}
      {data-prototype=Psd2_PPort.linkLayerShortRange, element-in-impl-datatype={root-data-prototype=linkLayerShortRange, target-data-prototype=qualityIndicators}, tlv-data-id=3}
      {data-prototype=Psd2_PPort.linkLayerShortRange, element-in-impl-datatype={root-data-prototype=linkLayerShortRange, target-data-prototype=trafficDirection}, tlv-data-id=4}
      {data-prototype=Psd2_PPort.linkLayerShortRange, element-in-impl-datatype={root-data-prototype=linkLayerShortRange, target-data-prototype=generalSpeedLimits}, tlv-data-id=5}
      {data-prototype=Psd2_PPort.linkLayerShortRange, element-in-impl-datatype={root-data-prototype=linkLayerShortRange, target-data-prototype=speedUnit}, tlv-data-id=6}
      {data-prototype=Psd2_PPort.linkLayerShortRange, element-in-impl-datatype={root-data-prototype=linkLayerShortRange, target-data-prototype=month}, tlv-data-id=0}
      {data-prototype=Psd2_PPort.linkLayerShortRange, element-in-impl-datatype={root-data-prototype=linkLayerShortRange, target-data-prototype=year}, tlv-data-id=1}
      {data-prototype=Psd2_PPort.linkLayerShortRange, element-in-impl-datatype={root-data-prototype=linkLayerShortRange, target-data-prototype=arrayMember}, tlv-data-id=0}
      {data-prototype=Psd2_PPort.linkLayerShortRange, element-in-impl-datatype={root-data-prototype=linkLayerShortRange, target-data-prototype=type}, tlv-data-id=0}
      {data-prototype=Psd2_PPort.linkLayerShortRange, element-in-impl-datatype={root-data-prototype=linkLayerShortRange, target-data-prototype=quality}, tlv-data-id=1}
      {data-prototype=Psd2_PPort.linkLayerShortRange, element-in-impl-datatype={root-data-prototype=linkLayerShortRange, target-data-prototype=qualityIndicatorType}, tlv-data-id=0}
      {data-prototype=Psd2_PPort.linkLayerShortRange, element-in-impl-datatype={root-data-prototype=linkLayerShortRange, target-data-prototype=trafficDirection}, tlv-data-id=0}
      {data-prototype=Psd2_PPort.linkLayerShortRange, element-in-impl-datatype={root-data-prototype=linkLayerShortRange, target-data-prototype=arrayMember}, tlv-data-id=0}
      {data-prototype=Psd2_PPort.linkLayerShortRange, element-in-impl-datatype={root-data-prototype=linkLayerShortRange, target-data-prototype=type}, tlv-data-id=0}
      {data-prototype=Psd2_PPort.linkLayerShortRange, element-in-impl-datatype={root-data-prototype=linkLayerShortRange, target-data-prototype=speedValue}, tlv-data-id=1}
      {data-prototype=Psd2_PPort.linkLayerShortRange, element-in-impl-datatype={root-data-prototype=linkLayerShortRange, target-data-prototype=constraint}, tlv-data-id=3}
      {data-prototype=Psd2_PPort.linkLayerShortRange, element-in-impl-datatype={root-data-prototype=linkLayerShortRange, target-data-prototype=generalSpeedLimitType}, tlv-data-id=0}
      {data-prototype=Psd2_PPort.linkLayerShortRange, element-in-impl-datatype={root-data-prototype=linkLayerShortRange, target-data-prototype=arrayMember}, tlv-data-id=0}
      {data-prototype=Psd2_PPort.linkLayerShortRange, element-in-impl-datatype={root-data-prototype=linkLayerShortRange, target-data-prototype=daysOfWeek}, tlv-data-id=0}
      {data-prototype=Psd2_PPort.linkLayerShortRange, element-in-impl-datatype={root-data-prototype=linkLayerShortRange, target-data-prototype=timeRangeOfDay}, tlv-data-id=1}
      {data-prototype=Psd2_PPort.linkLayerShortRange, element-in-impl-datatype={root-data-prototype=linkLayerShortRange, target-data-prototype=weatherConstraint}, tlv-data-id=2}
      {data-prototype=Psd2_PPort.linkLayerShortRange, element-in-impl-datatype={root-data-prototype=linkLayerShortRange, target-data-prototype=timeClassifier}, tlv-data-id=3}
      {data-prototype=Psd2_PPort.linkLayerShortRange, element-in-impl-datatype={root-data-prototype=linkLayerShortRange, target-data-prototype=zoneClassifier}, tlv-data-id=4}
      {data-prototype=Psd2_PPort.linkLayerShortRange, element-in-impl-datatype={root-data-prototype=linkLayerShortRange, target-data-prototype=applicableVehicles}, tlv-data-id=5}
      {data-prototype=Psd2_PPort.linkLayerShortRange, element-in-impl-datatype={root-data-prototype=linkLayerShortRange, target-data-prototype=turnConstraint}, tlv-data-id=6}
      {data-prototype=Psd2_PPort.linkLayerShortRange, element-in-impl-datatype={root-data-prototype=linkLayerShortRange, target-data-prototype=arrayMember}, tlv-data-id=0}
      {data-prototype=Psd2_PPort.linkLayerShortRange, element-in-impl-datatype={root-data-prototype=linkLayerShortRange, target-data-prototype=startTimeHour}, tlv-data-id=0}
      {data-prototype=Psd2_PPort.linkLayerShortRange, element-in-impl-datatype={root-data-prototype=linkLayerShortRange, target-data-prototype=startTimeMinute}, tlv-data-id=1}
      {data-prototype=Psd2_PPort.linkLayerShortRange, element-in-impl-datatype={root-data-prototype=linkLayerShortRange, target-data-prototype=endTimeHour}, tlv-data-id=2}
      {data-prototype=Psd2_PPort.linkLayerShortRange, element-in-impl-datatype={root-data-prototype=linkLayerShortRange, target-data-prototype=endTimeMinute}, tlv-data-id=3}
      {data-prototype=Psd2_PPort.linkLayerShortRange, element-in-impl-datatype={root-data-prototype=linkLayerShortRange, target-data-prototype=Weather}, tlv-data-id=0}
      {data-prototype=Psd2_PPort.linkLayerShortRange, element-in-impl-datatype={root-data-prototype=linkLayerShortRange, target-data-prototype=timeConstraintType}, tlv-data-id=0}
      {data-prototype=Psd2_PPort.linkLayerShortRange, element-in-impl-datatype={root-data-prototype=linkLayerShortRange, target-data-prototype=zoneConstraintType}, tlv-data-id=0}
      {data-prototype=Psd2_PPort.linkLayerShortRange, element-in-impl-datatype={root-data-prototype=linkLayerShortRange, target-data-prototype=applicableVehiclesType}, tlv-data-id=0}
      {data-prototype=Psd2_PPort.linkLayerShortRange, element-in-impl-datatype={root-data-prototype=linkLayerShortRange, target-data-prototype=turnConstraint}, tlv-data-id=0}
      {data-prototype=Psd2_PPort.linkLayerShortRange, element-in-impl-datatype={root-data-prototype=linkLayerShortRange, target-data-prototype=speedUnit}, tlv-data-id=0}
      {data-prototype=Psd2_PPort.laneLayer, element-in-impl-datatype={root-data-prototype=laneLayer, target-data-prototype=id}, tlv-data-id=0}
      {data-prototype=Psd2_PPort.laneLayer, element-in-impl-datatype={root-data-prototype=laneLayer, target-data-prototype=laneLayer}, tlv-data-id=1}
      {data-prototype=Psd2_PPort.laneLayer, element-in-impl-datatype={root-data-prototype=laneLayer, target-data-prototype=layerInfo}, tlv-data-id=2}
      {data-prototype=Psd2_PPort.laneLayer, element-in-impl-datatype={root-data-prototype=laneLayer, target-data-prototype=laneGroupReference}, tlv-data-id=0}
      {data-prototype=Psd2_PPort.laneLayer, element-in-impl-datatype={root-data-prototype=laneLayer, target-data-prototype=linkReferenceList}, tlv-data-id=1}
      {data-prototype=Psd2_PPort.laneLayer, element-in-impl-datatype={root-data-prototype=laneLayer, target-data-prototype=laneList}, tlv-data-id=2}
      {data-prototype=Psd2_PPort.laneLayer, element-in-impl-datatype={root-data-prototype=laneLayer, target-data-prototype=laneBoundaryGroupList}, tlv-data-id=3}
      {data-prototype=Psd2_PPort.laneLayer, element-in-impl-datatype={root-data-prototype=laneLayer, target-data-prototype=laneGroupAssociationList}, tlv-data-id=4}
      {data-prototype=Psd2_PPort.laneLayer, element-in-impl-datatype={root-data-prototype=laneLayer, target-data-prototype=metaDataIndex}, tlv-data-id=5}
      {data-prototype=Psd2_PPort.laneLayer, element-in-impl-datatype={root-data-prototype=laneLayer, target-data-prototype=localId}, tlv-data-id=1}
      {data-prototype=Psd2_PPort.laneLayer, element-in-impl-datatype={root-data-prototype=laneLayer, target-data-prototype=referenceBaseIndex}, tlv-data-id=0}
      {data-prototype=Psd2_PPort.laneLayer, element-in-impl-datatype={root-data-prototype=laneLayer, target-data-prototype=inPositiveDirection}, tlv-data-id=2}
      {data-prototype=Psd2_PPort.laneLayer, element-in-impl-datatype={root-data-prototype=laneLayer, target-data-prototype=arrayMember}, tlv-data-id=0}
      {data-prototype=Psd2_PPort.laneLayer, element-in-impl-datatype={root-data-prototype=laneLayer, target-data-prototype=reference}, tlv-data-id=0}
      {data-prototype=Psd2_PPort.laneLayer, element-in-impl-datatype={root-data-prototype=laneLayer, target-data-prototype=rangeStart}, tlv-data-id=1}
      {data-prototype=Psd2_PPort.laneLayer, element-in-impl-datatype={root-data-prototype=laneLayer, target-data-prototype=rangeEnd}, tlv-data-id=2}
      {data-prototype=Psd2_PPort.laneLayer, element-in-impl-datatype={root-data-prototype=laneLayer, target-data-prototype=localId}, tlv-data-id=1}
      {data-prototype=Psd2_PPort.laneLayer, element-in-impl-datatype={root-data-prototype=laneLayer, target-data-prototype=referenceBaseIndex}, tlv-data-id=0}
      {data-prototype=Psd2_PPort.laneLayer, element-in-impl-datatype={root-data-prototype=laneLayer, target-data-prototype=inPositiveDirection}, tlv-data-id=2}
      {data-prototype=Psd2_PPort.laneLayer, element-in-impl-datatype={root-data-prototype=laneLayer, target-data-prototype=arrayMember}, tlv-data-id=0}
      {data-prototype=Psd2_PPort.laneLayer, element-in-impl-datatype={root-data-prototype=laneLayer, target-data-prototype=sourceLaneReferenceList}, tlv-data-id=0}
      {data-prototype=Psd2_PPort.laneLayer, element-in-impl-datatype={root-data-prototype=laneLayer, target-data-prototype=destinationLaneReferenceList}, tlv-data-id=1}
      {data-prototype=Psd2_PPort.laneLayer, element-in-impl-datatype={root-data-prototype=laneLayer, target-data-prototype=laneWidth}, tlv-data-id=2}
      {data-prototype=Psd2_PPort.laneLayer, element-in-impl-datatype={root-data-prototype=laneLayer, target-data-prototype=centerlineGeometry}, tlv-data-id=3}
      {data-prototype=Psd2_PPort.laneLayer, element-in-impl-datatype={root-data-prototype=laneLayer, target-data-prototype=laneConnectionType}, tlv-data-id=5}
      {data-prototype=Psd2_PPort.laneLayer, element-in-impl-datatype={root-data-prototype=laneLayer, target-data-prototype=laneConnectivityElementType}, tlv-data-id=6}
      {data-prototype=Psd2_PPort.laneLayer, element-in-impl-datatype={root-data-prototype=laneLayer, target-data-prototype=laneReference}, tlv-data-id=7}
      {data-prototype=Psd2_PPort.laneLayer, element-in-impl-datatype={root-data-prototype=laneLayer, target-data-prototype=laneGroupReference}, tlv-data-id=8}
      {data-prototype=Psd2_PPort.laneLayer, element-in-impl-datatype={root-data-prototype=laneLayer, target-data-prototype=laneIndex}, tlv-data-id=9}
      {data-prototype=Psd2_PPort.laneLayer, element-in-impl-datatype={root-data-prototype=laneLayer, target-data-prototype=attributeList}, tlv-data-id=10}
      {data-prototype=Psd2_PPort.laneLayer, element-in-impl-datatype={root-data-prototype=laneLayer, target-data-prototype=length}, tlv-data-id=11}
      {data-prototype=Psd2_PPort.laneLayer, element-in-impl-datatype={root-data-prototype=laneLayer, target-data-prototype=arrayMember}, tlv-data-id=0}
      {data-prototype=Psd2_PPort.laneLayer, element-in-impl-datatype={root-data-prototype=laneLayer, target-data-prototype=localId}, tlv-data-id=1}
      {data-prototype=Psd2_PPort.laneLayer, element-in-impl-datatype={root-data-prototype=laneLayer, target-data-prototype=referenceBaseIndex}, tlv-data-id=0}
      {data-prototype=Psd2_PPort.laneLayer, element-in-impl-datatype={root-data-prototype=laneLayer, target-data-prototype=inPositiveDirection}, tlv-data-id=2}
      {data-prototype=Psd2_PPort.laneLayer, element-in-impl-datatype={root-data-prototype=laneLayer, target-data-prototype=arrayMember}, tlv-data-id=0}
      {data-prototype=Psd2_PPort.laneLayer, element-in-impl-datatype={root-data-prototype=laneLayer, target-data-prototype=localId}, tlv-data-id=1}
      {data-prototype=Psd2_PPort.laneLayer, element-in-impl-datatype={root-data-prototype=laneLayer, target-data-prototype=referenceBaseIndex}, tlv-data-id=0}
      {data-prototype=Psd2_PPort.laneLayer, element-in-impl-datatype={root-data-prototype=laneLayer, target-data-prototype=inPositiveDirection}, tlv-data-id=2}
      {data-prototype=Psd2_PPort.laneLayer, element-in-impl-datatype={root-data-prototype=laneLayer, target-data-prototype=arrayMember}, tlv-data-id=0}
      {data-prototype=Psd2_PPort.laneLayer, element-in-impl-datatype={root-data-prototype=laneLayer, target-data-prototype=longitude}, tlv-data-id=0}
      {data-prototype=Psd2_PPort.laneLayer, element-in-impl-datatype={root-data-prototype=laneLayer, target-data-prototype=latitude}, tlv-data-id=1}
      {data-prototype=Psd2_PPort.laneLayer, element-in-impl-datatype={root-data-prototype=laneLayer, target-data-prototype=height}, tlv-data-id=2}
      {data-prototype=Psd2_PPort.laneLayer, element-in-impl-datatype={root-data-prototype=laneLayer, target-data-prototype=laneConnectionType}, tlv-data-id=0}
      {data-prototype=Psd2_PPort.laneLayer, element-in-impl-datatype={root-data-prototype=laneLayer, target-data-prototype=laneConnectivityElementType}, tlv-data-id=0}
      {data-prototype=Psd2_PPort.laneLayer, element-in-impl-datatype={root-data-prototype=laneLayer, target-data-prototype=localId}, tlv-data-id=1}
      {data-prototype=Psd2_PPort.laneLayer, element-in-impl-datatype={root-data-prototype=laneLayer, target-data-prototype=referenceBaseIndex}, tlv-data-id=0}
      {data-prototype=Psd2_PPort.laneLayer, element-in-impl-datatype={root-data-prototype=laneLayer, target-data-prototype=inPositiveDirection}, tlv-data-id=2}
      {data-prototype=Psd2_PPort.laneLayer, element-in-impl-datatype={root-data-prototype=laneLayer, target-data-prototype=localId}, tlv-data-id=1}
      {data-prototype=Psd2_PPort.laneLayer, element-in-impl-datatype={root-data-prototype=laneLayer, target-data-prototype=referenceBaseIndex}, tlv-data-id=0}
      {data-prototype=Psd2_PPort.laneLayer, element-in-impl-datatype={root-data-prototype=laneLayer, target-data-prototype=inPositiveDirection}, tlv-data-id=2}
      {data-prototype=Psd2_PPort.laneLayer, element-in-impl-datatype={root-data-prototype=laneLayer, target-data-prototype=arrayMember}, tlv-data-id=0}
      {data-prototype=Psd2_PPort.laneLayer, element-in-impl-datatype={root-data-prototype=laneLayer, target-data-prototype=confidence}, tlv-data-id=0}
      {data-prototype=Psd2_PPort.laneLayer, element-in-impl-datatype={root-data-prototype=laneLayer, target-data-prototype=attributeType}, tlv-data-id=1}
      {data-prototype=Psd2_PPort.laneLayer, element-in-impl-datatype={root-data-prototype=laneLayer, target-data-prototype=direction}, tlv-data-id=2}
      {data-prototype=Psd2_PPort.laneLayer, element-in-impl-datatype={root-data-prototype=laneLayer, target-data-prototype=attributePointList}, tlv-data-id=3}
      {data-prototype=Psd2_PPort.laneLayer, element-in-impl-datatype={root-data-prototype=laneLayer, target-data-prototype=direction}, tlv-data-id=0}
      {data-prototype=Psd2_PPort.laneLayer, element-in-impl-datatype={root-data-prototype=laneLayer, target-data-prototype=arrayMember}, tlv-data-id=0}
      {data-prototype=Psd2_PPort.laneLayer, element-in-impl-datatype={root-data-prototype=laneLayer, target-data-prototype=offset}, tlv-data-id=0}
      {data-prototype=Psd2_PPort.laneLayer, element-in-impl-datatype={root-data-prototype=laneLayer, target-data-prototype=attributeValue}, tlv-data-id=1}
      {data-prototype=Psd2_PPort.laneLayer, element-in-impl-datatype={root-data-prototype=laneLayer, target-data-prototype=laneList}, tlv-data-id=2}
      {data-prototype=Psd2_PPort.laneLayer, element-in-impl-datatype={root-data-prototype=laneLayer, target-data-prototype=intValue}, tlv-data-id=0}
      {data-prototype=Psd2_PPort.laneLayer, element-in-impl-datatype={root-data-prototype=laneLayer, target-data-prototype=floatValue}, tlv-data-id=1}
      {data-prototype=Psd2_PPort.laneLayer, element-in-impl-datatype={root-data-prototype=laneLayer, target-data-prototype=blobValue}, tlv-data-id=2}
      {data-prototype=Psd2_PPort.laneLayer, element-in-impl-datatype={root-data-prototype=laneLayer, target-data-prototype=speedLimit}, tlv-data-id=3}
      {data-prototype=Psd2_PPort.laneLayer, element-in-impl-datatype={root-data-prototype=laneLayer, target-data-prototype=overtakingProhibition}, tlv-data-id=4}
      {data-prototype=Psd2_PPort.laneLayer, element-in-impl-datatype={root-data-prototype=laneLayer, target-data-prototype=arrayMember}, tlv-data-id=0}
      {data-prototype=Psd2_PPort.laneLayer, element-in-impl-datatype={root-data-prototype=laneLayer, target-data-prototype=speedValue}, tlv-data-id=0}
      {data-prototype=Psd2_PPort.laneLayer, element-in-impl-datatype={root-data-prototype=laneLayer, target-data-prototype=source}, tlv-data-id=1}
      {data-prototype=Psd2_PPort.laneLayer, element-in-impl-datatype={root-data-prototype=laneLayer, target-data-prototype=constraintList}, tlv-data-id=2}
      {data-prototype=Psd2_PPort.laneLayer, element-in-impl-datatype={root-data-prototype=laneLayer, target-data-prototype=online}, tlv-data-id=3}
      {data-prototype=Psd2_PPort.laneLayer, element-in-impl-datatype={root-data-prototype=laneLayer, target-data-prototype=speedLimitSource}, tlv-data-id=0}
      {data-prototype=Psd2_PPort.laneLayer, element-in-impl-datatype={root-data-prototype=laneLayer, target-data-prototype=arrayMember}, tlv-data-id=0}
      {data-prototype=Psd2_PPort.laneLayer, element-in-impl-datatype={root-data-prototype=laneLayer, target-data-prototype=daysOfWeek}, tlv-data-id=0}
      {data-prototype=Psd2_PPort.laneLayer, element-in-impl-datatype={root-data-prototype=laneLayer, target-data-prototype=timeRangeOfDay}, tlv-data-id=1}
      {data-prototype=Psd2_PPort.laneLayer, element-in-impl-datatype={root-data-prototype=laneLayer, target-data-prototype=weatherConstraint}, tlv-data-id=2}
      {data-prototype=Psd2_PPort.laneLayer, element-in-impl-datatype={root-data-prototype=laneLayer, target-data-prototype=timeClassifier}, tlv-data-id=3}
      {data-prototype=Psd2_PPort.laneLayer, element-in-impl-datatype={root-data-prototype=laneLayer, target-data-prototype=zoneClassifier}, tlv-data-id=4}
      {data-prototype=Psd2_PPort.laneLayer, element-in-impl-datatype={root-data-prototype=laneLayer, target-data-prototype=applicableVehicles}, tlv-data-id=5}
      {data-prototype=Psd2_PPort.laneLayer, element-in-impl-datatype={root-data-prototype=laneLayer, target-data-prototype=turnConstraint}, tlv-data-id=6}
      {data-prototype=Psd2_PPort.laneLayer, element-in-impl-datatype={root-data-prototype=laneLayer, target-data-prototype=arrayMember}, tlv-data-id=0}
      {data-prototype=Psd2_PPort.laneLayer, element-in-impl-datatype={root-data-prototype=laneLayer, target-data-prototype=startTimeHour}, tlv-data-id=0}
      {data-prototype=Psd2_PPort.laneLayer, element-in-impl-datatype={root-data-prototype=laneLayer, target-data-prototype=startTimeMinute}, tlv-data-id=1}
      {data-prototype=Psd2_PPort.laneLayer, element-in-impl-datatype={root-data-prototype=laneLayer, target-data-prototype=endTimeHour}, tlv-data-id=2}
      {data-prototype=Psd2_PPort.laneLayer, element-in-impl-datatype={root-data-prototype=laneLayer, target-data-prototype=endTimeMinute}, tlv-data-id=3}
      {data-prototype=Psd2_PPort.laneLayer, element-in-impl-datatype={root-data-prototype=laneLayer, target-data-prototype=Weather}, tlv-data-id=0}
      {data-prototype=Psd2_PPort.laneLayer, element-in-impl-datatype={root-data-prototype=laneLayer, target-data-prototype=timeConstraintType}, tlv-data-id=0}
      {data-prototype=Psd2_PPort.laneLayer, element-in-impl-datatype={root-data-prototype=laneLayer, target-data-prototype=zoneConstraintType}, tlv-data-id=0}
      {data-prototype=Psd2_PPort.laneLayer, element-in-impl-datatype={root-data-prototype=laneLayer, target-data-prototype=applicableVehiclesType}, tlv-data-id=0}
      {data-prototype=Psd2_PPort.laneLayer, element-in-impl-datatype={root-data-prototype=laneLayer, target-data-prototype=turnConstraint}, tlv-data-id=0}
      {data-prototype=Psd2_PPort.laneLayer, element-in-impl-datatype={root-data-prototype=laneLayer, target-data-prototype=online}, tlv-data-id=0}
      {data-prototype=Psd2_PPort.laneLayer, element-in-impl-datatype={root-data-prototype=laneLayer, target-data-prototype=constraintList}, tlv-data-id=1}
      {data-prototype=Psd2_PPort.laneLayer, element-in-impl-datatype={root-data-prototype=laneLayer, target-data-prototype=type}, tlv-data-id=2}
      {data-prototype=Psd2_PPort.laneLayer, element-in-impl-datatype={root-data-prototype=laneLayer, target-data-prototype=arrayMember}, tlv-data-id=0}
      {data-prototype=Psd2_PPort.laneLayer, element-in-impl-datatype={root-data-prototype=laneLayer, target-data-prototype=daysOfWeek}, tlv-data-id=0}
      {data-prototype=Psd2_PPort.laneLayer, element-in-impl-datatype={root-data-prototype=laneLayer, target-data-prototype=timeRangeOfDay}, tlv-data-id=1}
      {data-prototype=Psd2_PPort.laneLayer, element-in-impl-datatype={root-data-prototype=laneLayer, target-data-prototype=weatherConstraint}, tlv-data-id=2}
      {data-prototype=Psd2_PPort.laneLayer, element-in-impl-datatype={root-data-prototype=laneLayer, target-data-prototype=timeClassifier}, tlv-data-id=3}
      {data-prototype=Psd2_PPort.laneLayer, element-in-impl-datatype={root-data-prototype=laneLayer, target-data-prototype=zoneClassifier}, tlv-data-id=4}
      {data-prototype=Psd2_PPort.laneLayer, element-in-impl-datatype={root-data-prototype=laneLayer, target-data-prototype=applicableVehicles}, tlv-data-id=5}
      {data-prototype=Psd2_PPort.laneLayer, element-in-impl-datatype={root-data-prototype=laneLayer, target-data-prototype=turnConstraint}, tlv-data-id=6}
      {data-prototype=Psd2_PPort.laneLayer, element-in-impl-datatype={root-data-prototype=laneLayer, target-data-prototype=arrayMember}, tlv-data-id=0}
      {data-prototype=Psd2_PPort.laneLayer, element-in-impl-datatype={root-data-prototype=laneLayer, target-data-prototype=startTimeHour}, tlv-data-id=0}
      {data-prototype=Psd2_PPort.laneLayer, element-in-impl-datatype={root-data-prototype=laneLayer, target-data-prototype=startTimeMinute}, tlv-data-id=1}
      {data-prototype=Psd2_PPort.laneLayer, element-in-impl-datatype={root-data-prototype=laneLayer, target-data-prototype=endTimeHour}, tlv-data-id=2}
      {data-prototype=Psd2_PPort.laneLayer, element-in-impl-datatype={root-data-prototype=laneLayer, target-data-prototype=endTimeMinute}, tlv-data-id=3}
      {data-prototype=Psd2_PPort.laneLayer, element-in-impl-datatype={root-data-prototype=laneLayer, target-data-prototype=Weather}, tlv-data-id=0}
      {data-prototype=Psd2_PPort.laneLayer, element-in-impl-datatype={root-data-prototype=laneLayer, target-data-prototype=timeConstraintType}, tlv-data-id=0}
      {data-prototype=Psd2_PPort.laneLayer, element-in-impl-datatype={root-data-prototype=laneLayer, target-data-prototype=zoneConstraintType}, tlv-data-id=0}
      {data-prototype=Psd2_PPort.laneLayer, element-in-impl-datatype={root-data-prototype=laneLayer, target-data-prototype=applicableVehiclesType}, tlv-data-id=0}
      {data-prototype=Psd2_PPort.laneLayer, element-in-impl-datatype={root-data-prototype=laneLayer, target-data-prototype=turnConstraint}, tlv-data-id=0}
      {data-prototype=Psd2_PPort.laneLayer, element-in-impl-datatype={root-data-prototype=laneLayer, target-data-prototype=overtakingProhibitionType}, tlv-data-id=0}
      {data-prototype=Psd2_PPort.laneLayer, element-in-impl-datatype={root-data-prototype=laneLayer, target-data-prototype=arrayMember}, tlv-data-id=0}
      {data-prototype=Psd2_PPort.laneLayer, element-in-impl-datatype={root-data-prototype=laneLayer, target-data-prototype=arrayMember}, tlv-data-id=0}
      {data-prototype=Psd2_PPort.laneLayer, element-in-impl-datatype={root-data-prototype=laneLayer, target-data-prototype=laneBoundaryParallelElementList}, tlv-data-id=1}
      {data-prototype=Psd2_PPort.laneLayer, element-in-impl-datatype={root-data-prototype=laneLayer, target-data-prototype=arrayMember}, tlv-data-id=0}
      {data-prototype=Psd2_PPort.laneLayer, element-in-impl-datatype={root-data-prototype=laneLayer, target-data-prototype=laneBoundarySequentialList}, tlv-data-id=0}
      {data-prototype=Psd2_PPort.laneLayer, element-in-impl-datatype={root-data-prototype=laneLayer, target-data-prototype=arrayMember}, tlv-data-id=0}
      {data-prototype=Psd2_PPort.laneLayer, element-in-impl-datatype={root-data-prototype=laneLayer, target-data-prototype=type}, tlv-data-id=0}
      {data-prototype=Psd2_PPort.laneLayer, element-in-impl-datatype={root-data-prototype=laneLayer, target-data-prototype=openToCurbSide}, tlv-data-id=1}
      {data-prototype=Psd2_PPort.laneLayer, element-in-impl-datatype={root-data-prototype=laneLayer, target-data-prototype=openToMiddleSide}, tlv-data-id=2}
      {data-prototype=Psd2_PPort.laneLayer, element-in-impl-datatype={root-data-prototype=laneLayer, target-data-prototype=range}, tlv-data-id=3}
      {data-prototype=Psd2_PPort.laneLayer, element-in-impl-datatype={root-data-prototype=laneLayer, target-data-prototype=boundaryGeometry}, tlv-data-id=4}
      {data-prototype=Psd2_PPort.laneLayer, element-in-impl-datatype={root-data-prototype=laneLayer, target-data-prototype=color}, tlv-data-id=6}
      {data-prototype=Psd2_PPort.laneLayer, element-in-impl-datatype={root-data-prototype=laneLayer, target-data-prototype=width}, tlv-data-id=7}
      {data-prototype=Psd2_PPort.laneLayer, element-in-impl-datatype={root-data-prototype=laneLayer, target-data-prototype=laneBoundaryType}, tlv-data-id=0}
      {data-prototype=Psd2_PPort.laneLayer, element-in-impl-datatype={root-data-prototype=laneLayer, target-data-prototype=rangeStart}, tlv-data-id=0}
      {data-prototype=Psd2_PPort.laneLayer, element-in-impl-datatype={root-data-prototype=laneLayer, target-data-prototype=rangeEnd}, tlv-data-id=1}
      {data-prototype=Psd2_PPort.laneLayer, element-in-impl-datatype={root-data-prototype=laneLayer, target-data-prototype=arrayMember}, tlv-data-id=0}
      {data-prototype=Psd2_PPort.laneLayer, element-in-impl-datatype={root-data-prototype=laneLayer, target-data-prototype=longitude}, tlv-data-id=0}
      {data-prototype=Psd2_PPort.laneLayer, element-in-impl-datatype={root-data-prototype=laneLayer, target-data-prototype=latitude}, tlv-data-id=1}
      {data-prototype=Psd2_PPort.laneLayer, element-in-impl-datatype={root-data-prototype=laneLayer, target-data-prototype=height}, tlv-data-id=2}
      {data-prototype=Psd2_PPort.laneLayer, element-in-impl-datatype={root-data-prototype=laneLayer, target-data-prototype=laneMarkingColor}, tlv-data-id=0}
      {data-prototype=Psd2_PPort.laneLayer, element-in-impl-datatype={root-data-prototype=laneLayer, target-data-prototype=arrayMember}, tlv-data-id=0}
      {data-prototype=Psd2_PPort.laneLayer, element-in-impl-datatype={root-data-prototype=laneLayer, target-data-prototype=laneGroupAssociationType}, tlv-data-id=0}
      {data-prototype=Psd2_PPort.laneLayer, element-in-impl-datatype={root-data-prototype=laneLayer, target-data-prototype=laneGroupReferenceList}, tlv-data-id=1}
      {data-prototype=Psd2_PPort.laneLayer, element-in-impl-datatype={root-data-prototype=laneLayer, target-data-prototype=laneGroupAssociationType}, tlv-data-id=0}
      {data-prototype=Psd2_PPort.laneLayer, element-in-impl-datatype={root-data-prototype=laneLayer, target-data-prototype=arrayMember}, tlv-data-id=0}
      {data-prototype=Psd2_PPort.laneLayer, element-in-impl-datatype={root-data-prototype=laneLayer, target-data-prototype=localId}, tlv-data-id=1}
      {data-prototype=Psd2_PPort.laneLayer, element-in-impl-datatype={root-data-prototype=laneLayer, target-data-prototype=referenceBaseIndex}, tlv-data-id=0}
      {data-prototype=Psd2_PPort.laneLayer, element-in-impl-datatype={root-data-prototype=laneLayer, target-data-prototype=inPositiveDirection}, tlv-data-id=2}
      {data-prototype=Psd2_PPort.laneLayer, element-in-impl-datatype={root-data-prototype=laneLayer, target-data-prototype=referenceBaseList}, tlv-data-id=0}
      {data-prototype=Psd2_PPort.laneLayer, element-in-impl-datatype={root-data-prototype=laneLayer, target-data-prototype=metaDataList}, tlv-data-id=1}
      {data-prototype=Psd2_PPort.laneLayer, element-in-impl-datatype={root-data-prototype=laneLayer, target-data-prototype=arrayMember}, tlv-data-id=0}
      {data-prototype=Psd2_PPort.laneLayer, element-in-impl-datatype={root-data-prototype=laneLayer, target-data-prototype=productId}, tlv-data-id=0}
      {data-prototype=Psd2_PPort.laneLayer, element-in-impl-datatype={root-data-prototype=laneLayer, target-data-prototype=updateRegion}, tlv-data-id=1}
      {data-prototype=Psd2_PPort.laneLayer, element-in-impl-datatype={root-data-prototype=laneLayer, target-data-prototype=tileId}, tlv-data-id=2}
      {data-prototype=Psd2_PPort.laneLayer, element-in-impl-datatype={root-data-prototype=laneLayer, target-data-prototype=arrayMember}, tlv-data-id=0}
      {data-prototype=Psd2_PPort.laneLayer, element-in-impl-datatype={root-data-prototype=laneLayer, target-data-prototype=countryCode}, tlv-data-id=0}
      {data-prototype=Psd2_PPort.laneLayer, element-in-impl-datatype={root-data-prototype=laneLayer, target-data-prototype=regionCode}, tlv-data-id=1}
      {data-prototype=Psd2_PPort.laneLayer, element-in-impl-datatype={root-data-prototype=laneLayer, target-data-prototype=mapAge}, tlv-data-id=2}
      {data-prototype=Psd2_PPort.laneLayer, element-in-impl-datatype={root-data-prototype=laneLayer, target-data-prototype=qualityIndicators}, tlv-data-id=3}
      {data-prototype=Psd2_PPort.laneLayer, element-in-impl-datatype={root-data-prototype=laneLayer, target-data-prototype=trafficDirection}, tlv-data-id=4}
      {data-prototype=Psd2_PPort.laneLayer, element-in-impl-datatype={root-data-prototype=laneLayer, target-data-prototype=generalSpeedLimits}, tlv-data-id=5}
      {data-prototype=Psd2_PPort.laneLayer, element-in-impl-datatype={root-data-prototype=laneLayer, target-data-prototype=speedUnit}, tlv-data-id=6}
      {data-prototype=Psd2_PPort.laneLayer, element-in-impl-datatype={root-data-prototype=laneLayer, target-data-prototype=month}, tlv-data-id=0}
      {data-prototype=Psd2_PPort.laneLayer, element-in-impl-datatype={root-data-prototype=laneLayer, target-data-prototype=year}, tlv-data-id=1}
      {data-prototype=Psd2_PPort.laneLayer, element-in-impl-datatype={root-data-prototype=laneLayer, target-data-prototype=arrayMember}, tlv-data-id=0}
      {data-prototype=Psd2_PPort.laneLayer, element-in-impl-datatype={root-data-prototype=laneLayer, target-data-prototype=type}, tlv-data-id=0}
      {data-prototype=Psd2_PPort.laneLayer, element-in-impl-datatype={root-data-prototype=laneLayer, target-data-prototype=quality}, tlv-data-id=1}
      {data-prototype=Psd2_PPort.laneLayer, element-in-impl-datatype={root-data-prototype=laneLayer, target-data-prototype=qualityIndicatorType}, tlv-data-id=0}
      {data-prototype=Psd2_PPort.laneLayer, element-in-impl-datatype={root-data-prototype=laneLayer, target-data-prototype=trafficDirection}, tlv-data-id=0}
      {data-prototype=Psd2_PPort.laneLayer, element-in-impl-datatype={root-data-prototype=laneLayer, target-data-prototype=arrayMember}, tlv-data-id=0}
      {data-prototype=Psd2_PPort.laneLayer, element-in-impl-datatype={root-data-prototype=laneLayer, target-data-prototype=type}, tlv-data-id=0}
      {data-prototype=Psd2_PPort.laneLayer, element-in-impl-datatype={root-data-prototype=laneLayer, target-data-prototype=speedValue}, tlv-data-id=1}
      {data-prototype=Psd2_PPort.laneLayer, element-in-impl-datatype={root-data-prototype=laneLayer, target-data-prototype=constraint}, tlv-data-id=3}
      {data-prototype=Psd2_PPort.laneLayer, element-in-impl-datatype={root-data-prototype=laneLayer, target-data-prototype=generalSpeedLimitType}, tlv-data-id=0}
      {data-prototype=Psd2_PPort.laneLayer, element-in-impl-datatype={root-data-prototype=laneLayer, target-data-prototype=arrayMember}, tlv-data-id=0}
      {data-prototype=Psd2_PPort.laneLayer, element-in-impl-datatype={root-data-prototype=laneLayer, target-data-prototype=daysOfWeek}, tlv-data-id=0}
      {data-prototype=Psd2_PPort.laneLayer, element-in-impl-datatype={root-data-prototype=laneLayer, target-data-prototype=timeRangeOfDay}, tlv-data-id=1}
      {data-prototype=Psd2_PPort.laneLayer, element-in-impl-datatype={root-data-prototype=laneLayer, target-data-prototype=weatherConstraint}, tlv-data-id=2}
      {data-prototype=Psd2_PPort.laneLayer, element-in-impl-datatype={root-data-prototype=laneLayer, target-data-prototype=timeClassifier}, tlv-data-id=3}
      {data-prototype=Psd2_PPort.laneLayer, element-in-impl-datatype={root-data-prototype=laneLayer, target-data-prototype=zoneClassifier}, tlv-data-id=4}
      {data-prototype=Psd2_PPort.laneLayer, element-in-impl-datatype={root-data-prototype=laneLayer, target-data-prototype=applicableVehicles}, tlv-data-id=5}
      {data-prototype=Psd2_PPort.laneLayer, element-in-impl-datatype={root-data-prototype=laneLayer, target-data-prototype=turnConstraint}, tlv-data-id=6}
      {data-prototype=Psd2_PPort.laneLayer, element-in-impl-datatype={root-data-prototype=laneLayer, target-data-prototype=arrayMember}, tlv-data-id=0}
      {data-prototype=Psd2_PPort.laneLayer, element-in-impl-datatype={root-data-prototype=laneLayer, target-data-prototype=startTimeHour}, tlv-data-id=0}
      {data-prototype=Psd2_PPort.laneLayer, element-in-impl-datatype={root-data-prototype=laneLayer, target-data-prototype=startTimeMinute}, tlv-data-id=1}
      {data-prototype=Psd2_PPort.laneLayer, element-in-impl-datatype={root-data-prototype=laneLayer, target-data-prototype=endTimeHour}, tlv-data-id=2}
      {data-prototype=Psd2_PPort.laneLayer, element-in-impl-datatype={root-data-prototype=laneLayer, target-data-prototype=endTimeMinute}, tlv-data-id=3}
      {data-prototype=Psd2_PPort.laneLayer, element-in-impl-datatype={root-data-prototype=laneLayer, target-data-prototype=Weather}, tlv-data-id=0}
      {data-prototype=Psd2_PPort.laneLayer, element-in-impl-datatype={root-data-prototype=laneLayer, target-data-prototype=timeConstraintType}, tlv-data-id=0}
      {data-prototype=Psd2_PPort.laneLayer, element-in-impl-datatype={root-data-prototype=laneLayer, target-data-prototype=zoneConstraintType}, tlv-data-id=0}
      {data-prototype=Psd2_PPort.laneLayer, element-in-impl-datatype={root-data-prototype=laneLayer, target-data-prototype=applicableVehiclesType}, tlv-data-id=0}
      {data-prototype=Psd2_PPort.laneLayer, element-in-impl-datatype={root-data-prototype=laneLayer, target-data-prototype=turnConstraint}, tlv-data-id=0}
      {data-prototype=Psd2_PPort.laneLayer, element-in-impl-datatype={root-data-prototype=laneLayer, target-data-prototype=speedUnit}, tlv-data-id=0}
      {data-prototype=Psd2_PPort.positioningObjectsLayer, element-in-impl-datatype={root-data-prototype=positioningObjectsLayer, target-data-prototype=id}, tlv-data-id=0}
      {data-prototype=Psd2_PPort.positioningObjectsLayer, element-in-impl-datatype={root-data-prototype=positioningObjectsLayer, target-data-prototype=positioningObjectsLayer}, tlv-data-id=1}
      {data-prototype=Psd2_PPort.positioningObjectsLayer, element-in-impl-datatype={root-data-prototype=positioningObjectsLayer, target-data-prototype=layerInfo}, tlv-data-id=2}
      {data-prototype=Psd2_PPort.positioningObjectsLayer, element-in-impl-datatype={root-data-prototype=positioningObjectsLayer, target-data-prototype=confidenceLevel}, tlv-data-id=0}
      {data-prototype=Psd2_PPort.positioningObjectsLayer, element-in-impl-datatype={root-data-prototype=positioningObjectsLayer, target-data-prototype=detailedObjectList}, tlv-data-id=2}
      {data-prototype=Psd2_PPort.positioningObjectsLayer, element-in-impl-datatype={root-data-prototype=positioningObjectsLayer, target-data-prototype=position}, tlv-data-id=3}
      {data-prototype=Psd2_PPort.positioningObjectsLayer, element-in-impl-datatype={root-data-prototype=positioningObjectsLayer, target-data-prototype=arrayMember}, tlv-data-id=0}
      {data-prototype=Psd2_PPort.positioningObjectsLayer, element-in-impl-datatype={root-data-prototype=positioningObjectsLayer, target-data-prototype=objectType}, tlv-data-id=0}
      {data-prototype=Psd2_PPort.positioningObjectsLayer, element-in-impl-datatype={root-data-prototype=positioningObjectsLayer, target-data-prototype=sign}, tlv-data-id=1}
      {data-prototype=Psd2_PPort.positioningObjectsLayer, element-in-impl-datatype={root-data-prototype=positioningObjectsLayer, target-data-prototype=pole}, tlv-data-id=2}
      {data-prototype=Psd2_PPort.positioningObjectsLayer, element-in-impl-datatype={root-data-prototype=positioningObjectsLayer, target-data-prototype=marking}, tlv-data-id=3}
      {data-prototype=Psd2_PPort.positioningObjectsLayer, element-in-impl-datatype={root-data-prototype=positioningObjectsLayer, target-data-prototype=covariance}, tlv-data-id=4}
      {data-prototype=Psd2_PPort.positioningObjectsLayer, element-in-impl-datatype={root-data-prototype=positioningObjectsLayer, target-data-prototype=marker}, tlv-data-id=5}
      {data-prototype=Psd2_PPort.positioningObjectsLayer, element-in-impl-datatype={root-data-prototype=positioningObjectsLayer, target-data-prototype=landmarkObjectType}, tlv-data-id=0}
      {data-prototype=Psd2_PPort.positioningObjectsLayer, element-in-impl-datatype={root-data-prototype=positioningObjectsLayer, target-data-prototype=signShape}, tlv-data-id=0}
      {data-prototype=Psd2_PPort.positioningObjectsLayer, element-in-impl-datatype={root-data-prototype=positioningObjectsLayer, target-data-prototype=signMeaning}, tlv-data-id=1}
      {data-prototype=Psd2_PPort.positioningObjectsLayer, element-in-impl-datatype={root-data-prototype=positioningObjectsLayer, target-data-prototype=diameter}, tlv-data-id=2}
      {data-prototype=Psd2_PPort.positioningObjectsLayer, element-in-impl-datatype={root-data-prototype=positioningObjectsLayer, target-data-prototype=boundingBox}, tlv-data-id=3}
      {data-prototype=Psd2_PPort.positioningObjectsLayer, element-in-impl-datatype={root-data-prototype=positioningObjectsLayer, target-data-prototype=landmarkObjectSignShape}, tlv-data-id=0}
      {data-prototype=Psd2_PPort.positioningObjectsLayer, element-in-impl-datatype={root-data-prototype=positioningObjectsLayer, target-data-prototype=warningSign}, tlv-data-id=0}
      {data-prototype=Psd2_PPort.positioningObjectsLayer, element-in-impl-datatype={root-data-prototype=positioningObjectsLayer, target-data-prototype=arrayMember}, tlv-data-id=0}
      {data-prototype=Psd2_PPort.positioningObjectsLayer, element-in-impl-datatype={root-data-prototype=positioningObjectsLayer, target-data-prototype=longitude}, tlv-data-id=0}
      {data-prototype=Psd2_PPort.positioningObjectsLayer, element-in-impl-datatype={root-data-prototype=positioningObjectsLayer, target-data-prototype=latitude}, tlv-data-id=1}
      {data-prototype=Psd2_PPort.positioningObjectsLayer, element-in-impl-datatype={root-data-prototype=positioningObjectsLayer, target-data-prototype=height}, tlv-data-id=2}
      {data-prototype=Psd2_PPort.positioningObjectsLayer, element-in-impl-datatype={root-data-prototype=positioningObjectsLayer, target-data-prototype=polePositionGround}, tlv-data-id=0}
      {data-prototype=Psd2_PPort.positioningObjectsLayer, element-in-impl-datatype={root-data-prototype=positioningObjectsLayer, target-data-prototype=polePositionTop}, tlv-data-id=1}
      {data-prototype=Psd2_PPort.positioningObjectsLayer, element-in-impl-datatype={root-data-prototype=positioningObjectsLayer, target-data-prototype=diameter}, tlv-data-id=2}
      {data-prototype=Psd2_PPort.positioningObjectsLayer, element-in-impl-datatype={root-data-prototype=positioningObjectsLayer, target-data-prototype=diameterTop}, tlv-data-id=3}
      {data-prototype=Psd2_PPort.positioningObjectsLayer, element-in-impl-datatype={root-data-prototype=positioningObjectsLayer, target-data-prototype=height}, tlv-data-id=4}
      {data-prototype=Psd2_PPort.positioningObjectsLayer, element-in-impl-datatype={root-data-prototype=positioningObjectsLayer, target-data-prototype=poleType}, tlv-data-id=5}
      {data-prototype=Psd2_PPort.positioningObjectsLayer, element-in-impl-datatype={root-data-prototype=positioningObjectsLayer, target-data-prototype=longitude}, tlv-data-id=0}
      {data-prototype=Psd2_PPort.positioningObjectsLayer, element-in-impl-datatype={root-data-prototype=positioningObjectsLayer, target-data-prototype=latitude}, tlv-data-id=1}
      {data-prototype=Psd2_PPort.positioningObjectsLayer, element-in-impl-datatype={root-data-prototype=positioningObjectsLayer, target-data-prototype=height}, tlv-data-id=2}
      {data-prototype=Psd2_PPort.positioningObjectsLayer, element-in-impl-datatype={root-data-prototype=positioningObjectsLayer, target-data-prototype=longitude}, tlv-data-id=0}
      {data-prototype=Psd2_PPort.positioningObjectsLayer, element-in-impl-datatype={root-data-prototype=positioningObjectsLayer, target-data-prototype=latitude}, tlv-data-id=1}
      {data-prototype=Psd2_PPort.positioningObjectsLayer, element-in-impl-datatype={root-data-prototype=positioningObjectsLayer, target-data-prototype=height}, tlv-data-id=2}
      {data-prototype=Psd2_PPort.positioningObjectsLayer, element-in-impl-datatype={root-data-prototype=positioningObjectsLayer, target-data-prototype=landmarkObjectPoleType}, tlv-data-id=0}
      {data-prototype=Psd2_PPort.positioningObjectsLayer, element-in-impl-datatype={root-data-prototype=positioningObjectsLayer, target-data-prototype=markingType}, tlv-data-id=0}
      {data-prototype=Psd2_PPort.positioningObjectsLayer, element-in-impl-datatype={root-data-prototype=positioningObjectsLayer, target-data-prototype=colorType}, tlv-data-id=1}
      {data-prototype=Psd2_PPort.positioningObjectsLayer, element-in-impl-datatype={root-data-prototype=positioningObjectsLayer, target-data-prototype=boundingBox}, tlv-data-id=2}
      {data-prototype=Psd2_PPort.positioningObjectsLayer, element-in-impl-datatype={root-data-prototype=positioningObjectsLayer, target-data-prototype=line}, tlv-data-id=3}
      {data-prototype=Psd2_PPort.positioningObjectsLayer, element-in-impl-datatype={root-data-prototype=positioningObjectsLayer, target-data-prototype=landmarkObjectMarkingType}, tlv-data-id=0}
      {data-prototype=Psd2_PPort.positioningObjectsLayer, element-in-impl-datatype={root-data-prototype=positioningObjectsLayer, target-data-prototype=laneMarkingColor}, tlv-data-id=0}
      {data-prototype=Psd2_PPort.positioningObjectsLayer, element-in-impl-datatype={root-data-prototype=positioningObjectsLayer, target-data-prototype=arrayMember}, tlv-data-id=0}
      {data-prototype=Psd2_PPort.positioningObjectsLayer, element-in-impl-datatype={root-data-prototype=positioningObjectsLayer, target-data-prototype=longitude}, tlv-data-id=0}
      {data-prototype=Psd2_PPort.positioningObjectsLayer, element-in-impl-datatype={root-data-prototype=positioningObjectsLayer, target-data-prototype=latitude}, tlv-data-id=1}
      {data-prototype=Psd2_PPort.positioningObjectsLayer, element-in-impl-datatype={root-data-prototype=positioningObjectsLayer, target-data-prototype=height}, tlv-data-id=2}
      {data-prototype=Psd2_PPort.positioningObjectsLayer, element-in-impl-datatype={root-data-prototype=positioningObjectsLayer, target-data-prototype=arrayMember}, tlv-data-id=0}
      {data-prototype=Psd2_PPort.positioningObjectsLayer, element-in-impl-datatype={root-data-prototype=positioningObjectsLayer, target-data-prototype=longitude}, tlv-data-id=0}
      {data-prototype=Psd2_PPort.positioningObjectsLayer, element-in-impl-datatype={root-data-prototype=positioningObjectsLayer, target-data-prototype=latitude}, tlv-data-id=1}
      {data-prototype=Psd2_PPort.positioningObjectsLayer, element-in-impl-datatype={root-data-prototype=positioningObjectsLayer, target-data-prototype=height}, tlv-data-id=2}
      {data-prototype=Psd2_PPort.positioningObjectsLayer, element-in-impl-datatype={root-data-prototype=positioningObjectsLayer, target-data-prototype=varianceXX}, tlv-data-id=0}
      {data-prototype=Psd2_PPort.positioningObjectsLayer, element-in-impl-datatype={root-data-prototype=positioningObjectsLayer, target-data-prototype=varianceYY}, tlv-data-id=1}
      {data-prototype=Psd2_PPort.positioningObjectsLayer, element-in-impl-datatype={root-data-prototype=positioningObjectsLayer, target-data-prototype=varianceZZ}, tlv-data-id=2}
      {data-prototype=Psd2_PPort.positioningObjectsLayer, element-in-impl-datatype={root-data-prototype=positioningObjectsLayer, target-data-prototype=covarianceXY}, tlv-data-id=3}
      {data-prototype=Psd2_PPort.positioningObjectsLayer, element-in-impl-datatype={root-data-prototype=positioningObjectsLayer, target-data-prototype=applicableVehiclesType}, tlv-data-id=0}
      {data-prototype=Psd2_PPort.positioningObjectsLayer, element-in-impl-datatype={root-data-prototype=positioningObjectsLayer, target-data-prototype=longitude}, tlv-data-id=0}
      {data-prototype=Psd2_PPort.positioningObjectsLayer, element-in-impl-datatype={root-data-prototype=positioningObjectsLayer, target-data-prototype=latitude}, tlv-data-id=1}
      {data-prototype=Psd2_PPort.positioningObjectsLayer, element-in-impl-datatype={root-data-prototype=positioningObjectsLayer, target-data-prototype=height}, tlv-data-id=2}
      {data-prototype=Psd2_PPort.positioningObjectsLayer, element-in-impl-datatype={root-data-prototype=positioningObjectsLayer, target-data-prototype=referenceBaseList}, tlv-data-id=0}
      {data-prototype=Psd2_PPort.positioningObjectsLayer, element-in-impl-datatype={root-data-prototype=positioningObjectsLayer, target-data-prototype=metaDataList}, tlv-data-id=1}
      {data-prototype=Psd2_PPort.positioningObjectsLayer, element-in-impl-datatype={root-data-prototype=positioningObjectsLayer, target-data-prototype=arrayMember}, tlv-data-id=0}
      {data-prototype=Psd2_PPort.positioningObjectsLayer, element-in-impl-datatype={root-data-prototype=positioningObjectsLayer, target-data-prototype=productId}, tlv-data-id=0}
      {data-prototype=Psd2_PPort.positioningObjectsLayer, element-in-impl-datatype={root-data-prototype=positioningObjectsLayer, target-data-prototype=updateRegion}, tlv-data-id=1}
      {data-prototype=Psd2_PPort.positioningObjectsLayer, element-in-impl-datatype={root-data-prototype=positioningObjectsLayer, target-data-prototype=tileId}, tlv-data-id=2}
      {data-prototype=Psd2_PPort.positioningObjectsLayer, element-in-impl-datatype={root-data-prototype=positioningObjectsLayer, target-data-prototype=arrayMember}, tlv-data-id=0}
      {data-prototype=Psd2_PPort.positioningObjectsLayer, element-in-impl-datatype={root-data-prototype=positioningObjectsLayer, target-data-prototype=countryCode}, tlv-data-id=0}
      {data-prototype=Psd2_PPort.positioningObjectsLayer, element-in-impl-datatype={root-data-prototype=positioningObjectsLayer, target-data-prototype=regionCode}, tlv-data-id=1}
      {data-prototype=Psd2_PPort.positioningObjectsLayer, element-in-impl-datatype={root-data-prototype=positioningObjectsLayer, target-data-prototype=mapAge}, tlv-data-id=2}
      {data-prototype=Psd2_PPort.positioningObjectsLayer, element-in-impl-datatype={root-data-prototype=positioningObjectsLayer, target-data-prototype=qualityIndicators}, tlv-data-id=3}
      {data-prototype=Psd2_PPort.positioningObjectsLayer, element-in-impl-datatype={root-data-prototype=positioningObjectsLayer, target-data-prototype=trafficDirection}, tlv-data-id=4}
      {data-prototype=Psd2_PPort.positioningObjectsLayer, element-in-impl-datatype={root-data-prototype=positioningObjectsLayer, target-data-prototype=generalSpeedLimits}, tlv-data-id=5}
      {data-prototype=Psd2_PPort.positioningObjectsLayer, element-in-impl-datatype={root-data-prototype=positioningObjectsLayer, target-data-prototype=speedUnit}, tlv-data-id=6}
      {data-prototype=Psd2_PPort.positioningObjectsLayer, element-in-impl-datatype={root-data-prototype=positioningObjectsLayer, target-data-prototype=month}, tlv-data-id=0}
      {data-prototype=Psd2_PPort.positioningObjectsLayer, element-in-impl-datatype={root-data-prototype=positioningObjectsLayer, target-data-prototype=year}, tlv-data-id=1}
      {data-prototype=Psd2_PPort.positioningObjectsLayer, element-in-impl-datatype={root-data-prototype=positioningObjectsLayer, target-data-prototype=arrayMember}, tlv-data-id=0}
      {data-prototype=Psd2_PPort.positioningObjectsLayer, element-in-impl-datatype={root-data-prototype=positioningObjectsLayer, target-data-prototype=type}, tlv-data-id=0}
      {data-prototype=Psd2_PPort.positioningObjectsLayer, element-in-impl-datatype={root-data-prototype=positioningObjectsLayer, target-data-prototype=quality}, tlv-data-id=1}
      {data-prototype=Psd2_PPort.positioningObjectsLayer, element-in-impl-datatype={root-data-prototype=positioningObjectsLayer, target-data-prototype=qualityIndicatorType}, tlv-data-id=0}
      {data-prototype=Psd2_PPort.positioningObjectsLayer, element-in-impl-datatype={root-data-prototype=positioningObjectsLayer, target-data-prototype=trafficDirection}, tlv-data-id=0}
      {data-prototype=Psd2_PPort.positioningObjectsLayer, element-in-impl-datatype={root-data-prototype=positioningObjectsLayer, target-data-prototype=arrayMember}, tlv-data-id=0}
      {data-prototype=Psd2_PPort.positioningObjectsLayer, element-in-impl-datatype={root-data-prototype=positioningObjectsLayer, target-data-prototype=type}, tlv-data-id=0}
      {data-prototype=Psd2_PPort.positioningObjectsLayer, element-in-impl-datatype={root-data-prototype=positioningObjectsLayer, target-data-prototype=speedValue}, tlv-data-id=1}
      {data-prototype=Psd2_PPort.positioningObjectsLayer, element-in-impl-datatype={root-data-prototype=positioningObjectsLayer, target-data-prototype=constraint}, tlv-data-id=3}
      {data-prototype=Psd2_PPort.positioningObjectsLayer, element-in-impl-datatype={root-data-prototype=positioningObjectsLayer, target-data-prototype=generalSpeedLimitType}, tlv-data-id=0}
      {data-prototype=Psd2_PPort.positioningObjectsLayer, element-in-impl-datatype={root-data-prototype=positioningObjectsLayer, target-data-prototype=arrayMember}, tlv-data-id=0}
      {data-prototype=Psd2_PPort.positioningObjectsLayer, element-in-impl-datatype={root-data-prototype=positioningObjectsLayer, target-data-prototype=daysOfWeek}, tlv-data-id=0}
      {data-prototype=Psd2_PPort.positioningObjectsLayer, element-in-impl-datatype={root-data-prototype=positioningObjectsLayer, target-data-prototype=timeRangeOfDay}, tlv-data-id=1}
      {data-prototype=Psd2_PPort.positioningObjectsLayer, element-in-impl-datatype={root-data-prototype=positioningObjectsLayer, target-data-prototype=weatherConstraint}, tlv-data-id=2}
      {data-prototype=Psd2_PPort.positioningObjectsLayer, element-in-impl-datatype={root-data-prototype=positioningObjectsLayer, target-data-prototype=timeClassifier}, tlv-data-id=3}
      {data-prototype=Psd2_PPort.positioningObjectsLayer, element-in-impl-datatype={root-data-prototype=positioningObjectsLayer, target-data-prototype=zoneClassifier}, tlv-data-id=4}
      {data-prototype=Psd2_PPort.positioningObjectsLayer, element-in-impl-datatype={root-data-prototype=positioningObjectsLayer, target-data-prototype=applicableVehicles}, tlv-data-id=5}
      {data-prototype=Psd2_PPort.positioningObjectsLayer, element-in-impl-datatype={root-data-prototype=positioningObjectsLayer, target-data-prototype=turnConstraint}, tlv-data-id=6}
      {data-prototype=Psd2_PPort.positioningObjectsLayer, element-in-impl-datatype={root-data-prototype=positioningObjectsLayer, target-data-prototype=arrayMember}, tlv-data-id=0}
      {data-prototype=Psd2_PPort.positioningObjectsLayer, element-in-impl-datatype={root-data-prototype=positioningObjectsLayer, target-data-prototype=startTimeHour}, tlv-data-id=0}
      {data-prototype=Psd2_PPort.positioningObjectsLayer, element-in-impl-datatype={root-data-prototype=positioningObjectsLayer, target-data-prototype=startTimeMinute}, tlv-data-id=1}
      {data-prototype=Psd2_PPort.positioningObjectsLayer, element-in-impl-datatype={root-data-prototype=positioningObjectsLayer, target-data-prototype=endTimeHour}, tlv-data-id=2}
      {data-prototype=Psd2_PPort.positioningObjectsLayer, element-in-impl-datatype={root-data-prototype=positioningObjectsLayer, target-data-prototype=endTimeMinute}, tlv-data-id=3}
      {data-prototype=Psd2_PPort.positioningObjectsLayer, element-in-impl-datatype={root-data-prototype=positioningObjectsLayer, target-data-prototype=Weather}, tlv-data-id=0}
      {data-prototype=Psd2_PPort.positioningObjectsLayer, element-in-impl-datatype={root-data-prototype=positioningObjectsLayer, target-data-prototype=timeConstraintType}, tlv-data-id=0}
      {data-prototype=Psd2_PPort.positioningObjectsLayer, element-in-impl-datatype={root-data-prototype=positioningObjectsLayer, target-data-prototype=zoneConstraintType}, tlv-data-id=0}
      {data-prototype=Psd2_PPort.positioningObjectsLayer, element-in-impl-datatype={root-data-prototype=positioningObjectsLayer, target-data-prototype=applicableVehiclesType}, tlv-data-id=0}
      {data-prototype=Psd2_PPort.positioningObjectsLayer, element-in-impl-datatype={root-data-prototype=positioningObjectsLayer, target-data-prototype=turnConstraint}, tlv-data-id=0}
      {data-prototype=Psd2_PPort.positioningObjectsLayer, element-in-impl-datatype={root-data-prototype=positioningObjectsLayer, target-data-prototype=speedUnit}, tlv-data-id=0}
      {data-prototype=Psd2_PPort.egoPositionLayer, element-in-impl-datatype={root-data-prototype=egoPositionLayer, target-data-prototype=id}, tlv-data-id=0}
      {data-prototype=Psd2_PPort.egoPositionLayer, element-in-impl-datatype={root-data-prototype=egoPositionLayer, target-data-prototype=egoPositionLayer}, tlv-data-id=1}
      {data-prototype=Psd2_PPort.egoPositionLayer, element-in-impl-datatype={root-data-prototype=egoPositionLayer, target-data-prototype=layerInfo}, tlv-data-id=2}
      {data-prototype=Psd2_PPort.egoPositionLayer, element-in-impl-datatype={root-data-prototype=egoPositionLayer, target-data-prototype=egoPosition}, tlv-data-id=0}
      {data-prototype=Psd2_PPort.egoPositionLayer, element-in-impl-datatype={root-data-prototype=egoPositionLayer, target-data-prototype=routeGuidanceActive}, tlv-data-id=1}
      {data-prototype=Psd2_PPort.egoPositionLayer, element-in-impl-datatype={root-data-prototype=egoPositionLayer, target-data-prototype=routeGuidanceChanged}, tlv-data-id=2}
      {data-prototype=Psd2_PPort.egoPositionLayer, element-in-impl-datatype={root-data-prototype=egoPositionLayer, target-data-prototype=pathList}, tlv-data-id=3}
      {data-prototype=Psd2_PPort.egoPositionLayer, element-in-impl-datatype={root-data-prototype=egoPositionLayer, target-data-prototype=routeLength}, tlv-data-id=4}
      {data-prototype=Psd2_PPort.egoPositionLayer, element-in-impl-datatype={root-data-prototype=egoPositionLayer, target-data-prototype=linkPose}, tlv-data-id=0}
      {data-prototype=Psd2_PPort.egoPositionLayer, element-in-impl-datatype={root-data-prototype=egoPositionLayer, target-data-prototype=lanePose}, tlv-data-id=2}
      {data-prototype=Psd2_PPort.egoPositionLayer, element-in-impl-datatype={root-data-prototype=egoPositionLayer, target-data-prototype=rawPose}, tlv-data-id=3}
      {data-prototype=Psd2_PPort.egoPositionLayer, element-in-impl-datatype={root-data-prototype=egoPositionLayer, target-data-prototype=timeStamp}, tlv-data-id=5}
      {data-prototype=Psd2_PPort.egoPositionLayer, element-in-impl-datatype={root-data-prototype=egoPositionLayer, target-data-prototype=speed}, tlv-data-id=6}
      {data-prototype=Psd2_PPort.egoPositionLayer, element-in-impl-datatype={root-data-prototype=egoPositionLayer, target-data-prototype=pose}, tlv-data-id=0}
      {data-prototype=Psd2_PPort.egoPositionLayer, element-in-impl-datatype={root-data-prototype=egoPositionLayer, target-data-prototype=linkRelativeCoordinate}, tlv-data-id=1}
      {data-prototype=Psd2_PPort.egoPositionLayer, element-in-impl-datatype={root-data-prototype=egoPositionLayer, target-data-prototype=mapMatchingAccuracy}, tlv-data-id=2}
      {data-prototype=Psd2_PPort.egoPositionLayer, element-in-impl-datatype={root-data-prototype=egoPositionLayer, target-data-prototype=coordinate}, tlv-data-id=0}
      {data-prototype=Psd2_PPort.egoPositionLayer, element-in-impl-datatype={root-data-prototype=egoPositionLayer, target-data-prototype=heading}, tlv-data-id=1}
      {data-prototype=Psd2_PPort.egoPositionLayer, element-in-impl-datatype={root-data-prototype=egoPositionLayer, target-data-prototype=longitude}, tlv-data-id=0}
      {data-prototype=Psd2_PPort.egoPositionLayer, element-in-impl-datatype={root-data-prototype=egoPositionLayer, target-data-prototype=latitude}, tlv-data-id=1}
      {data-prototype=Psd2_PPort.egoPositionLayer, element-in-impl-datatype={root-data-prototype=egoPositionLayer, target-data-prototype=height}, tlv-data-id=2}
      {data-prototype=Psd2_PPort.egoPositionLayer, element-in-impl-datatype={root-data-prototype=egoPositionLayer, target-data-prototype=reference}, tlv-data-id=0}
      {data-prototype=Psd2_PPort.egoPositionLayer, element-in-impl-datatype={root-data-prototype=egoPositionLayer, target-data-prototype=offset}, tlv-data-id=1}
      {data-prototype=Psd2_PPort.egoPositionLayer, element-in-impl-datatype={root-data-prototype=egoPositionLayer, target-data-prototype=localId}, tlv-data-id=1}
      {data-prototype=Psd2_PPort.egoPositionLayer, element-in-impl-datatype={root-data-prototype=egoPositionLayer, target-data-prototype=referenceBaseIndex}, tlv-data-id=0}
      {data-prototype=Psd2_PPort.egoPositionLayer, element-in-impl-datatype={root-data-prototype=egoPositionLayer, target-data-prototype=inPositiveDirection}, tlv-data-id=2}
      {data-prototype=Psd2_PPort.egoPositionLayer, element-in-impl-datatype={root-data-prototype=egoPositionLayer, target-data-prototype=pose}, tlv-data-id=0}
      {data-prototype=Psd2_PPort.egoPositionLayer, element-in-impl-datatype={root-data-prototype=egoPositionLayer, target-data-prototype=laneRelativeCoordinate}, tlv-data-id=1}
      {data-prototype=Psd2_PPort.egoPositionLayer, element-in-impl-datatype={root-data-prototype=egoPositionLayer, target-data-prototype=mapMatchingAccuracy}, tlv-data-id=2}
      {data-prototype=Psd2_PPort.egoPositionLayer, element-in-impl-datatype={root-data-prototype=egoPositionLayer, target-data-prototype=coordinate}, tlv-data-id=0}
      {data-prototype=Psd2_PPort.egoPositionLayer, element-in-impl-datatype={root-data-prototype=egoPositionLayer, target-data-prototype=heading}, tlv-data-id=1}
      {data-prototype=Psd2_PPort.egoPositionLayer, element-in-impl-datatype={root-data-prototype=egoPositionLayer, target-data-prototype=longitude}, tlv-data-id=0}
      {data-prototype=Psd2_PPort.egoPositionLayer, element-in-impl-datatype={root-data-prototype=egoPositionLayer, target-data-prototype=latitude}, tlv-data-id=1}
      {data-prototype=Psd2_PPort.egoPositionLayer, element-in-impl-datatype={root-data-prototype=egoPositionLayer, target-data-prototype=height}, tlv-data-id=2}
      {data-prototype=Psd2_PPort.egoPositionLayer, element-in-impl-datatype={root-data-prototype=egoPositionLayer, target-data-prototype=reference}, tlv-data-id=0}
      {data-prototype=Psd2_PPort.egoPositionLayer, element-in-impl-datatype={root-data-prototype=egoPositionLayer, target-data-prototype=offset}, tlv-data-id=1}
      {data-prototype=Psd2_PPort.egoPositionLayer, element-in-impl-datatype={root-data-prototype=egoPositionLayer, target-data-prototype=localId}, tlv-data-id=1}
      {data-prototype=Psd2_PPort.egoPositionLayer, element-in-impl-datatype={root-data-prototype=egoPositionLayer, target-data-prototype=referenceBaseIndex}, tlv-data-id=0}
      {data-prototype=Psd2_PPort.egoPositionLayer, element-in-impl-datatype={root-data-prototype=egoPositionLayer, target-data-prototype=inPositiveDirection}, tlv-data-id=2}
      {data-prototype=Psd2_PPort.egoPositionLayer, element-in-impl-datatype={root-data-prototype=egoPositionLayer, target-data-prototype=coordinate}, tlv-data-id=0}
      {data-prototype=Psd2_PPort.egoPositionLayer, element-in-impl-datatype={root-data-prototype=egoPositionLayer, target-data-prototype=heading}, tlv-data-id=1}
      {data-prototype=Psd2_PPort.egoPositionLayer, element-in-impl-datatype={root-data-prototype=egoPositionLayer, target-data-prototype=longitude}, tlv-data-id=0}
      {data-prototype=Psd2_PPort.egoPositionLayer, element-in-impl-datatype={root-data-prototype=egoPositionLayer, target-data-prototype=latitude}, tlv-data-id=1}
      {data-prototype=Psd2_PPort.egoPositionLayer, element-in-impl-datatype={root-data-prototype=egoPositionLayer, target-data-prototype=height}, tlv-data-id=2}
      {data-prototype=Psd2_PPort.egoPositionLayer, element-in-impl-datatype={root-data-prototype=egoPositionLayer, target-data-prototype=arrayMember}, tlv-data-id=0}
      {data-prototype=Psd2_PPort.egoPositionLayer, element-in-impl-datatype={root-data-prototype=egoPositionLayer, target-data-prototype=pathType}, tlv-data-id=0}
      {data-prototype=Psd2_PPort.egoPositionLayer, element-in-impl-datatype={root-data-prototype=egoPositionLayer, target-data-prototype=pathElementList}, tlv-data-id=1}
      {data-prototype=Psd2_PPort.egoPositionLayer, element-in-impl-datatype={root-data-prototype=egoPositionLayer, target-data-prototype=pathID}, tlv-data-id=2}
      {data-prototype=Psd2_PPort.egoPositionLayer, element-in-impl-datatype={root-data-prototype=egoPositionLayer, target-data-prototype=confidence}, tlv-data-id=3}
      {data-prototype=Psd2_PPort.egoPositionLayer, element-in-impl-datatype={root-data-prototype=egoPositionLayer, target-data-prototype=pathType}, tlv-data-id=0}
      {data-prototype=Psd2_PPort.egoPositionLayer, element-in-impl-datatype={root-data-prototype=egoPositionLayer, target-data-prototype=arrayMember}, tlv-data-id=0}
      {data-prototype=Psd2_PPort.egoPositionLayer, element-in-impl-datatype={root-data-prototype=egoPositionLayer, target-data-prototype=linkReference}, tlv-data-id=0}
      {data-prototype=Psd2_PPort.egoPositionLayer, element-in-impl-datatype={root-data-prototype=egoPositionLayer, target-data-prototype=positiveGeometryDirection}, tlv-data-id=1}
      {data-prototype=Psd2_PPort.egoPositionLayer, element-in-impl-datatype={root-data-prototype=egoPositionLayer, target-data-prototype=localId}, tlv-data-id=1}
      {data-prototype=Psd2_PPort.egoPositionLayer, element-in-impl-datatype={root-data-prototype=egoPositionLayer, target-data-prototype=referenceBaseIndex}, tlv-data-id=0}
      {data-prototype=Psd2_PPort.egoPositionLayer, element-in-impl-datatype={root-data-prototype=egoPositionLayer, target-data-prototype=inPositiveDirection}, tlv-data-id=2}
      {data-prototype=Psd2_PPort.egoPositionLayer, element-in-impl-datatype={root-data-prototype=egoPositionLayer, target-data-prototype=referenceBaseList}, tlv-data-id=0}
      {data-prototype=Psd2_PPort.egoPositionLayer, element-in-impl-datatype={root-data-prototype=egoPositionLayer, target-data-prototype=metaDataList}, tlv-data-id=1}
      {data-prototype=Psd2_PPort.egoPositionLayer, element-in-impl-datatype={root-data-prototype=egoPositionLayer, target-data-prototype=arrayMember}, tlv-data-id=0}
      {data-prototype=Psd2_PPort.egoPositionLayer, element-in-impl-datatype={root-data-prototype=egoPositionLayer, target-data-prototype=productId}, tlv-data-id=0}
      {data-prototype=Psd2_PPort.egoPositionLayer, element-in-impl-datatype={root-data-prototype=egoPositionLayer, target-data-prototype=updateRegion}, tlv-data-id=1}
      {data-prototype=Psd2_PPort.egoPositionLayer, element-in-impl-datatype={root-data-prototype=egoPositionLayer, target-data-prototype=tileId}, tlv-data-id=2}
      {data-prototype=Psd2_PPort.egoPositionLayer, element-in-impl-datatype={root-data-prototype=egoPositionLayer, target-data-prototype=arrayMember}, tlv-data-id=0}
      {data-prototype=Psd2_PPort.egoPositionLayer, element-in-impl-datatype={root-data-prototype=egoPositionLayer, target-data-prototype=countryCode}, tlv-data-id=0}
      {data-prototype=Psd2_PPort.egoPositionLayer, element-in-impl-datatype={root-data-prototype=egoPositionLayer, target-data-prototype=regionCode}, tlv-data-id=1}
      {data-prototype=Psd2_PPort.egoPositionLayer, element-in-impl-datatype={root-data-prototype=egoPositionLayer, target-data-prototype=mapAge}, tlv-data-id=2}
      {data-prototype=Psd2_PPort.egoPositionLayer, element-in-impl-datatype={root-data-prototype=egoPositionLayer, target-data-prototype=qualityIndicators}, tlv-data-id=3}
      {data-prototype=Psd2_PPort.egoPositionLayer, element-in-impl-datatype={root-data-prototype=egoPositionLayer, target-data-prototype=trafficDirection}, tlv-data-id=4}
      {data-prototype=Psd2_PPort.egoPositionLayer, element-in-impl-datatype={root-data-prototype=egoPositionLayer, target-data-prototype=generalSpeedLimits}, tlv-data-id=5}
      {data-prototype=Psd2_PPort.egoPositionLayer, element-in-impl-datatype={root-data-prototype=egoPositionLayer, target-data-prototype=speedUnit}, tlv-data-id=6}
      {data-prototype=Psd2_PPort.egoPositionLayer, element-in-impl-datatype={root-data-prototype=egoPositionLayer, target-data-prototype=month}, tlv-data-id=0}
      {data-prototype=Psd2_PPort.egoPositionLayer, element-in-impl-datatype={root-data-prototype=egoPositionLayer, target-data-prototype=year}, tlv-data-id=1}
      {data-prototype=Psd2_PPort.egoPositionLayer, element-in-impl-datatype={root-data-prototype=egoPositionLayer, target-data-prototype=arrayMember}, tlv-data-id=0}
      {data-prototype=Psd2_PPort.egoPositionLayer, element-in-impl-datatype={root-data-prototype=egoPositionLayer, target-data-prototype=type}, tlv-data-id=0}
      {data-prototype=Psd2_PPort.egoPositionLayer, element-in-impl-datatype={root-data-prototype=egoPositionLayer, target-data-prototype=quality}, tlv-data-id=1}
      {data-prototype=Psd2_PPort.egoPositionLayer, element-in-impl-datatype={root-data-prototype=egoPositionLayer, target-data-prototype=qualityIndicatorType}, tlv-data-id=0}
      {data-prototype=Psd2_PPort.egoPositionLayer, element-in-impl-datatype={root-data-prototype=egoPositionLayer, target-data-prototype=trafficDirection}, tlv-data-id=0}
      {data-prototype=Psd2_PPort.egoPositionLayer, element-in-impl-datatype={root-data-prototype=egoPositionLayer, target-data-prototype=arrayMember}, tlv-data-id=0}
      {data-prototype=Psd2_PPort.egoPositionLayer, element-in-impl-datatype={root-data-prototype=egoPositionLayer, target-data-prototype=type}, tlv-data-id=0}
      {data-prototype=Psd2_PPort.egoPositionLayer, element-in-impl-datatype={root-data-prototype=egoPositionLayer, target-data-prototype=speedValue}, tlv-data-id=1}
      {data-prototype=Psd2_PPort.egoPositionLayer, element-in-impl-datatype={root-data-prototype=egoPositionLayer, target-data-prototype=constraint}, tlv-data-id=3}
      {data-prototype=Psd2_PPort.egoPositionLayer, element-in-impl-datatype={root-data-prototype=egoPositionLayer, target-data-prototype=generalSpeedLimitType}, tlv-data-id=0}
      {data-prototype=Psd2_PPort.egoPositionLayer, element-in-impl-datatype={root-data-prototype=egoPositionLayer, target-data-prototype=arrayMember}, tlv-data-id=0}
      {data-prototype=Psd2_PPort.egoPositionLayer, element-in-impl-datatype={root-data-prototype=egoPositionLayer, target-data-prototype=daysOfWeek}, tlv-data-id=0}
      {data-prototype=Psd2_PPort.egoPositionLayer, element-in-impl-datatype={root-data-prototype=egoPositionLayer, target-data-prototype=timeRangeOfDay}, tlv-data-id=1}
      {data-prototype=Psd2_PPort.egoPositionLayer, element-in-impl-datatype={root-data-prototype=egoPositionLayer, target-data-prototype=weatherConstraint}, tlv-data-id=2}
      {data-prototype=Psd2_PPort.egoPositionLayer, element-in-impl-datatype={root-data-prototype=egoPositionLayer, target-data-prototype=timeClassifier}, tlv-data-id=3}
      {data-prototype=Psd2_PPort.egoPositionLayer, element-in-impl-datatype={root-data-prototype=egoPositionLayer, target-data-prototype=zoneClassifier}, tlv-data-id=4}
      {data-prototype=Psd2_PPort.egoPositionLayer, element-in-impl-datatype={root-data-prototype=egoPositionLayer, target-data-prototype=applicableVehicles}, tlv-data-id=5}
      {data-prototype=Psd2_PPort.egoPositionLayer, element-in-impl-datatype={root-data-prototype=egoPositionLayer, target-data-prototype=turnConstraint}, tlv-data-id=6}
      {data-prototype=Psd2_PPort.egoPositionLayer, element-in-impl-datatype={root-data-prototype=egoPositionLayer, target-data-prototype=arrayMember}, tlv-data-id=0}
      {data-prototype=Psd2_PPort.egoPositionLayer, element-in-impl-datatype={root-data-prototype=egoPositionLayer, target-data-prototype=startTimeHour}, tlv-data-id=0}
      {data-prototype=Psd2_PPort.egoPositionLayer, element-in-impl-datatype={root-data-prototype=egoPositionLayer, target-data-prototype=startTimeMinute}, tlv-data-id=1}
      {data-prototype=Psd2_PPort.egoPositionLayer, element-in-impl-datatype={root-data-prototype=egoPositionLayer, target-data-prototype=endTimeHour}, tlv-data-id=2}
      {data-prototype=Psd2_PPort.egoPositionLayer, element-in-impl-datatype={root-data-prototype=egoPositionLayer, target-data-prototype=endTimeMinute}, tlv-data-id=3}
      {data-prototype=Psd2_PPort.egoPositionLayer, element-in-impl-datatype={root-data-prototype=egoPositionLayer, target-data-prototype=Weather}, tlv-data-id=0}
      {data-prototype=Psd2_PPort.egoPositionLayer, element-in-impl-datatype={root-data-prototype=egoPositionLayer, target-data-prototype=timeConstraintType}, tlv-data-id=0}
      {data-prototype=Psd2_PPort.egoPositionLayer, element-in-impl-datatype={root-data-prototype=egoPositionLayer, target-data-prototype=zoneConstraintType}, tlv-data-id=0}
      {data-prototype=Psd2_PPort.egoPositionLayer, element-in-impl-datatype={root-data-prototype=egoPositionLayer, target-data-prototype=applicableVehiclesType}, tlv-data-id=0}
      {data-prototype=Psd2_PPort.egoPositionLayer, element-in-impl-datatype={root-data-prototype=egoPositionLayer, target-data-prototype=turnConstraint}, tlv-data-id=0}
      {data-prototype=Psd2_PPort.egoPositionLayer, element-in-impl-datatype={root-data-prototype=egoPositionLayer, target-data-prototype=speedUnit}, tlv-data-id=0}
      {data-prototype=Psd2_PPort.dynamicContentLayer, element-in-impl-datatype={root-data-prototype=dynamicContentLayer, target-data-prototype=id}, tlv-data-id=0}
      {data-prototype=Psd2_PPort.dynamicContentLayer, element-in-impl-datatype={root-data-prototype=dynamicContentLayer, target-data-prototype=dynamicContentLayer}, tlv-data-id=1}
      {data-prototype=Psd2_PPort.dynamicContentLayer, element-in-impl-datatype={root-data-prototype=dynamicContentLayer, target-data-prototype=layerInfo}, tlv-data-id=2}
      {data-prototype=Psd2_PPort.dynamicContentLayer, element-in-impl-datatype={root-data-prototype=dynamicContentLayer, target-data-prototype=dynamicAttributes}, tlv-data-id=0}
      {data-prototype=Psd2_PPort.dynamicContentLayer, element-in-impl-datatype={root-data-prototype=dynamicContentLayer, target-data-prototype=arrayMember}, tlv-data-id=0}
      {data-prototype=Psd2_PPort.dynamicContentLayer, element-in-impl-datatype={root-data-prototype=dynamicContentLayer, target-data-prototype=linkReference}, tlv-data-id=0}
      {data-prototype=Psd2_PPort.dynamicContentLayer, element-in-impl-datatype={root-data-prototype=dynamicContentLayer, target-data-prototype=laneReference}, tlv-data-id=1}
      {data-prototype=Psd2_PPort.dynamicContentLayer, element-in-impl-datatype={root-data-prototype=dynamicContentLayer, target-data-prototype=attributeList}, tlv-data-id=2}
      {data-prototype=Psd2_PPort.dynamicContentLayer, element-in-impl-datatype={root-data-prototype=dynamicContentLayer, target-data-prototype=psd15SegmentReference}, tlv-data-id=3}
      {data-prototype=Psd2_PPort.dynamicContentLayer, element-in-impl-datatype={root-data-prototype=dynamicContentLayer, target-data-prototype=localId}, tlv-data-id=1}
      {data-prototype=Psd2_PPort.dynamicContentLayer, element-in-impl-datatype={root-data-prototype=dynamicContentLayer, target-data-prototype=referenceBaseIndex}, tlv-data-id=0}
      {data-prototype=Psd2_PPort.dynamicContentLayer, element-in-impl-datatype={root-data-prototype=dynamicContentLayer, target-data-prototype=inPositiveDirection}, tlv-data-id=2}
      {data-prototype=Psd2_PPort.dynamicContentLayer, element-in-impl-datatype={root-data-prototype=dynamicContentLayer, target-data-prototype=localId}, tlv-data-id=1}
      {data-prototype=Psd2_PPort.dynamicContentLayer, element-in-impl-datatype={root-data-prototype=dynamicContentLayer, target-data-prototype=referenceBaseIndex}, tlv-data-id=0}
      {data-prototype=Psd2_PPort.dynamicContentLayer, element-in-impl-datatype={root-data-prototype=dynamicContentLayer, target-data-prototype=inPositiveDirection}, tlv-data-id=2}
      {data-prototype=Psd2_PPort.dynamicContentLayer, element-in-impl-datatype={root-data-prototype=dynamicContentLayer, target-data-prototype=arrayMember}, tlv-data-id=0}
      {data-prototype=Psd2_PPort.dynamicContentLayer, element-in-impl-datatype={root-data-prototype=dynamicContentLayer, target-data-prototype=confidence}, tlv-data-id=0}
      {data-prototype=Psd2_PPort.dynamicContentLayer, element-in-impl-datatype={root-data-prototype=dynamicContentLayer, target-data-prototype=attributeType}, tlv-data-id=1}
      {data-prototype=Psd2_PPort.dynamicContentLayer, element-in-impl-datatype={root-data-prototype=dynamicContentLayer, target-data-prototype=direction}, tlv-data-id=2}
      {data-prototype=Psd2_PPort.dynamicContentLayer, element-in-impl-datatype={root-data-prototype=dynamicContentLayer, target-data-prototype=attributePointList}, tlv-data-id=3}
      {data-prototype=Psd2_PPort.dynamicContentLayer, element-in-impl-datatype={root-data-prototype=dynamicContentLayer, target-data-prototype=direction}, tlv-data-id=0}
      {data-prototype=Psd2_PPort.dynamicContentLayer, element-in-impl-datatype={root-data-prototype=dynamicContentLayer, target-data-prototype=arrayMember}, tlv-data-id=0}
      {data-prototype=Psd2_PPort.dynamicContentLayer, element-in-impl-datatype={root-data-prototype=dynamicContentLayer, target-data-prototype=offset}, tlv-data-id=0}
      {data-prototype=Psd2_PPort.dynamicContentLayer, element-in-impl-datatype={root-data-prototype=dynamicContentLayer, target-data-prototype=attributeValue}, tlv-data-id=1}
      {data-prototype=Psd2_PPort.dynamicContentLayer, element-in-impl-datatype={root-data-prototype=dynamicContentLayer, target-data-prototype=laneList}, tlv-data-id=2}
      {data-prototype=Psd2_PPort.dynamicContentLayer, element-in-impl-datatype={root-data-prototype=dynamicContentLayer, target-data-prototype=intValue}, tlv-data-id=0}
      {data-prototype=Psd2_PPort.dynamicContentLayer, element-in-impl-datatype={root-data-prototype=dynamicContentLayer, target-data-prototype=floatValue}, tlv-data-id=1}
      {data-prototype=Psd2_PPort.dynamicContentLayer, element-in-impl-datatype={root-data-prototype=dynamicContentLayer, target-data-prototype=blobValue}, tlv-data-id=2}
      {data-prototype=Psd2_PPort.dynamicContentLayer, element-in-impl-datatype={root-data-prototype=dynamicContentLayer, target-data-prototype=speedLimit}, tlv-data-id=3}
      {data-prototype=Psd2_PPort.dynamicContentLayer, element-in-impl-datatype={root-data-prototype=dynamicContentLayer, target-data-prototype=overtakingProhibition}, tlv-data-id=4}
      {data-prototype=Psd2_PPort.dynamicContentLayer, element-in-impl-datatype={root-data-prototype=dynamicContentLayer, target-data-prototype=arrayMember}, tlv-data-id=0}
      {data-prototype=Psd2_PPort.dynamicContentLayer, element-in-impl-datatype={root-data-prototype=dynamicContentLayer, target-data-prototype=speedValue}, tlv-data-id=0}
      {data-prototype=Psd2_PPort.dynamicContentLayer, element-in-impl-datatype={root-data-prototype=dynamicContentLayer, target-data-prototype=source}, tlv-data-id=1}
      {data-prototype=Psd2_PPort.dynamicContentLayer, element-in-impl-datatype={root-data-prototype=dynamicContentLayer, target-data-prototype=constraintList}, tlv-data-id=2}
      {data-prototype=Psd2_PPort.dynamicContentLayer, element-in-impl-datatype={root-data-prototype=dynamicContentLayer, target-data-prototype=online}, tlv-data-id=3}
      {data-prototype=Psd2_PPort.dynamicContentLayer, element-in-impl-datatype={root-data-prototype=dynamicContentLayer, target-data-prototype=speedLimitSource}, tlv-data-id=0}
      {data-prototype=Psd2_PPort.dynamicContentLayer, element-in-impl-datatype={root-data-prototype=dynamicContentLayer, target-data-prototype=arrayMember}, tlv-data-id=0}
      {data-prototype=Psd2_PPort.dynamicContentLayer, element-in-impl-datatype={root-data-prototype=dynamicContentLayer, target-data-prototype=daysOfWeek}, tlv-data-id=0}
      {data-prototype=Psd2_PPort.dynamicContentLayer, element-in-impl-datatype={root-data-prototype=dynamicContentLayer, target-data-prototype=timeRangeOfDay}, tlv-data-id=1}
      {data-prototype=Psd2_PPort.dynamicContentLayer, element-in-impl-datatype={root-data-prototype=dynamicContentLayer, target-data-prototype=weatherConstraint}, tlv-data-id=2}
      {data-prototype=Psd2_PPort.dynamicContentLayer, element-in-impl-datatype={root-data-prototype=dynamicContentLayer, target-data-prototype=timeClassifier}, tlv-data-id=3}
      {data-prototype=Psd2_PPort.dynamicContentLayer, element-in-impl-datatype={root-data-prototype=dynamicContentLayer, target-data-prototype=zoneClassifier}, tlv-data-id=4}
      {data-prototype=Psd2_PPort.dynamicContentLayer, element-in-impl-datatype={root-data-prototype=dynamicContentLayer, target-data-prototype=applicableVehicles}, tlv-data-id=5}
      {data-prototype=Psd2_PPort.dynamicContentLayer, element-in-impl-datatype={root-data-prototype=dynamicContentLayer, target-data-prototype=turnConstraint}, tlv-data-id=6}
      {data-prototype=Psd2_PPort.dynamicContentLayer, element-in-impl-datatype={root-data-prototype=dynamicContentLayer, target-data-prototype=arrayMember}, tlv-data-id=0}
      {data-prototype=Psd2_PPort.dynamicContentLayer, element-in-impl-datatype={root-data-prototype=dynamicContentLayer, target-data-prototype=startTimeHour}, tlv-data-id=0}
      {data-prototype=Psd2_PPort.dynamicContentLayer, element-in-impl-datatype={root-data-prototype=dynamicContentLayer, target-data-prototype=startTimeMinute}, tlv-data-id=1}
      {data-prototype=Psd2_PPort.dynamicContentLayer, element-in-impl-datatype={root-data-prototype=dynamicContentLayer, target-data-prototype=endTimeHour}, tlv-data-id=2}
      {data-prototype=Psd2_PPort.dynamicContentLayer, element-in-impl-datatype={root-data-prototype=dynamicContentLayer, target-data-prototype=endTimeMinute}, tlv-data-id=3}
      {data-prototype=Psd2_PPort.dynamicContentLayer, element-in-impl-datatype={root-data-prototype=dynamicContentLayer, target-data-prototype=Weather}, tlv-data-id=0}
      {data-prototype=Psd2_PPort.dynamicContentLayer, element-in-impl-datatype={root-data-prototype=dynamicContentLayer, target-data-prototype=timeConstraintType}, tlv-data-id=0}
      {data-prototype=Psd2_PPort.dynamicContentLayer, element-in-impl-datatype={root-data-prototype=dynamicContentLayer, target-data-prototype=zoneConstraintType}, tlv-data-id=0}
      {data-prototype=Psd2_PPort.dynamicContentLayer, element-in-impl-datatype={root-data-prototype=dynamicContentLayer, target-data-prototype=applicableVehiclesType}, tlv-data-id=0}
      {data-prototype=Psd2_PPort.dynamicContentLayer, element-in-impl-datatype={root-data-prototype=dynamicContentLayer, target-data-prototype=turnConstraint}, tlv-data-id=0}
      {data-prototype=Psd2_PPort.dynamicContentLayer, element-in-impl-datatype={root-data-prototype=dynamicContentLayer, target-data-prototype=online}, tlv-data-id=0}
      {data-prototype=Psd2_PPort.dynamicContentLayer, element-in-impl-datatype={root-data-prototype=dynamicContentLayer, target-data-prototype=constraintList}, tlv-data-id=1}
      {data-prototype=Psd2_PPort.dynamicContentLayer, element-in-impl-datatype={root-data-prototype=dynamicContentLayer, target-data-prototype=type}, tlv-data-id=2}
      {data-prototype=Psd2_PPort.dynamicContentLayer, element-in-impl-datatype={root-data-prototype=dynamicContentLayer, target-data-prototype=arrayMember}, tlv-data-id=0}
      {data-prototype=Psd2_PPort.dynamicContentLayer, element-in-impl-datatype={root-data-prototype=dynamicContentLayer, target-data-prototype=daysOfWeek}, tlv-data-id=0}
      {data-prototype=Psd2_PPort.dynamicContentLayer, element-in-impl-datatype={root-data-prototype=dynamicContentLayer, target-data-prototype=timeRangeOfDay}, tlv-data-id=1}
      {data-prototype=Psd2_PPort.dynamicContentLayer, element-in-impl-datatype={root-data-prototype=dynamicContentLayer, target-data-prototype=weatherConstraint}, tlv-data-id=2}
      {data-prototype=Psd2_PPort.dynamicContentLayer, element-in-impl-datatype={root-data-prototype=dynamicContentLayer, target-data-prototype=timeClassifier}, tlv-data-id=3}
      {data-prototype=Psd2_PPort.dynamicContentLayer, element-in-impl-datatype={root-data-prototype=dynamicContentLayer, target-data-prototype=zoneClassifier}, tlv-data-id=4}
      {data-prototype=Psd2_PPort.dynamicContentLayer, element-in-impl-datatype={root-data-prototype=dynamicContentLayer, target-data-prototype=applicableVehicles}, tlv-data-id=5}
      {data-prototype=Psd2_PPort.dynamicContentLayer, element-in-impl-datatype={root-data-prototype=dynamicContentLayer, target-data-prototype=turnConstraint}, tlv-data-id=6}
      {data-prototype=Psd2_PPort.dynamicContentLayer, element-in-impl-datatype={root-data-prototype=dynamicContentLayer, target-data-prototype=arrayMember}, tlv-data-id=0}
      {data-prototype=Psd2_PPort.dynamicContentLayer, element-in-impl-datatype={root-data-prototype=dynamicContentLayer, target-data-prototype=startTimeHour}, tlv-data-id=0}
      {data-prototype=Psd2_PPort.dynamicContentLayer, element-in-impl-datatype={root-data-prototype=dynamicContentLayer, target-data-prototype=startTimeMinute}, tlv-data-id=1}
      {data-prototype=Psd2_PPort.dynamicContentLayer, element-in-impl-datatype={root-data-prototype=dynamicContentLayer, target-data-prototype=endTimeHour}, tlv-data-id=2}
      {data-prototype=Psd2_PPort.dynamicContentLayer, element-in-impl-datatype={root-data-prototype=dynamicContentLayer, target-data-prototype=endTimeMinute}, tlv-data-id=3}
      {data-prototype=Psd2_PPort.dynamicContentLayer, element-in-impl-datatype={root-data-prototype=dynamicContentLayer, target-data-prototype=Weather}, tlv-data-id=0}
      {data-prototype=Psd2_PPort.dynamicContentLayer, element-in-impl-datatype={root-data-prototype=dynamicContentLayer, target-data-prototype=timeConstraintType}, tlv-data-id=0}
      {data-prototype=Psd2_PPort.dynamicContentLayer, element-in-impl-datatype={root-data-prototype=dynamicContentLayer, target-data-prototype=zoneConstraintType}, tlv-data-id=0}
      {data-prototype=Psd2_PPort.dynamicContentLayer, element-in-impl-datatype={root-data-prototype=dynamicContentLayer, target-data-prototype=applicableVehiclesType}, tlv-data-id=0}
      {data-prototype=Psd2_PPort.dynamicContentLayer, element-in-impl-datatype={root-data-prototype=dynamicContentLayer, target-data-prototype=turnConstraint}, tlv-data-id=0}
      {data-prototype=Psd2_PPort.dynamicContentLayer, element-in-impl-datatype={root-data-prototype=dynamicContentLayer, target-data-prototype=overtakingProhibitionType}, tlv-data-id=0}
      {data-prototype=Psd2_PPort.dynamicContentLayer, element-in-impl-datatype={root-data-prototype=dynamicContentLayer, target-data-prototype=arrayMember}, tlv-data-id=0}
      {data-prototype=Psd2_PPort.dynamicContentLayer, element-in-impl-datatype={root-data-prototype=dynamicContentLayer, target-data-prototype=arrayMember}, tlv-data-id=0}
      {data-prototype=Psd2_PPort.dynamicContentLayer, element-in-impl-datatype={root-data-prototype=dynamicContentLayer, target-data-prototype=arrayMember}, tlv-data-id=0}
      {data-prototype=Psd2_PPort.dynamicContentLayer, element-in-impl-datatype={root-data-prototype=dynamicContentLayer, target-data-prototype=referenceBaseList}, tlv-data-id=0}
      {data-prototype=Psd2_PPort.dynamicContentLayer, element-in-impl-datatype={root-data-prototype=dynamicContentLayer, target-data-prototype=metaDataList}, tlv-data-id=1}
      {data-prototype=Psd2_PPort.dynamicContentLayer, element-in-impl-datatype={root-data-prototype=dynamicContentLayer, target-data-prototype=arrayMember}, tlv-data-id=0}
      {data-prototype=Psd2_PPort.dynamicContentLayer, element-in-impl-datatype={root-data-prototype=dynamicContentLayer, target-data-prototype=productId}, tlv-data-id=0}
      {data-prototype=Psd2_PPort.dynamicContentLayer, element-in-impl-datatype={root-data-prototype=dynamicContentLayer, target-data-prototype=updateRegion}, tlv-data-id=1}
      {data-prototype=Psd2_PPort.dynamicContentLayer, element-in-impl-datatype={root-data-prototype=dynamicContentLayer, target-data-prototype=tileId}, tlv-data-id=2}
      {data-prototype=Psd2_PPort.dynamicContentLayer, element-in-impl-datatype={root-data-prototype=dynamicContentLayer, target-data-prototype=arrayMember}, tlv-data-id=0}
      {data-prototype=Psd2_PPort.dynamicContentLayer, element-in-impl-datatype={root-data-prototype=dynamicContentLayer, target-data-prototype=countryCode}, tlv-data-id=0}
      {data-prototype=Psd2_PPort.dynamicContentLayer, element-in-impl-datatype={root-data-prototype=dynamicContentLayer, target-data-prototype=regionCode}, tlv-data-id=1}
      {data-prototype=Psd2_PPort.dynamicContentLayer, element-in-impl-datatype={root-data-prototype=dynamicContentLayer, target-data-prototype=mapAge}, tlv-data-id=2}
      {data-prototype=Psd2_PPort.dynamicContentLayer, element-in-impl-datatype={root-data-prototype=dynamicContentLayer, target-data-prototype=qualityIndicators}, tlv-data-id=3}
      {data-prototype=Psd2_PPort.dynamicContentLayer, element-in-impl-datatype={root-data-prototype=dynamicContentLayer, target-data-prototype=trafficDirection}, tlv-data-id=4}
      {data-prototype=Psd2_PPort.dynamicContentLayer, element-in-impl-datatype={root-data-prototype=dynamicContentLayer, target-data-prototype=generalSpeedLimits}, tlv-data-id=5}
      {data-prototype=Psd2_PPort.dynamicContentLayer, element-in-impl-datatype={root-data-prototype=dynamicContentLayer, target-data-prototype=speedUnit}, tlv-data-id=6}
      {data-prototype=Psd2_PPort.dynamicContentLayer, element-in-impl-datatype={root-data-prototype=dynamicContentLayer, target-data-prototype=month}, tlv-data-id=0}
      {data-prototype=Psd2_PPort.dynamicContentLayer, element-in-impl-datatype={root-data-prototype=dynamicContentLayer, target-data-prototype=year}, tlv-data-id=1}
      {data-prototype=Psd2_PPort.dynamicContentLayer, element-in-impl-datatype={root-data-prototype=dynamicContentLayer, target-data-prototype=arrayMember}, tlv-data-id=0}
      {data-prototype=Psd2_PPort.dynamicContentLayer, element-in-impl-datatype={root-data-prototype=dynamicContentLayer, target-data-prototype=type}, tlv-data-id=0}
      {data-prototype=Psd2_PPort.dynamicContentLayer, element-in-impl-datatype={root-data-prototype=dynamicContentLayer, target-data-prototype=quality}, tlv-data-id=1}
      {data-prototype=Psd2_PPort.dynamicContentLayer, element-in-impl-datatype={root-data-prototype=dynamicContentLayer, target-data-prototype=qualityIndicatorType}, tlv-data-id=0}
      {data-prototype=Psd2_PPort.dynamicContentLayer, element-in-impl-datatype={root-data-prototype=dynamicContentLayer, target-data-prototype=trafficDirection}, tlv-data-id=0}
      {data-prototype=Psd2_PPort.dynamicContentLayer, element-in-impl-datatype={root-data-prototype=dynamicContentLayer, target-data-prototype=arrayMember}, tlv-data-id=0}
      {data-prototype=Psd2_PPort.dynamicContentLayer, element-in-impl-datatype={root-data-prototype=dynamicContentLayer, target-data-prototype=type}, tlv-data-id=0}
      {data-prototype=Psd2_PPort.dynamicContentLayer, element-in-impl-datatype={root-data-prototype=dynamicContentLayer, target-data-prototype=speedValue}, tlv-data-id=1}
      {data-prototype=Psd2_PPort.dynamicContentLayer, element-in-impl-datatype={root-data-prototype=dynamicContentLayer, target-data-prototype=constraint}, tlv-data-id=3}
      {data-prototype=Psd2_PPort.dynamicContentLayer, element-in-impl-datatype={root-data-prototype=dynamicContentLayer, target-data-prototype=generalSpeedLimitType}, tlv-data-id=0}
      {data-prototype=Psd2_PPort.dynamicContentLayer, element-in-impl-datatype={root-data-prototype=dynamicContentLayer, target-data-prototype=arrayMember}, tlv-data-id=0}
      {data-prototype=Psd2_PPort.dynamicContentLayer, element-in-impl-datatype={root-data-prototype=dynamicContentLayer, target-data-prototype=daysOfWeek}, tlv-data-id=0}
      {data-prototype=Psd2_PPort.dynamicContentLayer, element-in-impl-datatype={root-data-prototype=dynamicContentLayer, target-data-prototype=timeRangeOfDay}, tlv-data-id=1}
      {data-prototype=Psd2_PPort.dynamicContentLayer, element-in-impl-datatype={root-data-prototype=dynamicContentLayer, target-data-prototype=weatherConstraint}, tlv-data-id=2}
      {data-prototype=Psd2_PPort.dynamicContentLayer, element-in-impl-datatype={root-data-prototype=dynamicContentLayer, target-data-prototype=timeClassifier}, tlv-data-id=3}
      {data-prototype=Psd2_PPort.dynamicContentLayer, element-in-impl-datatype={root-data-prototype=dynamicContentLayer, target-data-prototype=zoneClassifier}, tlv-data-id=4}
      {data-prototype=Psd2_PPort.dynamicContentLayer, element-in-impl-datatype={root-data-prototype=dynamicContentLayer, target-data-prototype=applicableVehicles}, tlv-data-id=5}
      {data-prototype=Psd2_PPort.dynamicContentLayer, element-in-impl-datatype={root-data-prototype=dynamicContentLayer, target-data-prototype=turnConstraint}, tlv-data-id=6}
      {data-prototype=Psd2_PPort.dynamicContentLayer, element-in-impl-datatype={root-data-prototype=dynamicContentLayer, target-data-prototype=arrayMember}, tlv-data-id=0}
      {data-prototype=Psd2_PPort.dynamicContentLayer, element-in-impl-datatype={root-data-prototype=dynamicContentLayer, target-data-prototype=startTimeHour}, tlv-data-id=0}
      {data-prototype=Psd2_PPort.dynamicContentLayer, element-in-impl-datatype={root-data-prototype=dynamicContentLayer, target-data-prototype=startTimeMinute}, tlv-data-id=1}
      {data-prototype=Psd2_PPort.dynamicContentLayer, element-in-impl-datatype={root-data-prototype=dynamicContentLayer, target-data-prototype=endTimeHour}, tlv-data-id=2}
      {data-prototype=Psd2_PPort.dynamicContentLayer, element-in-impl-datatype={root-data-prototype=dynamicContentLayer, target-data-prototype=endTimeMinute}, tlv-data-id=3}
      {data-prototype=Psd2_PPort.dynamicContentLayer, element-in-impl-datatype={root-data-prototype=dynamicContentLayer, target-data-prototype=Weather}, tlv-data-id=0}
      {data-prototype=Psd2_PPort.dynamicContentLayer, element-in-impl-datatype={root-data-prototype=dynamicContentLayer, target-data-prototype=timeConstraintType}, tlv-data-id=0}
      {data-prototype=Psd2_PPort.dynamicContentLayer, element-in-impl-datatype={root-data-prototype=dynamicContentLayer, target-data-prototype=zoneConstraintType}, tlv-data-id=0}
      {data-prototype=Psd2_PPort.dynamicContentLayer, element-in-impl-datatype={root-data-prototype=dynamicContentLayer, target-data-prototype=applicableVehiclesType}, tlv-data-id=0}
      {data-prototype=Psd2_PPort.dynamicContentLayer, element-in-impl-datatype={root-data-prototype=dynamicContentLayer, target-data-prototype=turnConstraint}, tlv-data-id=0}
      {data-prototype=Psd2_PPort.dynamicContentLayer, element-in-impl-datatype={root-data-prototype=dynamicContentLayer, target-data-prototype=speedUnit}, tlv-data-id=0}
      {data-prototype=Psd2_PPort.automatedParkingLayer, element-in-impl-datatype={root-data-prototype=automatedParkingLayer, target-data-prototype=id}, tlv-data-id=0}
      {data-prototype=Psd2_PPort.automatedParkingLayer, element-in-impl-datatype={root-data-prototype=automatedParkingLayer, target-data-prototype=automatedParkingLayer}, tlv-data-id=1}
      {data-prototype=Psd2_PPort.automatedParkingLayer, element-in-impl-datatype={root-data-prototype=automatedParkingLayer, target-data-prototype=layerInfo}, tlv-data-id=2}
      {data-prototype=Psd2_PPort.automatedParkingLayer, element-in-impl-datatype={root-data-prototype=automatedParkingLayer, target-data-prototype=parkingSectionList}, tlv-data-id=0}
      {data-prototype=Psd2_PPort.automatedParkingLayer, element-in-impl-datatype={root-data-prototype=automatedParkingLayer, target-data-prototype=parkingRowList}, tlv-data-id=1}
      {data-prototype=Psd2_PPort.automatedParkingLayer, element-in-impl-datatype={root-data-prototype=automatedParkingLayer, target-data-prototype=outerPolygon}, tlv-data-id=2}
      {data-prototype=Psd2_PPort.automatedParkingLayer, element-in-impl-datatype={root-data-prototype=automatedParkingLayer, target-data-prototype=facilityType}, tlv-data-id=3}
      {data-prototype=Psd2_PPort.automatedParkingLayer, element-in-impl-datatype={root-data-prototype=automatedParkingLayer, target-data-prototype=facilityId}, tlv-data-id=4}
      {data-prototype=Psd2_PPort.automatedParkingLayer, element-in-impl-datatype={root-data-prototype=automatedParkingLayer, target-data-prototype=arrayMember}, tlv-data-id=0}
      {data-prototype=Psd2_PPort.automatedParkingLayer, element-in-impl-datatype={root-data-prototype=automatedParkingLayer, target-data-prototype=sectionId}, tlv-data-id=0}
      {data-prototype=Psd2_PPort.automatedParkingLayer, element-in-impl-datatype={root-data-prototype=automatedParkingLayer, target-data-prototype=parkingRowList}, tlv-data-id=1}
      {data-prototype=Psd2_PPort.automatedParkingLayer, element-in-impl-datatype={root-data-prototype=automatedParkingLayer, target-data-prototype=sectionConnectionList}, tlv-data-id=2}
      {data-prototype=Psd2_PPort.automatedParkingLayer, element-in-impl-datatype={root-data-prototype=automatedParkingLayer, target-data-prototype=laneAccessList}, tlv-data-id=3}
      {data-prototype=Psd2_PPort.automatedParkingLayer, element-in-impl-datatype={root-data-prototype=automatedParkingLayer, target-data-prototype=linkAccessList}, tlv-data-id=4}
      {data-prototype=Psd2_PPort.automatedParkingLayer, element-in-impl-datatype={root-data-prototype=automatedParkingLayer, target-data-prototype=sectionType}, tlv-data-id=5}
      {data-prototype=Psd2_PPort.automatedParkingLayer, element-in-impl-datatype={root-data-prototype=automatedParkingLayer, target-data-prototype=name}, tlv-data-id=6}
      {data-prototype=Psd2_PPort.automatedParkingLayer, element-in-impl-datatype={root-data-prototype=automatedParkingLayer, target-data-prototype=outerBoundary}, tlv-data-id=7}
      {data-prototype=Psd2_PPort.automatedParkingLayer, element-in-impl-datatype={root-data-prototype=automatedParkingLayer, target-data-prototype=floorNumber}, tlv-data-id=8}
      {data-prototype=Psd2_PPort.automatedParkingLayer, element-in-impl-datatype={root-data-prototype=automatedParkingLayer, target-data-prototype=areaList}, tlv-data-id=9}
      {data-prototype=Psd2_PPort.automatedParkingLayer, element-in-impl-datatype={root-data-prototype=automatedParkingLayer, target-data-prototype=childSectionList}, tlv-data-id=10}
      {data-prototype=Psd2_PPort.automatedParkingLayer, element-in-impl-datatype={root-data-prototype=automatedParkingLayer, target-data-prototype=localId}, tlv-data-id=1}
      {data-prototype=Psd2_PPort.automatedParkingLayer, element-in-impl-datatype={root-data-prototype=automatedParkingLayer, target-data-prototype=referenceBaseIndex}, tlv-data-id=0}
      {data-prototype=Psd2_PPort.automatedParkingLayer, element-in-impl-datatype={root-data-prototype=automatedParkingLayer, target-data-prototype=inPositiveDirection}, tlv-data-id=2}
      {data-prototype=Psd2_PPort.automatedParkingLayer, element-in-impl-datatype={root-data-prototype=automatedParkingLayer, target-data-prototype=arrayMember}, tlv-data-id=0}
      {data-prototype=Psd2_PPort.automatedParkingLayer, element-in-impl-datatype={root-data-prototype=automatedParkingLayer, target-data-prototype=parkingRowId}, tlv-data-id=0}
      {data-prototype=Psd2_PPort.automatedParkingLayer, element-in-impl-datatype={root-data-prototype=automatedParkingLayer, target-data-prototype=laneRangeList}, tlv-data-id=1}
      {data-prototype=Psd2_PPort.automatedParkingLayer, element-in-impl-datatype={root-data-prototype=automatedParkingLayer, target-data-prototype=linkRangeList}, tlv-data-id=2}
      {data-prototype=Psd2_PPort.automatedParkingLayer, element-in-impl-datatype={root-data-prototype=automatedParkingLayer, target-data-prototype=parkingSpotList}, tlv-data-id=3}
      {data-prototype=Psd2_PPort.automatedParkingLayer, element-in-impl-datatype={root-data-prototype=automatedParkingLayer, target-data-prototype=localId}, tlv-data-id=1}
      {data-prototype=Psd2_PPort.automatedParkingLayer, element-in-impl-datatype={root-data-prototype=automatedParkingLayer, target-data-prototype=referenceBaseIndex}, tlv-data-id=0}
      {data-prototype=Psd2_PPort.automatedParkingLayer, element-in-impl-datatype={root-data-prototype=automatedParkingLayer, target-data-prototype=inPositiveDirection}, tlv-data-id=2}
      {data-prototype=Psd2_PPort.automatedParkingLayer, element-in-impl-datatype={root-data-prototype=automatedParkingLayer, target-data-prototype=arrayMember}, tlv-data-id=0}
      {data-prototype=Psd2_PPort.automatedParkingLayer, element-in-impl-datatype={root-data-prototype=automatedParkingLayer, target-data-prototype=reference}, tlv-data-id=0}
      {data-prototype=Psd2_PPort.automatedParkingLayer, element-in-impl-datatype={root-data-prototype=automatedParkingLayer, target-data-prototype=rangeStart}, tlv-data-id=1}
      {data-prototype=Psd2_PPort.automatedParkingLayer, element-in-impl-datatype={root-data-prototype=automatedParkingLayer, target-data-prototype=rangeEnd}, tlv-data-id=2}
      {data-prototype=Psd2_PPort.automatedParkingLayer, element-in-impl-datatype={root-data-prototype=automatedParkingLayer, target-data-prototype=localId}, tlv-data-id=1}
      {data-prototype=Psd2_PPort.automatedParkingLayer, element-in-impl-datatype={root-data-prototype=automatedParkingLayer, target-data-prototype=referenceBaseIndex}, tlv-data-id=0}
      {data-prototype=Psd2_PPort.automatedParkingLayer, element-in-impl-datatype={root-data-prototype=automatedParkingLayer, target-data-prototype=inPositiveDirection}, tlv-data-id=2}
      {data-prototype=Psd2_PPort.automatedParkingLayer, element-in-impl-datatype={root-data-prototype=automatedParkingLayer, target-data-prototype=arrayMember}, tlv-data-id=0}
      {data-prototype=Psd2_PPort.automatedParkingLayer, element-in-impl-datatype={root-data-prototype=automatedParkingLayer, target-data-prototype=reference}, tlv-data-id=0}
      {data-prototype=Psd2_PPort.automatedParkingLayer, element-in-impl-datatype={root-data-prototype=automatedParkingLayer, target-data-prototype=rangeStart}, tlv-data-id=1}
      {data-prototype=Psd2_PPort.automatedParkingLayer, element-in-impl-datatype={root-data-prototype=automatedParkingLayer, target-data-prototype=rangeEnd}, tlv-data-id=2}
      {data-prototype=Psd2_PPort.automatedParkingLayer, element-in-impl-datatype={root-data-prototype=automatedParkingLayer, target-data-prototype=localId}, tlv-data-id=1}
      {data-prototype=Psd2_PPort.automatedParkingLayer, element-in-impl-datatype={root-data-prototype=automatedParkingLayer, target-data-prototype=referenceBaseIndex}, tlv-data-id=0}
      {data-prototype=Psd2_PPort.automatedParkingLayer, element-in-impl-datatype={root-data-prototype=automatedParkingLayer, target-data-prototype=inPositiveDirection}, tlv-data-id=2}
      {data-prototype=Psd2_PPort.automatedParkingLayer, element-in-impl-datatype={root-data-prototype=automatedParkingLayer, target-data-prototype=spotId}, tlv-data-id=0}
      {data-prototype=Psd2_PPort.automatedParkingLayer, element-in-impl-datatype={root-data-prototype=automatedParkingLayer, target-data-prototype=laneRangeList}, tlv-data-id=1}
      {data-prototype=Psd2_PPort.automatedParkingLayer, element-in-impl-datatype={root-data-prototype=automatedParkingLayer, target-data-prototype=linkRangeList}, tlv-data-id=2}
      {data-prototype=Psd2_PPort.automatedParkingLayer, element-in-impl-datatype={root-data-prototype=automatedParkingLayer, target-data-prototype=localId}, tlv-data-id=1}
      {data-prototype=Psd2_PPort.automatedParkingLayer, element-in-impl-datatype={root-data-prototype=automatedParkingLayer, target-data-prototype=referenceBaseIndex}, tlv-data-id=0}
      {data-prototype=Psd2_PPort.automatedParkingLayer, element-in-impl-datatype={root-data-prototype=automatedParkingLayer, target-data-prototype=inPositiveDirection}, tlv-data-id=2}
      {data-prototype=Psd2_PPort.automatedParkingLayer, element-in-impl-datatype={root-data-prototype=automatedParkingLayer, target-data-prototype=arrayMember}, tlv-data-id=0}
      {data-prototype=Psd2_PPort.automatedParkingLayer, element-in-impl-datatype={root-data-prototype=automatedParkingLayer, target-data-prototype=reference}, tlv-data-id=0}
      {data-prototype=Psd2_PPort.automatedParkingLayer, element-in-impl-datatype={root-data-prototype=automatedParkingLayer, target-data-prototype=offset}, tlv-data-id=1}
      {data-prototype=Psd2_PPort.automatedParkingLayer, element-in-impl-datatype={root-data-prototype=automatedParkingLayer, target-data-prototype=localId}, tlv-data-id=1}
      {data-prototype=Psd2_PPort.automatedParkingLayer, element-in-impl-datatype={root-data-prototype=automatedParkingLayer, target-data-prototype=referenceBaseIndex}, tlv-data-id=0}
      {data-prototype=Psd2_PPort.automatedParkingLayer, element-in-impl-datatype={root-data-prototype=automatedParkingLayer, target-data-prototype=inPositiveDirection}, tlv-data-id=2}
      {data-prototype=Psd2_PPort.automatedParkingLayer, element-in-impl-datatype={root-data-prototype=automatedParkingLayer, target-data-prototype=arrayMember}, tlv-data-id=0}
      {data-prototype=Psd2_PPort.automatedParkingLayer, element-in-impl-datatype={root-data-prototype=automatedParkingLayer, target-data-prototype=reference}, tlv-data-id=0}
      {data-prototype=Psd2_PPort.automatedParkingLayer, element-in-impl-datatype={root-data-prototype=automatedParkingLayer, target-data-prototype=offset}, tlv-data-id=1}
      {data-prototype=Psd2_PPort.automatedParkingLayer, element-in-impl-datatype={root-data-prototype=automatedParkingLayer, target-data-prototype=localId}, tlv-data-id=1}
      {data-prototype=Psd2_PPort.automatedParkingLayer, element-in-impl-datatype={root-data-prototype=automatedParkingLayer, target-data-prototype=referenceBaseIndex}, tlv-data-id=0}
      {data-prototype=Psd2_PPort.automatedParkingLayer, element-in-impl-datatype={root-data-prototype=automatedParkingLayer, target-data-prototype=inPositiveDirection}, tlv-data-id=2}
      {data-prototype=Psd2_PPort.automatedParkingLayer, element-in-impl-datatype={root-data-prototype=automatedParkingLayer, target-data-prototype=arrayMember}, tlv-data-id=0}
      {data-prototype=Psd2_PPort.automatedParkingLayer, element-in-impl-datatype={root-data-prototype=automatedParkingLayer, target-data-prototype=localId}, tlv-data-id=1}
      {data-prototype=Psd2_PPort.automatedParkingLayer, element-in-impl-datatype={root-data-prototype=automatedParkingLayer, target-data-prototype=referenceBaseIndex}, tlv-data-id=0}
      {data-prototype=Psd2_PPort.automatedParkingLayer, element-in-impl-datatype={root-data-prototype=automatedParkingLayer, target-data-prototype=inPositiveDirection}, tlv-data-id=2}
      {data-prototype=Psd2_PPort.automatedParkingLayer, element-in-impl-datatype={root-data-prototype=automatedParkingLayer, target-data-prototype=arrayMember}, tlv-data-id=0}
      {data-prototype=Psd2_PPort.automatedParkingLayer, element-in-impl-datatype={root-data-prototype=automatedParkingLayer, target-data-prototype=reference}, tlv-data-id=0}
      {data-prototype=Psd2_PPort.automatedParkingLayer, element-in-impl-datatype={root-data-prototype=automatedParkingLayer, target-data-prototype=offset}, tlv-data-id=1}
      {data-prototype=Psd2_PPort.automatedParkingLayer, element-in-impl-datatype={root-data-prototype=automatedParkingLayer, target-data-prototype=localId}, tlv-data-id=1}
      {data-prototype=Psd2_PPort.automatedParkingLayer, element-in-impl-datatype={root-data-prototype=automatedParkingLayer, target-data-prototype=referenceBaseIndex}, tlv-data-id=0}
      {data-prototype=Psd2_PPort.automatedParkingLayer, element-in-impl-datatype={root-data-prototype=automatedParkingLayer, target-data-prototype=inPositiveDirection}, tlv-data-id=2}
      {data-prototype=Psd2_PPort.automatedParkingLayer, element-in-impl-datatype={root-data-prototype=automatedParkingLayer, target-data-prototype=arrayMember}, tlv-data-id=0}
      {data-prototype=Psd2_PPort.automatedParkingLayer, element-in-impl-datatype={root-data-prototype=automatedParkingLayer, target-data-prototype=reference}, tlv-data-id=0}
      {data-prototype=Psd2_PPort.automatedParkingLayer, element-in-impl-datatype={root-data-prototype=automatedParkingLayer, target-data-prototype=offset}, tlv-data-id=1}
      {data-prototype=Psd2_PPort.automatedParkingLayer, element-in-impl-datatype={root-data-prototype=automatedParkingLayer, target-data-prototype=localId}, tlv-data-id=1}
      {data-prototype=Psd2_PPort.automatedParkingLayer, element-in-impl-datatype={root-data-prototype=automatedParkingLayer, target-data-prototype=referenceBaseIndex}, tlv-data-id=0}
      {data-prototype=Psd2_PPort.automatedParkingLayer, element-in-impl-datatype={root-data-prototype=automatedParkingLayer, target-data-prototype=inPositiveDirection}, tlv-data-id=2}
      {data-prototype=Psd2_PPort.automatedParkingLayer, element-in-impl-datatype={root-data-prototype=automatedParkingLayer, target-data-prototype=parkingSectionType}, tlv-data-id=0}
      {data-prototype=Psd2_PPort.automatedParkingLayer, element-in-impl-datatype={root-data-prototype=automatedParkingLayer, target-data-prototype=name}, tlv-data-id=0}
      {data-prototype=Psd2_PPort.automatedParkingLayer, element-in-impl-datatype={root-data-prototype=automatedParkingLayer, target-data-prototype=arrayMember}, tlv-data-id=0}
      {data-prototype=Psd2_PPort.automatedParkingLayer, element-in-impl-datatype={root-data-prototype=automatedParkingLayer, target-data-prototype=longitude}, tlv-data-id=0}
      {data-prototype=Psd2_PPort.automatedParkingLayer, element-in-impl-datatype={root-data-prototype=automatedParkingLayer, target-data-prototype=latitude}, tlv-data-id=1}
      {data-prototype=Psd2_PPort.automatedParkingLayer, element-in-impl-datatype={root-data-prototype=automatedParkingLayer, target-data-prototype=height}, tlv-data-id=2}
      {data-prototype=Psd2_PPort.automatedParkingLayer, element-in-impl-datatype={root-data-prototype=automatedParkingLayer, target-data-prototype=arrayMember}, tlv-data-id=0}
      {data-prototype=Psd2_PPort.automatedParkingLayer, element-in-impl-datatype={root-data-prototype=automatedParkingLayer, target-data-prototype=areaId}, tlv-data-id=0}
      {data-prototype=Psd2_PPort.automatedParkingLayer, element-in-impl-datatype={root-data-prototype=automatedParkingLayer, target-data-prototype=areaType}, tlv-data-id=1}
      {data-prototype=Psd2_PPort.automatedParkingLayer, element-in-impl-datatype={root-data-prototype=automatedParkingLayer, target-data-prototype=outerBoundary}, tlv-data-id=2}
      {data-prototype=Psd2_PPort.automatedParkingLayer, element-in-impl-datatype={root-data-prototype=automatedParkingLayer, target-data-prototype=parkingAreaType}, tlv-data-id=0}
      {data-prototype=Psd2_PPort.automatedParkingLayer, element-in-impl-datatype={root-data-prototype=automatedParkingLayer, target-data-prototype=arrayMember}, tlv-data-id=0}
      {data-prototype=Psd2_PPort.automatedParkingLayer, element-in-impl-datatype={root-data-prototype=automatedParkingLayer, target-data-prototype=longitude}, tlv-data-id=0}
      {data-prototype=Psd2_PPort.automatedParkingLayer, element-in-impl-datatype={root-data-prototype=automatedParkingLayer, target-data-prototype=latitude}, tlv-data-id=1}
      {data-prototype=Psd2_PPort.automatedParkingLayer, element-in-impl-datatype={root-data-prototype=automatedParkingLayer, target-data-prototype=height}, tlv-data-id=2}
      {data-prototype=Psd2_PPort.automatedParkingLayer, element-in-impl-datatype={root-data-prototype=automatedParkingLayer, target-data-prototype=arrayMember}, tlv-data-id=0}
      {data-prototype=Psd2_PPort.automatedParkingLayer, element-in-impl-datatype={root-data-prototype=automatedParkingLayer, target-data-prototype=localId}, tlv-data-id=1}
      {data-prototype=Psd2_PPort.automatedParkingLayer, element-in-impl-datatype={root-data-prototype=automatedParkingLayer, target-data-prototype=referenceBaseIndex}, tlv-data-id=0}
      {data-prototype=Psd2_PPort.automatedParkingLayer, element-in-impl-datatype={root-data-prototype=automatedParkingLayer, target-data-prototype=inPositiveDirection}, tlv-data-id=2}
      {data-prototype=Psd2_PPort.automatedParkingLayer, element-in-impl-datatype={root-data-prototype=automatedParkingLayer, target-data-prototype=arrayMember}, tlv-data-id=0}
      {data-prototype=Psd2_PPort.automatedParkingLayer, element-in-impl-datatype={root-data-prototype=automatedParkingLayer, target-data-prototype=parkingRowId}, tlv-data-id=0}
      {data-prototype=Psd2_PPort.automatedParkingLayer, element-in-impl-datatype={root-data-prototype=automatedParkingLayer, target-data-prototype=laneRangeList}, tlv-data-id=1}
      {data-prototype=Psd2_PPort.automatedParkingLayer, element-in-impl-datatype={root-data-prototype=automatedParkingLayer, target-data-prototype=linkRangeList}, tlv-data-id=2}
      {data-prototype=Psd2_PPort.automatedParkingLayer, element-in-impl-datatype={root-data-prototype=automatedParkingLayer, target-data-prototype=parkingSpotList}, tlv-data-id=3}
      {data-prototype=Psd2_PPort.automatedParkingLayer, element-in-impl-datatype={root-data-prototype=automatedParkingLayer, target-data-prototype=localId}, tlv-data-id=1}
      {data-prototype=Psd2_PPort.automatedParkingLayer, element-in-impl-datatype={root-data-prototype=automatedParkingLayer, target-data-prototype=referenceBaseIndex}, tlv-data-id=0}
      {data-prototype=Psd2_PPort.automatedParkingLayer, element-in-impl-datatype={root-data-prototype=automatedParkingLayer, target-data-prototype=inPositiveDirection}, tlv-data-id=2}
      {data-prototype=Psd2_PPort.automatedParkingLayer, element-in-impl-datatype={root-data-prototype=automatedParkingLayer, target-data-prototype=arrayMember}, tlv-data-id=0}
      {data-prototype=Psd2_PPort.automatedParkingLayer, element-in-impl-datatype={root-data-prototype=automatedParkingLayer, target-data-prototype=reference}, tlv-data-id=0}
      {data-prototype=Psd2_PPort.automatedParkingLayer, element-in-impl-datatype={root-data-prototype=automatedParkingLayer, target-data-prototype=rangeStart}, tlv-data-id=1}
      {data-prototype=Psd2_PPort.automatedParkingLayer, element-in-impl-datatype={root-data-prototype=automatedParkingLayer, target-data-prototype=rangeEnd}, tlv-data-id=2}
      {data-prototype=Psd2_PPort.automatedParkingLayer, element-in-impl-datatype={root-data-prototype=automatedParkingLayer, target-data-prototype=localId}, tlv-data-id=1}
      {data-prototype=Psd2_PPort.automatedParkingLayer, element-in-impl-datatype={root-data-prototype=automatedParkingLayer, target-data-prototype=referenceBaseIndex}, tlv-data-id=0}
      {data-prototype=Psd2_PPort.automatedParkingLayer, element-in-impl-datatype={root-data-prototype=automatedParkingLayer, target-data-prototype=inPositiveDirection}, tlv-data-id=2}
      {data-prototype=Psd2_PPort.automatedParkingLayer, element-in-impl-datatype={root-data-prototype=automatedParkingLayer, target-data-prototype=arrayMember}, tlv-data-id=0}
      {data-prototype=Psd2_PPort.automatedParkingLayer, element-in-impl-datatype={root-data-prototype=automatedParkingLayer, target-data-prototype=reference}, tlv-data-id=0}
      {data-prototype=Psd2_PPort.automatedParkingLayer, element-in-impl-datatype={root-data-prototype=automatedParkingLayer, target-data-prototype=rangeStart}, tlv-data-id=1}
      {data-prototype=Psd2_PPort.automatedParkingLayer, element-in-impl-datatype={root-data-prototype=automatedParkingLayer, target-data-prototype=rangeEnd}, tlv-data-id=2}
      {data-prototype=Psd2_PPort.automatedParkingLayer, element-in-impl-datatype={root-data-prototype=automatedParkingLayer, target-data-prototype=localId}, tlv-data-id=1}
      {data-prototype=Psd2_PPort.automatedParkingLayer, element-in-impl-datatype={root-data-prototype=automatedParkingLayer, target-data-prototype=referenceBaseIndex}, tlv-data-id=0}
      {data-prototype=Psd2_PPort.automatedParkingLayer, element-in-impl-datatype={root-data-prototype=automatedParkingLayer, target-data-prototype=inPositiveDirection}, tlv-data-id=2}
      {data-prototype=Psd2_PPort.automatedParkingLayer, element-in-impl-datatype={root-data-prototype=automatedParkingLayer, target-data-prototype=spotId}, tlv-data-id=0}
      {data-prototype=Psd2_PPort.automatedParkingLayer, element-in-impl-datatype={root-data-prototype=automatedParkingLayer, target-data-prototype=laneRangeList}, tlv-data-id=1}
      {data-prototype=Psd2_PPort.automatedParkingLayer, element-in-impl-datatype={root-data-prototype=automatedParkingLayer, target-data-prototype=linkRangeList}, tlv-data-id=2}
      {data-prototype=Psd2_PPort.automatedParkingLayer, element-in-impl-datatype={root-data-prototype=automatedParkingLayer, target-data-prototype=localId}, tlv-data-id=1}
      {data-prototype=Psd2_PPort.automatedParkingLayer, element-in-impl-datatype={root-data-prototype=automatedParkingLayer, target-data-prototype=referenceBaseIndex}, tlv-data-id=0}
      {data-prototype=Psd2_PPort.automatedParkingLayer, element-in-impl-datatype={root-data-prototype=automatedParkingLayer, target-data-prototype=inPositiveDirection}, tlv-data-id=2}
      {data-prototype=Psd2_PPort.automatedParkingLayer, element-in-impl-datatype={root-data-prototype=automatedParkingLayer, target-data-prototype=arrayMember}, tlv-data-id=0}
      {data-prototype=Psd2_PPort.automatedParkingLayer, element-in-impl-datatype={root-data-prototype=automatedParkingLayer, target-data-prototype=reference}, tlv-data-id=0}
      {data-prototype=Psd2_PPort.automatedParkingLayer, element-in-impl-datatype={root-data-prototype=automatedParkingLayer, target-data-prototype=offset}, tlv-data-id=1}
      {data-prototype=Psd2_PPort.automatedParkingLayer, element-in-impl-datatype={root-data-prototype=automatedParkingLayer, target-data-prototype=localId}, tlv-data-id=1}
      {data-prototype=Psd2_PPort.automatedParkingLayer, element-in-impl-datatype={root-data-prototype=automatedParkingLayer, target-data-prototype=referenceBaseIndex}, tlv-data-id=0}
      {data-prototype=Psd2_PPort.automatedParkingLayer, element-in-impl-datatype={root-data-prototype=automatedParkingLayer, target-data-prototype=inPositiveDirection}, tlv-data-id=2}
      {data-prototype=Psd2_PPort.automatedParkingLayer, element-in-impl-datatype={root-data-prototype=automatedParkingLayer, target-data-prototype=arrayMember}, tlv-data-id=0}
      {data-prototype=Psd2_PPort.automatedParkingLayer, element-in-impl-datatype={root-data-prototype=automatedParkingLayer, target-data-prototype=reference}, tlv-data-id=0}
      {data-prototype=Psd2_PPort.automatedParkingLayer, element-in-impl-datatype={root-data-prototype=automatedParkingLayer, target-data-prototype=offset}, tlv-data-id=1}
      {data-prototype=Psd2_PPort.automatedParkingLayer, element-in-impl-datatype={root-data-prototype=automatedParkingLayer, target-data-prototype=localId}, tlv-data-id=1}
      {data-prototype=Psd2_PPort.automatedParkingLayer, element-in-impl-datatype={root-data-prototype=automatedParkingLayer, target-data-prototype=referenceBaseIndex}, tlv-data-id=0}
      {data-prototype=Psd2_PPort.automatedParkingLayer, element-in-impl-datatype={root-data-prototype=automatedParkingLayer, target-data-prototype=inPositiveDirection}, tlv-data-id=2}
      {data-prototype=Psd2_PPort.automatedParkingLayer, element-in-impl-datatype={root-data-prototype=automatedParkingLayer, target-data-prototype=arrayMember}, tlv-data-id=0}
      {data-prototype=Psd2_PPort.automatedParkingLayer, element-in-impl-datatype={root-data-prototype=automatedParkingLayer, target-data-prototype=longitude}, tlv-data-id=0}
      {data-prototype=Psd2_PPort.automatedParkingLayer, element-in-impl-datatype={root-data-prototype=automatedParkingLayer, target-data-prototype=latitude}, tlv-data-id=1}
      {data-prototype=Psd2_PPort.automatedParkingLayer, element-in-impl-datatype={root-data-prototype=automatedParkingLayer, target-data-prototype=height}, tlv-data-id=2}
      {data-prototype=Psd2_PPort.automatedParkingLayer, element-in-impl-datatype={root-data-prototype=automatedParkingLayer, target-data-prototype=parkingFacilityType}, tlv-data-id=0}
      {data-prototype=Psd2_PPort.automatedParkingLayer, element-in-impl-datatype={root-data-prototype=automatedParkingLayer, target-data-prototype=localId}, tlv-data-id=1}
      {data-prototype=Psd2_PPort.automatedParkingLayer, element-in-impl-datatype={root-data-prototype=automatedParkingLayer, target-data-prototype=referenceBaseIndex}, tlv-data-id=0}
      {data-prototype=Psd2_PPort.automatedParkingLayer, element-in-impl-datatype={root-data-prototype=automatedParkingLayer, target-data-prototype=inPositiveDirection}, tlv-data-id=2}
      {data-prototype=Psd2_PPort.automatedParkingLayer, element-in-impl-datatype={root-data-prototype=automatedParkingLayer, target-data-prototype=referenceBaseList}, tlv-data-id=0}
      {data-prototype=Psd2_PPort.automatedParkingLayer, element-in-impl-datatype={root-data-prototype=automatedParkingLayer, target-data-prototype=metaDataList}, tlv-data-id=1}
      {data-prototype=Psd2_PPort.automatedParkingLayer, element-in-impl-datatype={root-data-prototype=automatedParkingLayer, target-data-prototype=arrayMember}, tlv-data-id=0}
      {data-prototype=Psd2_PPort.automatedParkingLayer, element-in-impl-datatype={root-data-prototype=automatedParkingLayer, target-data-prototype=productId}, tlv-data-id=0}
      {data-prototype=Psd2_PPort.automatedParkingLayer, element-in-impl-datatype={root-data-prototype=automatedParkingLayer, target-data-prototype=updateRegion}, tlv-data-id=1}
      {data-prototype=Psd2_PPort.automatedParkingLayer, element-in-impl-datatype={root-data-prototype=automatedParkingLayer, target-data-prototype=tileId}, tlv-data-id=2}
      {data-prototype=Psd2_PPort.automatedParkingLayer, element-in-impl-datatype={root-data-prototype=automatedParkingLayer, target-data-prototype=arrayMember}, tlv-data-id=0}
      {data-prototype=Psd2_PPort.automatedParkingLayer, element-in-impl-datatype={root-data-prototype=automatedParkingLayer, target-data-prototype=countryCode}, tlv-data-id=0}
      {data-prototype=Psd2_PPort.automatedParkingLayer, element-in-impl-datatype={root-data-prototype=automatedParkingLayer, target-data-prototype=regionCode}, tlv-data-id=1}
      {data-prototype=Psd2_PPort.automatedParkingLayer, element-in-impl-datatype={root-data-prototype=automatedParkingLayer, target-data-prototype=mapAge}, tlv-data-id=2}
      {data-prototype=Psd2_PPort.automatedParkingLayer, element-in-impl-datatype={root-data-prototype=automatedParkingLayer, target-data-prototype=qualityIndicators}, tlv-data-id=3}
      {data-prototype=Psd2_PPort.automatedParkingLayer, element-in-impl-datatype={root-data-prototype=automatedParkingLayer, target-data-prototype=trafficDirection}, tlv-data-id=4}
      {data-prototype=Psd2_PPort.automatedParkingLayer, element-in-impl-datatype={root-data-prototype=automatedParkingLayer, target-data-prototype=generalSpeedLimits}, tlv-data-id=5}
      {data-prototype=Psd2_PPort.automatedParkingLayer, element-in-impl-datatype={root-data-prototype=automatedParkingLayer, target-data-prototype=speedUnit}, tlv-data-id=6}
      {data-prototype=Psd2_PPort.automatedParkingLayer, element-in-impl-datatype={root-data-prototype=automatedParkingLayer, target-data-prototype=month}, tlv-data-id=0}
      {data-prototype=Psd2_PPort.automatedParkingLayer, element-in-impl-datatype={root-data-prototype=automatedParkingLayer, target-data-prototype=year}, tlv-data-id=1}
      {data-prototype=Psd2_PPort.automatedParkingLayer, element-in-impl-datatype={root-data-prototype=automatedParkingLayer, target-data-prototype=arrayMember}, tlv-data-id=0}
      {data-prototype=Psd2_PPort.automatedParkingLayer, element-in-impl-datatype={root-data-prototype=automatedParkingLayer, target-data-prototype=type}, tlv-data-id=0}
      {data-prototype=Psd2_PPort.automatedParkingLayer, element-in-impl-datatype={root-data-prototype=automatedParkingLayer, target-data-prototype=quality}, tlv-data-id=1}
      {data-prototype=Psd2_PPort.automatedParkingLayer, element-in-impl-datatype={root-data-prototype=automatedParkingLayer, target-data-prototype=qualityIndicatorType}, tlv-data-id=0}
      {data-prototype=Psd2_PPort.automatedParkingLayer, element-in-impl-datatype={root-data-prototype=automatedParkingLayer, target-data-prototype=trafficDirection}, tlv-data-id=0}
      {data-prototype=Psd2_PPort.automatedParkingLayer, element-in-impl-datatype={root-data-prototype=automatedParkingLayer, target-data-prototype=arrayMember}, tlv-data-id=0}
      {data-prototype=Psd2_PPort.automatedParkingLayer, element-in-impl-datatype={root-data-prototype=automatedParkingLayer, target-data-prototype=type}, tlv-data-id=0}
      {data-prototype=Psd2_PPort.automatedParkingLayer, element-in-impl-datatype={root-data-prototype=automatedParkingLayer, target-data-prototype=speedValue}, tlv-data-id=1}
      {data-prototype=Psd2_PPort.automatedParkingLayer, element-in-impl-datatype={root-data-prototype=automatedParkingLayer, target-data-prototype=constraint}, tlv-data-id=3}
      {data-prototype=Psd2_PPort.automatedParkingLayer, element-in-impl-datatype={root-data-prototype=automatedParkingLayer, target-data-prototype=generalSpeedLimitType}, tlv-data-id=0}
      {data-prototype=Psd2_PPort.automatedParkingLayer, element-in-impl-datatype={root-data-prototype=automatedParkingLayer, target-data-prototype=arrayMember}, tlv-data-id=0}
      {data-prototype=Psd2_PPort.automatedParkingLayer, element-in-impl-datatype={root-data-prototype=automatedParkingLayer, target-data-prototype=daysOfWeek}, tlv-data-id=0}
      {data-prototype=Psd2_PPort.automatedParkingLayer, element-in-impl-datatype={root-data-prototype=automatedParkingLayer, target-data-prototype=timeRangeOfDay}, tlv-data-id=1}
      {data-prototype=Psd2_PPort.automatedParkingLayer, element-in-impl-datatype={root-data-prototype=automatedParkingLayer, target-data-prototype=weatherConstraint}, tlv-data-id=2}
      {data-prototype=Psd2_PPort.automatedParkingLayer, element-in-impl-datatype={root-data-prototype=automatedParkingLayer, target-data-prototype=timeClassifier}, tlv-data-id=3}
      {data-prototype=Psd2_PPort.automatedParkingLayer, element-in-impl-datatype={root-data-prototype=automatedParkingLayer, target-data-prototype=zoneClassifier}, tlv-data-id=4}
      {data-prototype=Psd2_PPort.automatedParkingLayer, element-in-impl-datatype={root-data-prototype=automatedParkingLayer, target-data-prototype=applicableVehicles}, tlv-data-id=5}
      {data-prototype=Psd2_PPort.automatedParkingLayer, element-in-impl-datatype={root-data-prototype=automatedParkingLayer, target-data-prototype=turnConstraint}, tlv-data-id=6}
      {data-prototype=Psd2_PPort.automatedParkingLayer, element-in-impl-datatype={root-data-prototype=automatedParkingLayer, target-data-prototype=arrayMember}, tlv-data-id=0}
      {data-prototype=Psd2_PPort.automatedParkingLayer, element-in-impl-datatype={root-data-prototype=automatedParkingLayer, target-data-prototype=startTimeHour}, tlv-data-id=0}
      {data-prototype=Psd2_PPort.automatedParkingLayer, element-in-impl-datatype={root-data-prototype=automatedParkingLayer, target-data-prototype=startTimeMinute}, tlv-data-id=1}
      {data-prototype=Psd2_PPort.automatedParkingLayer, element-in-impl-datatype={root-data-prototype=automatedParkingLayer, target-data-prototype=endTimeHour}, tlv-data-id=2}
      {data-prototype=Psd2_PPort.automatedParkingLayer, element-in-impl-datatype={root-data-prototype=automatedParkingLayer, target-data-prototype=endTimeMinute}, tlv-data-id=3}
      {data-prototype=Psd2_PPort.automatedParkingLayer, element-in-impl-datatype={root-data-prototype=automatedParkingLayer, target-data-prototype=Weather}, tlv-data-id=0}
      {data-prototype=Psd2_PPort.automatedParkingLayer, element-in-impl-datatype={root-data-prototype=automatedParkingLayer, target-data-prototype=timeConstraintType}, tlv-data-id=0}
      {data-prototype=Psd2_PPort.automatedParkingLayer, element-in-impl-datatype={root-data-prototype=automatedParkingLayer, target-data-prototype=zoneConstraintType}, tlv-data-id=0}
      {data-prototype=Psd2_PPort.automatedParkingLayer, element-in-impl-datatype={root-data-prototype=automatedParkingLayer, target-data-prototype=applicableVehiclesType}, tlv-data-id=0}
      {data-prototype=Psd2_PPort.automatedParkingLayer, element-in-impl-datatype={root-data-prototype=automatedParkingLayer, target-data-prototype=turnConstraint}, tlv-data-id=0}
      {data-prototype=Psd2_PPort.automatedParkingLayer, element-in-impl-datatype={root-data-prototype=automatedParkingLayer, target-data-prototype=speedUnit}, tlv-data-id=0}
      {data-prototype=Psd2_PPort.timezoneInformation, element-in-impl-datatype={root-data-prototype=timezoneInformation, target-data-prototype=id}, tlv-data-id=0}
      {data-prototype=Psd2_PPort.timezoneInformation, element-in-impl-datatype={root-data-prototype=timezoneInformation, target-data-prototype=timezoneInformation}, tlv-data-id=1}
      {data-prototype=Psd2_PPort.timezoneInformation, element-in-impl-datatype={root-data-prototype=timezoneInformation, target-data-prototype=type}, tlv-data-id=0}
      {data-prototype=Psd2_PPort.timezoneInformation, element-in-impl-datatype={root-data-prototype=timezoneInformation, target-data-prototype=timezoneST}, tlv-data-id=1}
      {data-prototype=Psd2_PPort.timezoneInformation, element-in-impl-datatype={root-data-prototype=timezoneInformation, target-data-prototype=timezoneDST}, tlv-data-id=2}
      {data-prototype=Psd2_PPort.timezoneInformation, element-in-impl-datatype={root-data-prototype=timezoneInformation, target-data-prototype=timezoneDSTactive}, tlv-data-id=3}
      {data-prototype=Psd2_PPort.timezoneInformation, element-in-impl-datatype={root-data-prototype=timezoneInformation, target-data-prototype=timezoneInformationType}, tlv-data-id=0}
      {data-prototype=Psd2_PPort.timezoneInformation, element-in-impl-datatype={root-data-prototype=timezoneInformation, target-data-prototype=timezoneOffsetUtcHours}, tlv-data-id=0}
      {data-prototype=Psd2_PPort.timezoneInformation, element-in-impl-datatype={root-data-prototype=timezoneInformation, target-data-prototype=timezoneOffsetUtcMinutes}, tlv-data-id=1}
      {data-prototype=Psd2_PPort.timezoneInformation, element-in-impl-datatype={root-data-prototype=timezoneInformation, target-data-prototype=year}, tlv-data-id=2}
      {data-prototype=Psd2_PPort.timezoneInformation, element-in-impl-datatype={root-data-prototype=timezoneInformation, target-data-prototype=monthOfYear}, tlv-data-id=3}
      {data-prototype=Psd2_PPort.timezoneInformation, element-in-impl-datatype={root-data-prototype=timezoneInformation, target-data-prototype=dayOfMonth}, tlv-data-id=4}
      {data-prototype=Psd2_PPort.timezoneInformation, element-in-impl-datatype={root-data-prototype=timezoneInformation, target-data-prototype=hourOfDay}, tlv-data-id=5}
      {data-prototype=Psd2_PPort.timezoneInformation, element-in-impl-datatype={root-data-prototype=timezoneInformation, target-data-prototype=minuteOfHour}, tlv-data-id=6}
      {data-prototype=Psd2_PPort.timezoneInformation, element-in-impl-datatype={root-data-prototype=timezoneInformation, target-data-prototype=timezoneOffsetUtcHours}, tlv-data-id=0}
      {data-prototype=Psd2_PPort.timezoneInformation, element-in-impl-datatype={root-data-prototype=timezoneInformation, target-data-prototype=timezoneOffsetUtcMinutes}, tlv-data-id=1}
      {data-prototype=Psd2_PPort.timezoneInformation, element-in-impl-datatype={root-data-prototype=timezoneInformation, target-data-prototype=year}, tlv-data-id=2}
      {data-prototype=Psd2_PPort.timezoneInformation, element-in-impl-datatype={root-data-prototype=timezoneInformation, target-data-prototype=monthOfYear}, tlv-data-id=3}
      {data-prototype=Psd2_PPort.timezoneInformation, element-in-impl-datatype={root-data-prototype=timezoneInformation, target-data-prototype=dayOfMonth}, tlv-data-id=4}
      {data-prototype=Psd2_PPort.timezoneInformation, element-in-impl-datatype={root-data-prototype=timezoneInformation, target-data-prototype=hourOfDay}, tlv-data-id=5}
      {data-prototype=Psd2_PPort.timezoneInformation, element-in-impl-datatype={root-data-prototype=timezoneInformation, target-data-prototype=minuteOfHour}, tlv-data-id=6}
