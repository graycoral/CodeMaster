AUTOSAR XML (schema 00043)
package /vwg/applications/Basis__ICAS3_Sys_IVI_01
  executable Basis__ICAS3_Sys_IVI_01_Exe
    root sw component prototype Basis__ICAS3_Sys_IVI_01: application-type=Basis__ICAS3_Sys_IVI_01
  process Basis__ICAS3_Sys_IVI_01_instance1: executable=Basis__ICAS3_Sys_IVI_01_Exe, mode-dependent-startup-config{machine-mode=ICAS3MachineMode.Startup, startup-config=Startup}
    application mode machine BasisModes: type=ApplicationStates
  process to machine mapping set basis_app_MachineMappingSet
    process to machine mapping basis_app_MachineMapping: machine=ICAS3Machine, process=Basis__ICAS3_Sys_IVI_01_instance1
  adaptive autosar application ICAS3_Basis_App: category=PLATFORM_LEVEL, executable=Basis__ICAS3_Sys_IVI_01_Exe
  startup config set ICAS3_BasisConfigs
    startup config Startup: scheduling-policy=SCHEDULING-POLICY-ROUND-ROBIN, scheduling-priority=10
      startup-options:
        option-argument=/opt/soc_app/etc/application.json, option-kind=COMMAND-LINE-SHORT-FORM, option-name=c
        option-kind=COMMAND-LINE-SHORT-FORM, option-name=v
