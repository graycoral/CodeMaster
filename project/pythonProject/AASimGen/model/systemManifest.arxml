AUTOSAR XML (schema 00043)
package /system
  ethernet cluster theEthCluster
    ethernet physical channel theEthPhysChannel
      5 x network endpoint:
        myNetworkEndpoint: network-endpoint-addresses=ipv-6-configuration={ip-address-prefix-length=64, ipv-6-address=fd53:7cb8:0383:0003:0000:0000:0000:0073, ipv-6-address-source=FIXED}
        mySDNetworkEndpoint: network-endpoint-addresses=ipv-6-configuration={ip-address-prefix-length=64, ipv-6-address=ff14:0000:0000:0000:0000:0000:0004:0000, ipv-6-address-source=FIXED}
        myNetworkEndpoint_1: network-endpoint-addresses=ipv-6-configuration={ip-address-prefix-length=64, ipv-6-address=fd53:7cb8:0383:0003:0000:0000:0000:0010, ipv-6-address-source=FIXED}
        myNetworkEndpoint_2: network-endpoint-addresses=ipv-6-configuration={ip-address-prefix-length=64, ipv-6-address=fd53:7cb8:0383:0003:0000:0000:0000:0106, ipv-6-address-source=FIXED}
        mySDNetworkEndpoint_1: network-endpoint-addresses=ipv-6-configuration={ip-address-prefix-length=64, ipv-6-address=ff14:0000:0000:0000:0000:0000:0005:0000, ipv-6-address-source=FIXED}
      vlan VLANConfig: vlan-identifier=4
