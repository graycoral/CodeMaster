[part 1 of 2: package /vwg/services/Psd2]
AUTOSAR XML (schema 00043)
package /vwg/services/Psd2
  service interface Psd2: service-interface-sub-element=opt-impl-record-elements=[{root-autosar-data-prototype=linkLayerLongRange, context-data-prototype=DT_linkLayerLongRange_vector/subElement, target-data-prototype=DT_linkLayerLongRange_struct/id}, {root-autosar-data-prototype=linkLayerLongRange, context-data-prototype=DT_linkLayerLongRange_vector/subElement, target-data-prototype=linkLayerLongRange}, {root-autosar-data-prototype=linkLayerLongRange, context-data-prototype=DT_linkLayerLongRange_vector/subElement, target-data-prototype=DT_linkLayerLongRange_struct/layerInfo}, {root-autosar-data-prototype=linkLayerLongRange, context-data-prototype=DT_linkLayerLongRangelinkLayerLongRange/subElement, target-data-prototype=DT_link/metaDataIndex}, {root-autosar-data-prototype=linkLayerLongRange, context-data-prototype=DT_linkLayerLongRangelinkLayerLongRange/subElement, target-data-prototype=fromLinkList}, {root-autosar-data-prototype=linkLayerLongRange, context-data-prototype=DT_linkLayerLongRangelinkLayerLongRange/subElement, target-data-prototype=toLinkList}, {root-autosar-data-prototype=linkLayerLongRange, context-data-prototype=DT_linkLayerLongRangelinkLayerLongRange/subElement, target-data-prototype=DT_link/linkType}, {root-autosar-data-prototype=linkLayerLongRange, context-data-prototype=DT_linkLayerLongRangelinkLayerLongRange/subElement, target-data-prototype=DT_link/reference}, {root-autosar-data-prototype=linkLayerLongRange, context-data-prototype=DT_linkLayerLongRangelinkLayerLongRange/subElement, target-data-prototype=controlledAccess}, {root-autosar-data-prototype=linkLayerLongRange, context-data-prototype=DT_linkLayerLongRangelinkLayerLongRange/subElement, target-data-prototype=drivingDirection}, {root-autosar-data-prototype=linkLayerLongRange, context-data-prototype=DT_linkLayerLongRangelinkLayerLongRange/subElement, target-data-prototype=DT_link/functionalRoadClass}, {root-autosar-data-prototype=linkLayerLongRange, context-data-prototype=DT_linkLayerLongRangelinkLayerLongRange/subElement, target-data-prototype=clothoidList}, {root-autosar-data-prototype=linkLayerLongRange, context-data-prototype=DT_linkLayerLongRangelinkLayerLongRange/subElement, target-data-prototype=polyline}, {root-autosar-data-prototype=linkLayerLongRange, context-data-prototype=DT_linkLayerLongRangelinkLayerLongRange/subElement, target-data-prototype=insideCityLimits}, {root-autosar-data-prototype=linkLayerLongRange, context-data-prototype=DT_linkLayerLongRangelinkLayerLongRange/subElement, target-data-prototype=tollway}, {root-autosar-data-prototype=linkLayerLongRange, context-data-prototype=DT_linkLayerLongRangelinkLayerLongRange/subElement, target-data-prototype=adas}, {root-autosar-data-prototype=linkLayerLongRange, context-data-prototype=DT_linkLayerLongRangelinkLayerLongRange/subElement, target-data-prototype=urban}, {root-autosar-data-prototype=linkLayerLongRange, context-data-prototype=DT_linkLayerLongRangelinkLayerLongRange/subElement, target-data-prototype=paved}, {root-autosar-data-prototype=linkLayerLongRange, context-data-prototype=DT_linkLayerLongRangelinkLayerLongRange/subElement, target-data-prototype=DT_link/attributeList}, {root-autosar-data-prototype=linkLayerLongRange, context-data-prototype=DT_linkLayerLongRangelinkLayerLongRange/subElement, target-data-prototype=avgSpeed}, {root-autosar-data-prototype=linkLayerLongRange, context-data-prototype=DT_linkLayerLongRangelinkLayerLongRange/subElement, target-data-prototype=rightOfWay}, {root-autosar-data-prototype=linkLayerLongRange, context-data-prototype=DT_linkLayerLongRangelinkLayerLongRange/subElement, target-data-prototype=DT_link/length}, {root-autosar-data-prototype=linkLayerLongRange, context-data-prototype=fromLinkList, target-data-prototype=DT_referenceList/arrayMember}, {root-autosar-data-prototype=linkLayerLongRange, context-data-prototype=DT_referenceList_arrayMember_ARRAY/subElement, target-data-prototype=localId}, {root-autosar-data-prototype=linkLayerLongRange, context-data-prototype=DT_referenceList_arrayMember_ARRAY/subElement, target-data-prototype=referenceBaseIndex}, {root-autosar-data-prototype=linkLayerLongRange, context-data-prototype=DT_referenceList_arrayMember_ARRAY/subElement, target-data-prototype=inPositiveDirection}, {root-autosar-data-prototype=linkLayerLongRange, context-data-prototype=toLinkList, target-data-prototype=DT_referenceList/arrayMember}, {root-autosar-data-prototype=linkLayerLongRange, context-data-prototype=DT_referenceList_arrayMember_ARRAY/subElement, target-data-prototype=localId}, {root-autosar-data-prototype=linkLayerLongRange, context-data-prototype=DT_referenceList_arrayMember_ARRAY/subElement, target-data-prototype=referenceBaseIndex}, {root-autosar-data-prototype=linkLayerLongRange, context-data-prototype=DT_referenceList_arrayMember_ARRAY/subElement, target-data-prototype=inPositiveDirection}, {root-autosar-data-prototype=linkLayerLongRange, context-data-prototype=DT_link/linkType, target-data-prototype=DT_linkType/linkType}, {root-autosar-data-prototype=linkLayerLongRange, context-data-prototype=DT_link/reference, target-data-prototype=localId}, {root-autosar-data-prototype=linkLayerLongRange, context-data-prototype=DT_link/reference, target-data-prototype=referenceBaseIndex}, {root-autosar-data-prototype=linkLayerLongRange, context-data-prototype=DT_link/reference, target-data-prototype=inPositiveDirection}, {root-autosar-data-prototype=linkLayerLongRange, context-data-prototype=drivingDirection, target-data-prototype=DT_direction/direction}, {root-autosar-data-prototype=linkLayerLongRange, context-data-prototype=DT_link/functionalRoadClass, target-data-prototype=DT_functionalRoadClass/functionalRoadClass}, {root-autosar-data-prototype=linkLayerLongRange, context-data-prototype=clothoidList, target-data-prototype=DT_clothoidList/arrayMember}, {root-autosar-data-prototype=linkLayerLongRange, context-data-prototype=DT_clothoidList_arrayMember_ARRAY/subElement, target-data-prototype=startCurvature}, {root-autosar-data-prototype=linkLayerLongRange, context-data-prototype=DT_clothoidList_arrayMember_ARRAY/subElement, target-data-prototype=endCurvature}, {root-autosar-data-prototype=linkLayerLongRange, context-data-prototype=DT_clothoidList_arrayMember_ARRAY/subElement, target-data-prototype=DT_clothoid/length}, {root-autosar-data-prototype=linkLayerLongRange, context-data-prototype=DT_clothoidList_arrayMember_ARRAY/subElement, target-data-prototype=angle}, {root-autosar-data-prototype=linkLayerLongRange, context-data-prototype=DT_clothoidList_arrayMember_ARRAY/subElement, target-data-prototype=ndsCoordinates}, {root-autosar-data-prototype=linkLayerLongRange, context-data-prototype=DT_clothoidList_arrayMember_ARRAY/subElement, target-data-prototype=geometryQuality}, {root-autosar-data-prototype=linkLayerLongRange, context-data-prototype=ndsCoordinates, target-data-prototype=longitude}, {root-autosar-data-prototype=linkLayerLongRange, context-data-prototype=ndsCoordinates, target-data-prototype=latitude}, {root-autosar-data-prototype=linkLayerLongRange, context-data-prototype=ndsCoordinates, target-data-prototype=DT_wgs84Coordinate/height}, {root-autosar-data-prototype=linkLayerLongRange, context-data-prototype=polyline, target-data-prototype=DT_polyline/arrayMember}, {root-autosar-data-prototype=linkLayerLongRange, context-data-prototype=DT_polyline_arrayMember_ARRAY/subElement, target-data-prototype=longitude}, {root-autosar-data-prototype=linkLayerLongRange, context-data-prototype=DT_polyline_arrayMember_ARRAY/subElement, target-data-prototype=latitude}, {root-autosar-data-prototype=linkLayerLongRange, context-data-prototype=DT_polyline_arrayMember_ARRAY/subElement, target-data-prototype=DT_wgs84Coordinate/height}, {root-autosar-data-prototype=linkLayerLongRange, context-data-prototype=adas, target-data-prototype=adasAccuracyType}, {root-autosar-data-prototype=linkLayerLongRange, context-data-prototype=DT_link/attributeList, target-data-prototype=DT_attributeList/arrayMember}, {root-autosar-data-prototype=linkLayerLongRange, context-data-prototype=DT_attributeList_arrayMember_ARRAY/subElement, target-data-prototype=DT_attribute/confidence}, {root-autosar-data-prototype=linkLayerLongRange, context-data-prototype=DT_attributeList_arrayMember_ARRAY/subElement, target-data-prototype=attributeType}, {root-autosar-data-prototype=linkLayerLongRange, context-data-prototype=DT_attributeList_arrayMember_ARRAY/subElement, target-data-prototype=DT_attribute/direction}, {root-autosar-data-prototype=linkLayerLongRange, context-data-prototype=DT_attributeList_arrayMember_ARRAY/subElement, target-data-prototype=attributePointList}, {root-autosar-data-prototype=linkLayerLongRange, context-data-prototype=DT_attribute/direction, target-data-prototype=DT_direction/direction}, {root-autosar-data-prototype=linkLayerLongRange, context-data-prototype=attributePointList, target-data-prototype=DT_attributePointList/arrayMember}, {root-autosar-data-prototype=linkLayerLongRange, context-data-prototype=DT_attributePointList_arrayMember_ARRAY/subElement, target-data-prototype=DT_attributePoint/offset}, {root-autosar-data-prototype=linkLayerLongRange, context-data-prototype=DT_attributePointList_arrayMember_ARRAY/subElement, target-data-prototype=attributeValue}, {root-autosar-data-prototype=linkLayerLongRange, context-data-prototype=DT_attributePointList_arrayMember_ARRAY/subElement, target-data-prototype=DT_attributePoint/laneList}, {root-autosar-data-prototype=linkLayerLongRange, context-data-prototype=attributeValue, target-data-prototype=intValue}, {root-autosar-data-prototype=linkLayerLongRange, context-data-prototype=attributeValue, target-data-prototype=floatValue}, {root-autosar-data-prototype=linkLayerLongRange, context-data-prototype=attributeValue, target-data-prototype=blobValue}, {root-autosar-data-prototype=linkLayerLongRange, context-data-prototype=attributeValue, target-data-prototype=speedLimit}, {root-autosar-data-prototype=linkLayerLongRange, context-data-prototype=attributeValue, target-data-prototype=overtakingProhibition}, {root-autosar-data-prototype=linkLayerLongRange, context-data-prototype=blobValue, target-data-prototype=DT_byteArray/arrayMember}, {root-autosar-data-prototype=linkLayerLongRange, context-data-prototype=speedLimit, target-data-prototype=DT_speedLimit/speedValue}, {root-autosar-data-prototype=linkLayerLongRange, context-data-prototype=speedLimit, target-data-prototype=source}, {root-autosar-data-prototype=linkLayerLongRange, context-data-prototype=speedLimit, target-data-prototype=DT_speedLimit/constraintList}, {root-autosar-data-prototype=linkLayerLongRange, context-data-prototype=speedLimit, target-data-prototype=DT_speedLimit/online}, {root-autosar-data-prototype=linkLayerLongRange, context-data-prototype=source, target-data-prototype=speedLimitSource}, {root-autosar-data-prototype=linkLayerLongRange, context-data-prototype=DT_speedLimit/constraintList, target-data-prototype=DT_constraintList/arrayMember}, {root-autosar-data-prototype=linkLayerLongRange, context-data-prototype=DT_constraintList_arrayMember_ARRAY/subElement, target-data-prototype=daysOfWeek}, {root-autosar-data-prototype=linkLayerLongRange, context-data-prototype=DT_constraintList_arrayMember_ARRAY/subElement, target-data-prototype=timeRangeOfDay}, {root-autosar-data-prototype=linkLayerLongRange, context-data-prototype=DT_constraintList_arrayMember_ARRAY/subElement, target-data-prototype=weatherConstraint}, {root-autosar-data-prototype=linkLayerLongRange, context-data-prototype=DT_constraintList_arrayMember_ARRAY/subElement, target-data-prototype=timeClassifier}, {root-autosar-data-prototype=linkLayerLongRange, context-data-prototype=DT_constraintList_arrayMember_ARRAY/subElement, target-data-prototype=zoneClassifier}, {root-autosar-data-prototype=linkLayerLongRange, context-data-prototype=DT_constraintList_arrayMember_ARRAY/subElement, target-data-prototype=applicableVehicles}, {root-autosar-data-prototype=linkLayerLongRange, context-data-prototype=DT_constraintList_arrayMember_ARRAY/subElement, target-data-prototype=DT_constraint/turnConstraint}, {root-autosar-data-prototype=linkLayerLongRange, context-data-prototype=daysOfWeek, target-data-prototype=DT_listOfDays/arrayMember}, {root-autosar-data-prototype=linkLayerLongRange, context-data-prototype=timeRangeOfDay, target-data-prototype=startTimeHour}, {root-autosar-data-prototype=linkLayerLongRange, context-data-prototype=timeRangeOfDay, target-data-prototype=startTimeMinute}, {root-autosar-data-prototype=linkLayerLongRange, context-data-prototype=timeRangeOfDay, target-data-prototype=endTimeHour}, {root-autosar-data-prototype=linkLayerLongRange, context-data-prototype=timeRangeOfDay, target-data-prototype=endTimeMinute}, {root-autosar-data-prototype=linkLayerLongRange, context-data-prototype=weatherConstraint, target-data-prototype=Weather}, {root-autosar-data-prototype=linkLayerLongRange, context-data-prototype=timeClassifier, target-data-prototype=timeConstraintType}, {root-autosar-data-prototype=linkLayerLongRange, context-data-prototype=zoneClassifier, target-data-prototype=zoneConstraintType}, {root-autosar-data-prototype=linkLayerLongRange, context-data-prototype=applicableVehicles, target-data-prototype=applicableVehiclesType}, {root-autosar-data-prototype=linkLayerLongRange, context-data-prototype=DT_constraint/turnConstraint, target-data-prototype=DT_turnConstraint/turnConstraint}, {root-autosar-data-prototype=linkLayerLongRange, context-data-prototype=overtakingProhibition, target-data-prototype=DT_overtakingProhibition/online}, {root-autosar-data-prototype=linkLayerLongRange, context-data-prototype=overtakingProhibition, target-data-prototype=DT_overtakingProhibition/constraintList}, {root-autosar-data-prototype=linkLayerLongRange, context-data-prototype=overtakingProhibition, target-data-prototype=DT_overtakingProhibition/type}, {root-autosar-data-prototype=linkLayerLongRange, context-data-prototype=DT_overtakingProhibition/constraintList, target-data-prototype=DT_constraintList/arrayMember}, {root-autosar-data-prototype=linkLayerLongRange, context-data-prototype=DT_constraintList_arrayMember_ARRAY/subElement, target-data-prototype=daysOfWeek}, {root-autosar-data-prototype=linkLayerLongRange, context-data-prototype=DT_constraintList_arrayMember_ARRAY/subElement, target-data-prototype=timeRangeOfDay}, {root-autosar-data-prototype=linkLayerLongRange, context-data-prototype=DT_constraintList_arrayMember_ARRAY/subElement, target-data-prototype=weatherConstraint}, {root-autosar-data-prototype=linkLayerLongRange, context-data-prototype=DT_constraintList_arrayMember_ARRAY/subElement, target-data-prototype=timeClassifier}, {root-autosar-data-prototype=linkLayerLongRange, context-data-prototype=DT_constraintList_arrayMember_ARRAY/subElement, target-data-prototype=zoneClassifier}, {root-autosar-data-prototype=linkLayerLongRange, context-data-prototype=DT_constraintList_arrayMember_ARRAY/subElement, target-data-prototype=applicableVehicles}, {root-autosar-data-prototype=linkLayerLongRange, context-data-prototype=DT_constraintList_arrayMember_ARRAY/subElement, target-data-prototype=DT_constraint/turnConstraint}, {root-autosar-data-prototype=linkLayerLongRange, context-data-prototype=daysOfWeek, target-data-prototype=DT_listOfDays/arrayMember}, {root-autosar-data-prototype=linkLayerLongRange, context-data-prototype=timeRangeOfDay, target-data-prototype=startTimeHour}, {root-autosar-data-prototype=linkLayerLongRange, context-data-prototype=timeRangeOfDay, target-data-prototype=startTimeMinute}, {root-autosar-data-prototype=linkLayerLongRange, context-data-prototype=timeRangeOfDay, target-data-prototype=endTimeHour}, {root-autosar-data-prototype=linkLayerLongRange, context-data-prototype=timeRangeOfDay, target-data-prototype=endTimeMinute}, {root-autosar-data-prototype=linkLayerLongRange, context-data-prototype=weatherConstraint, target-data-prototype=Weather}, {root-autosar-data-prototype=linkLayerLongRange, context-data-prototype=timeClassifier, target-data-prototype=timeConstraintType}, {root-autosar-data-prototype=linkLayerLongRange, context-data-prototype=zoneClassifier, target-data-prototype=zoneConstraintType}, {root-autosar-data-prototype=linkLayerLongRange, context-data-prototype=applicableVehicles, target-data-prototype=applicableVehiclesType}, {root-autosar-data-prototype=linkLayerLongRange, context-data-prototype=DT_constraint/turnConstraint, target-data-prototype=DT_turnConstraint/turnConstraint}, {root-autosar-data-prototype=linkLayerLongRange, context-data-prototype=DT_overtakingProhibition/type, target-data-prototype=overtakingProhibitionType}, {root-autosar-data-prototype=linkLayerLongRange, context-data-prototype=DT_attributePoint/laneList, target-data-prototype=DT_laneIndexList/arrayMember}, {root-autosar-data-prototype=linkLayerLongRange, context-data-prototype=rightOfWay, target-data-prototype=rightOfWayRegulation}, {root-autosar-data-prototype=linkLayerLongRange, context-data-prototype=DT_linkLayerLongRange_struct/layerInfo, target-data-prototype=referenceBaseList}, {root-autosar-data-prototype=linkLayerLongRange, context-data-prototype=DT_linkLayerLongRange_struct/layerInfo, target-data-prototype=metaDataList}, {root-autosar-data-prototype=linkLayerLongRange, context-data-prototype=referenceBaseList, target-data-prototype=DT_referenceBaseList/arrayMember}, {root-autosar-data-prototype=linkLayerLongRange, context-data-prototype=DT_referenceBaseList_arrayMember_ARRAY/subElement, target-data-prototype=productId}, {root-autosar-data-prototype=linkLayerLongRange, context-data-prototype=DT_referenceBaseList_arrayMember_ARRAY/subElement, target-data-prototype=updateRegion}, {root-autosar-data-prototype=linkLayerLongRange, context-data-prototype=DT_referenceBaseList_arrayMember_ARRAY/subElement, target-data-prototype=tileId}, {root-autosar-data-prototype=linkLayerLongRange, context-data-prototype=metaDataList, target-data-prototype=DT_metaDataList/arrayMember}, {root-autosar-data-prototype=linkLayerLongRange, context-data-prototype=DT_metaDataList_arrayMember_ARRAY/subElement, target-data-prototype=countryCode}, {root-autosar-data-prototype=linkLayerLongRange, context-data-prototype=DT_metaDataList_arrayMember_ARRAY/subElement, target-data-prototype=regionCode}, {root-autosar-data-prototype=linkLayerLongRange, context-data-prototype=DT_metaDataList_arrayMember_ARRAY/subElement, target-data-prototype=mapAge}, {root-autosar-data-prototype=linkLayerLongRange, context-data-prototype=DT_metaDataList_arrayMember_ARRAY/subElement, target-data-prototype=qualityIndicators}, {root-autosar-data-prototype=linkLayerLongRange, context-data-prototype=DT_metaDataList_arrayMember_ARRAY/subElement, target-data-prototype=DT_metaData/trafficDirection}, {root-autosar-data-prototype=linkLayerLongRange, context-data-prototype=DT_metaDataList_arrayMember_ARRAY/subElement, target-data-prototype=generalSpeedLimits}, {root-autosar-data-prototype=linkLayerLongRange, context-data-prototype=DT_metaDataList_arrayMember_ARRAY/subElement, target-data-prototype=DT_metaData/speedUnit}, {root-autosar-data-prototype=linkLayerLongRange, context-data-prototype=mapAge, target-data-prototype=month}, {root-autosar-data-prototype=linkLayerLongRange, context-data-prototype=mapAge, target-data-prototype=DT_monthOfYear/year}, {root-autosar-data-prototype=linkLayerLongRange, context-data-prototype=qualityIndicators, target-data-prototype=DT_qualityIndicatorList/arrayMember}, {root-autosar-data-prototype=linkLayerLongRange, context-data-prototype=DT_qualityIndicatorList_arrayMember_ARRAY/subElement, target-data-prototype=DT_qualityIndicator/type}, {root-autosar-data-prototype=linkLayerLongRange, context-data-prototype=DT_qualityIndicatorList_arrayMember_ARRAY/subElement, target-data-prototype=quality}, {root-autosar-data-prototype=linkLayerLongRange, context-data-prototype=DT_qualityIndicator/type, target-data-prototype=qualityIndicatorType}, {root-autosar-data-prototype=linkLayerLongRange, context-data-prototype=DT_metaData/trafficDirection, target-data-prototype=DT_trafficDirection/trafficDirection}, {root-autosar-data-prototype=linkLayerLongRange, context-data-prototype=generalSpeedLimits, target-data-prototype=DT_generalSpeedLimitList/arrayMember}, {root-autosar-data-prototype=linkLayerLongRange, context-data-prototype=DT_generalSpeedLimitList_arrayMember_ARRAY/subElement, target-data-prototype=DT_generalSpeedLimit/type}, {root-autosar-data-prototype=linkLayerLongRange, context-data-prototype=DT_generalSpeedLimitList_arrayMember_ARRAY/subElement, target-data-prototype=DT_generalSpeedLimit/speedValue}, {root-autosar-data-prototype=linkLayerLongRange, context-data-prototype=DT_generalSpeedLimitList_arrayMember_ARRAY/subElement, target-data-prototype=constraint}, {root-autosar-data-prototype=linkLayerLongRange, context-data-prototype=DT_generalSpeedLimit/type, target-data-prototype=generalSpeedLimitType}, {root-autosar-data-prototype=linkLayerLongRange, context-data-prototype=constraint, target-data-prototype=DT_constraintList/arrayMember}, {root-autosar-data-prototype=linkLayerLongRange, context-data-prototype=DT_constraintList_arrayMember_ARRAY/subElement, target-data-prototype=daysOfWeek}, {root-autosar-data-prototype=linkLayerLongRange, context-data-prototype=DT_constraintList_arrayMember_ARRAY/subElement, target-data-prototype=timeRangeOfDay}, {root-autosar-data-prototype=linkLayerLongRange, context-data-prototype=DT_constraintList_arrayMember_ARRAY/subElement, target-data-prototype=weatherConstraint}, {root-autosar-data-prototype=linkLayerLongRange, context-data-prototype=DT_constraintList_arrayMember_ARRAY/subElement, target-data-prototype=timeClassifier}, {root-autosar-data-prototype=linkLayerLongRange, context-data-prototype=DT_constraintList_arrayMember_ARRAY/subElement, target-data-prototype=zoneClassifier}, {root-autosar-data-prototype=linkLayerLongRange, context-data-prototype=DT_constraintList_arrayMember_ARRAY/subElement, target-data-prototype=applicableVehicles}, {root-autosar-data-prototype=linkLayerLongRange, context-data-prototype=DT_constraintList_arrayMember_ARRAY/subElement, target-data-prototype=DT_constraint/turnConstraint}, {root-autosar-data-prototype=linkLayerLongRange, context-data-prototype=daysOfWeek, target-data-prototype=DT_listOfDays/arrayMember}, {root-autosar-data-prototype=linkLayerLongRange, context-data-prototype=timeRangeOfDay, target-data-prototype=startTimeHour}, {root-autosar-data-prototype=linkLayerLongRange, context-data-prototype=timeRangeOfDay, target-data-prototype=startTimeMinute}, {root-autosar-data-prototype=linkLayerLongRange, context-data-prototype=timeRangeOfDay, target-data-prototype=endTimeHour}, {root-autosar-data-prototype=linkLayerLongRange, context-data-prototype=timeRangeOfDay, target-data-prototype=endTimeMinute}, {root-autosar-data-prototype=linkLayerLongRange, context-data-prototype=weatherConstraint, target-data-prototype=Weather}, {root-autosar-data-prototype=linkLayerLongRange, context-data-prototype=timeClassifier, target-data-prototype=timeConstraintType}, {root-autosar-data-prototype=linkLayerLongRange, context-data-prototype=zoneClassifier, target-data-prototype=zoneConstraintType}, {root-autosar-data-prototype=linkLayerLongRange, context-data-prototype=applicableVehicles, target-data-prototype=applicableVehiclesType}, {root-autosar-data-prototype=linkLayerLongRange, context-data-prototype=DT_constraint/turnConstraint, target-data-prototype=DT_turnConstraint/turnConstraint}, {root-autosar-data-prototype=linkLayerLongRange, context-data-prototype=DT_metaData/speedUnit, target-data-prototype=DT_speedUnit/speedUnit}, {root-autosar-data-prototype=linkLayerShortRange, context-data-prototype=DT_linkLayerShortRange_vector/subElement, target-data-prototype=DT_linkLayerShortRange_struct/id}, {root-autosar-data-prototype=linkLayerShortRange, context-data-prototype=DT_linkLayerShortRange_vector/subElement, target-data-prototype=linkLayerShortRange}, {root-autosar-data-prototype=linkLayerShortRange, context-data-prototype=DT_linkLayerShortRange_vector/subElement, target-data-prototype=DT_linkLayerShortRange_struct/layerInfo}, {root-autosar-data-prototype=linkLayerShortRange, context-data-prototype=DT_linkLayerShortRangelinkLayerShortRange/subElement, target-data-prototype=DT_link/metaDataIndex}, {root-autosar-data-prototype=linkLayerShortRange, context-data-prototype=DT_linkLayerShortRangelinkLayerShortRange/subElement, target-data-prototype=fromLinkList}, {root-autosar-data-prototype=linkLayerShortRange, context-data-prototype=DT_linkLayerShortRangelinkLayerShortRange/subElement, target-data-prototype=toLinkList}, {root-autosar-data-prototype=linkLayerShortRange, context-data-prototype=DT_linkLayerShortRangelinkLayerShortRange/subElement, target-data-prototype=DT_link/linkType}, {root-autosar-data-prototype=linkLayerShortRange, context-data-prototype=DT_linkLayerShortRangelinkLayerShortRange/subElement, target-data-prototype=DT_link/reference}, {root-autosar-data-prototype=linkLayerShortRange, context-data-prototype=DT_linkLayerShortRangelinkLayerShortRange/subElement, target-data-prototype=controlledAccess}, {root-autosar-data-prototype=linkLayerShortRange, context-data-prototype=DT_linkLayerShortRangelinkLayerShortRange/subElement, target-data-prototype=drivingDirection}, {root-autosar-data-prototype=linkLayerShortRange, context-data-prototype=DT_linkLayerShortRangelinkLayerShortRange/subElement, target-data-prototype=DT_link/functionalRoadClass}, {root-autosar-data-prototype=linkLayerShortRange, context-data-prototype=DT_linkLayerShortRangelinkLayerShortRange/subElement, target-data-prototype=clothoidList}, {root-autosar-data-prototype=linkLayerShortRange, context-data-prototype=DT_linkLayerShortRangelinkLayerShortRange/subElement, target-data-prototype=polyline}, {root-autosar-data-prototype=linkLayerShortRange, context-data-prototype=DT_linkLayerShortRangelinkLayerShortRange/subElement, target-data-prototype=insideCityLimits}, {root-autosar-data-prototype=linkLayerShortRange, context-data-prototype=DT_linkLayerShortRangelinkLayerShortRange/subElement, target-data-prototype=tollway}, {root-autosar-data-prototype=linkLayerShortRange, context-data-prototype=DT_linkLayerShortRangelinkLayerShortRange/subElement, target-data-prototype=adas}, {root-autosar-data-prototype=linkLayerShortRange, context-data-prototype=DT_linkLayerShortRangelinkLayerShortRange/subElement, target-data-prototype=urban}, {root-autosar-data-prototype=linkLayerShortRange, context-data-prototype=DT_linkLayerShortRangelinkLayerShortRange/subElement, target-data-prototype=paved}, {root-autosar-data-prototype=linkLayerShortRange, context-data-prototype=DT_linkLayerShortRangelinkLayerShortRange/subElement, target-data-prototype=DT_link/attributeList}, {root-autosar-data-prototype=linkLayerShortRange, context-data-prototype=DT_linkLayerShortRangelinkLayerShortRange/subElement, target-data-prototype=avgSpeed}, {root-autosar-data-prototype=linkLayerShortRange, context-data-prototype=DT_linkLayerShortRangelinkLayerShortRange/subElement, target-data-prototype=rightOfWay}, {root-autosar-data-prototype=linkLayerShortRange, context-data-prototype=DT_linkLayerShortRangelinkLayerShortRange/subElement, target-data-prototype=DT_link/length}, {root-autosar-data-prototype=linkLayerShortRange, context-data-prototype=fromLinkList, target-data-prototype=DT_referenceList/arrayMember}, {root-autosar-data-prototype=linkLayerShortRange, context-data-prototype=DT_referenceList_arrayMember_ARRAY/subElement, target-data-prototype=localId}, {root-autosar-data-prototype=linkLayerShortRange, context-data-prototype=DT_referenceList_arrayMember_ARRAY/subElement, target-data-prototype=referenceBaseIndex}, {root-autosar-data-prototype=linkLayerShortRange, context-data-prototype=DT_referenceList_arrayMember_ARRAY/subElement, target-data-prototype=inPositiveDirection}, {root-autosar-data-prototype=linkLayerShortRange, context-data-prototype=toLinkList, target-data-prototype=DT_referenceList/arrayMember}, {root-autosar-data-prototype=linkLayerShortRange, context-data-prototype=DT_referenceList_arrayMember_ARRAY/subElement, target-data-prototype=localId}, {root-autosar-data-prototype=linkLayerShortRange, context-data-prototype=DT_referenceList_arrayMember_ARRAY/subElement, target-data-prototype=referenceBaseIndex}, {root-autosar-data-prototype=linkLayerShortRange, context-data-prototype=DT_referenceList_arrayMember_ARRAY/subElement, target-data-prototype=inPositiveDirection}, {root-autosar-data-prototype=linkLayerShortRange, context-data-prototype=DT_link/linkType, target-data-prototype=DT_linkType/linkType}, {root-autosar-data-prototype=linkLayerShortRange, context-data-prototype=DT_link/reference, target-data-prototype=localId}, {root-autosar-data-prototype=linkLayerShortRange, context-data-prototype=DT_link/reference, target-data-prototype=referenceBaseIndex}, {root-autosar-data-prototype=linkLayerShortRange, context-data-prototype=DT_link/reference, target-data-prototype=inPositiveDirection}, {root-autosar-data-prototype=linkLayerShortRange, context-data-prototype=drivingDirection, target-data-prototype=DT_direction/direction}, {root-autosar-data-prototype=linkLayerShortRange, context-data-prototype=DT_link/functionalRoadClass, target-data-prototype=DT_functionalRoadClass/functionalRoadClass}, {root-autosar-data-prototype=linkLayerShortRange, context-data-prototype=clothoidList, target-data-prototype=DT_clothoidList/arrayMember}, {root-autosar-data-prototype=linkLayerShortRange, context-data-prototype=DT_clothoidList_arrayMember_ARRAY/subElement, target-data-prototype=startCurvature}, {root-autosar-data-prototype=linkLayerShortRange, context-data-prototype=DT_clothoidList_arrayMember_ARRAY/subElement, target-data-prototype=endCurvature}, {root-autosar-data-prototype=linkLayerShortRange, context-data-prototype=DT_clothoidList_arrayMember_ARRAY/subElement, target-data-prototype=DT_clothoid/length}, {root-autosar-data-prototype=linkLayerShortRange, context-data-prototype=DT_clothoidList_arrayMember_ARRAY/subElement, target-data-prototype=angle}, {root-autosar-data-prototype=linkLayerShortRange, context-data-prototype=DT_clothoidList_arrayMember_ARRAY/subElement, target-data-prototype=ndsCoordinates}, {root-autosar-data-prototype=linkLayerShortRange, context-data-prototype=DT_clothoidList_arrayMember_ARRAY/subElement, target-data-prototype=geometryQuality}, {root-autosar-data-prototype=linkLayerShortRange, context-data-prototype=ndsCoordinates, target-data-prototype=longitude}, {root-autosar-data-prototype=linkLayerShortRange, context-data-prototype=ndsCoordinates, target-data-prototype=latitude}, {root-autosar-data-prototype=linkLayerShortRange, context-data-prototype=ndsCoordinates, target-data-prototype=DT_wgs84Coordinate/height}, {root-autosar-data-prototype=linkLayerShortRange, context-data-prototype=polyline, target-data-prototype=DT_polyline/arrayMember}, {root-autosar-data-prototype=linkLayerShortRange, context-data-prototype=DT_polyline_arrayMember_ARRAY/subElement, target-data-prototype=longitude}, {root-autosar-data-prototype=linkLayerShortRange, context-data-prototype=DT_polyline_arrayMember_ARRAY/subElement, target-data-prototype=latitude}, {root-autosar-data-prototype=linkLayerShortRange, context-data-prototype=DT_polyline_arrayMember_ARRAY/subElement, target-data-prototype=DT_wgs84Coordinate/height}, {root-autosar-data-prototype=linkLayerShortRange, context-data-prototype=adas, target-data-prototype=adasAccuracyType}, {root-autosar-data-prototype=linkLayerShortRange, context-data-prototype=DT_link/attributeList, target-data-prototype=DT_attributeList/arrayMember}, {root-autosar-data-prototype=linkLayerShortRange, context-data-prototype=DT_attributeList_arrayMember_ARRAY/subElement, target-data-prototype=DT_attribute/confidence}, {root-autosar-data-prototype=linkLayerShortRange, context-data-prototype=DT_attributeList_arrayMember_ARRAY/subElement, target-data-prototype=attributeType}, {root-autosar-data-prototype=linkLayerShortRange, context-data-prototype=DT_attributeList_arrayMember_ARRAY/subElement, target-data-prototype=DT_attribute/direction}, {root-autosar-data-prototype=linkLayerShortRange, context-data-prototype=DT_attributeList_arrayMember_ARRAY/subElement, target-data-prototype=attributePointList}, {root-autosar-data-prototype=linkLayerShortRange, context-data-prototype=DT_attribute/direction, target-data-prototype=DT_direction/direction}, {root-autosar-data-prototype=linkLayerShortRange, context-data-prototype=attributePointList, target-data-prototype=DT_attributePointList/arrayMember}, {root-autosar-data-prototype=linkLayerShortRange, context-data-prototype=DT_attributePointList_arrayMember_ARRAY/subElement, target-data-prototype=DT_attributePoint/offset}, {root-autosar-data-prototype=linkLayerShortRange, context-data-prototype=DT_attributePointList_arrayMember_ARRAY/subElement, target-data-prototype=attributeValue}, {root-autosar-data-prototype=linkLayerShortRange, context-data-prototype=DT_attributePointList_arrayMember_ARRAY/subElement, target-data-prototype=DT_attributePoint/laneList}, {root-autosar-data-prototype=linkLayerShortRange, context-data-prototype=attributeValue, target-data-prototype=intValue}, {root-autosar-data-prototype=linkLayerShortRange, context-data-prototype=attributeValue, target-data-prototype=floatValue}, {root-autosar-data-prototype=linkLayerShortRange, context-data-prototype=attributeValue, target-data-prototype=blobValue}, {root-autosar-data-prototype=linkLayerShortRange, context-data-prototype=attributeValue, target-data-prototype=speedLimit}, {root-autosar-data-prototype=linkLayerShortRange, context-data-prototype=attributeValue, target-data-prototype=overtakingProhibition}, {root-autosar-data-prototype=linkLayerShortRange, context-data-prototype=blobValue, target-data-prototype=DT_byteArray/arrayMember}, {root-autosar-data-prototype=linkLayerShortRange, context-data-prototype=speedLimit, target-data-prototype=DT_speedLimit/speedValue}, {root-autosar-data-prototype=linkLayerShortRange, context-data-prototype=speedLimit, target-data-prototype=source}, {root-autosar-data-prototype=linkLayerShortRange, context-data-prototype=speedLimit, target-data-prototype=DT_speedLimit/constraintList}, {root-autosar-data-prototype=linkLayerShortRange, context-data-prototype=speedLimit, target-data-prototype=DT_speedLimit/online}, {root-autosar-data-prototype=linkLayerShortRange, context-data-prototype=source, target-data-prototype=speedLimitSource}, {root-autosar-data-prototype=linkLayerShortRange, context-data-prototype=DT_speedLimit/constraintList, target-data-prototype=DT_constraintList/arrayMember}, {root-autosar-data-prototype=linkLayerShortRange, context-data-prototype=DT_constraintList_arrayMember_ARRAY/subElement, target-data-prototype=daysOfWeek}, {root-autosar-data-prototype=linkLayerShortRange, context-data-prototype=DT_constraintList_arrayMember_ARRAY/subElement, target-data-prototype=timeRangeOfDay}, {root-autosar-data-prototype=linkLayerShortRange, context-data-prototype=DT_constraintList_arrayMember_ARRAY/subElement, target-data-prototype=weatherConstraint}, {root-autosar-data-prototype=linkLayerShortRange, context-data-prototype=DT_constraintList_arrayMember_ARRAY/subElement, target-data-prototype=timeClassifier}, {root-autosar-data-prototype=linkLayerShortRange, context-data-prototype=DT_constraintList_arrayMember_ARRAY/subElement, target-data-prototype=zoneClassifier}, {root-autosar-data-prototype=linkLayerShortRange, context-data-prototype=DT_constraintList_arrayMember_ARRAY/subElement, target-data-prototype=applicableVehicles}, {root-autosar-data-prototype=linkLayerShortRange, context-data-prototype=DT_constraintList_arrayMember_ARRAY/subElement, target-data-prototype=DT_constraint/turnConstraint}, {root-autosar-data-prototype=linkLayerShortRange, context-data-prototype=daysOfWeek, target-data-prototype=DT_listOfDays/arrayMember}, {root-autosar-data-prototype=linkLayerShortRange, context-data-prototype=timeRangeOfDay, target-data-prototype=startTimeHour}, {root-autosar-data-prototype=linkLayerShortRange, context-data-prototype=timeRangeOfDay, target-data-prototype=startTimeMinute}, {root-autosar-data-prototype=linkLayerShortRange, context-data-prototype=timeRangeOfDay, target-data-prototype=endTimeHour}, {root-autosar-data-prototype=linkLayerShortRange, context-data-prototype=timeRangeOfDay, target-data-prototype=endTimeMinute}, {root-autosar-data-prototype=linkLayerShortRange, context-data-prototype=weatherConstraint, target-data-prototype=Weather}, {root-autosar-data-prototype=linkLayerShortRange, context-data-prototype=timeClassifier, target-data-prototype=timeConstraintType}, {root-autosar-data-prototype=linkLayerShortRange, context-data-prototype=zoneClassifier, target-data-prototype=zoneConstraintType}, {root-autosar-data-prototype=linkLayerShortRange, context-data-prototype=applicableVehicles, target-data-prototype=applicableVehiclesType}, {root-autosar-data-prototype=linkLayerShortRange, context-data-prototype=DT_constraint/turnConstraint, target-data-prototype=DT_turnConstraint/turnConstraint}, {root-autosar-data-prototype=linkLayerShortRange, context-data-prototype=overtakingProhibition, target-data-prototype=DT_overtakingProhibition/online}, {root-autosar-data-prototype=linkLayerShortRange, context-data-prototype=overtakingProhibition, target-data-prototype=DT_overtakingProhibition/constraintList}, {root-autosar-data-prototype=linkLayerShortRange, context-data-prototype=overtakingProhibition, target-data-prototype=DT_overtakingProhibition/type}, {root-autosar-data-prototype=linkLayerShortRange, context-data-prototype=DT_overtakingProhibition/constraintList, target-data-prototype=DT_constraintList/arrayMember}, {root-autosar-data-prototype=linkLayerShortRange, context-data-prototype=DT_constraintList_arrayMember_ARRAY/subElement, target-data-prototype=daysOfWeek}, {root-autosar-data-prototype=linkLayerShortRange, context-data-prototype=DT_constraintList_arrayMember_ARRAY/subElement, target-data-prototype=timeRangeOfDay}, {root-autosar-data-prototype=linkLayerShortRange, context-data-prototype=DT_constraintList_arrayMember_ARRAY/subElement, target-data-prototype=weatherConstraint}, {root-autosar-data-prototype=linkLayerShortRange, context-data-prototype=DT_constraintList_arrayMember_ARRAY/subElement, target-data-prototype=timeClassifier}, {root-autosar-data-prototype=linkLayerShortRange, context-data-prototype=DT_constraintList_arrayMember_ARRAY/subElement, target-data-prototype=zoneClassifier}, {root-autosar-data-prototype=linkLayerShortRange, context-data-prototype=DT_constraintList_arrayMember_ARRAY/subElement, target-data-prototype=applicableVehicles}, {root-autosar-data-prototype=linkLayerShortRange, context-data-prototype=DT_constraintList_arrayMember_ARRAY/subElement, target-data-prototype=DT_constraint/turnConstraint}, {root-autosar-data-prototype=linkLayerShortRange, context-data-prototype=daysOfWeek, target-data-prototype=DT_listOfDays/arrayMember}, {root-autosar-data-prototype=linkLayerShortRange, context-data-prototype=timeRangeOfDay, target-data-prototype=startTimeHour}, {root-autosar-data-prototype=linkLayerShortRange, context-data-prototype=timeRangeOfDay, target-data-prototype=startTimeMinute}, {root-autosar-data-prototype=linkLayerShortRange, context-data-prototype=timeRangeOfDay, target-data-prototype=endTimeHour}, {root-autosar-data-prototype=linkLayerShortRange, context-data-prototype=timeRangeOfDay, target-data-prototype=endTimeMinute}, {root-autosar-data-prototype=linkLayerShortRange, context-data-prototype=weatherConstraint, target-data-prototype=Weather}, {root-autosar-data-prototype=linkLayerShortRange, context-data-prototype=timeClassifier, target-data-prototype=timeConstraintType}, {root-autosar-data-prototype=linkLayerShortRange, context-data-prototype=zoneClassifier, target-data-prototype=zoneConstraintType}, {root-autosar-data-prototype=linkLayerShortRange, context-data-prototype=applicableVehicles, target-data-prototype=applicableVehiclesType}, {root-autosar-data-prototype=linkLayerShortRange, context-data-prototype=DT_constraint/turnConstraint, target-data-prototype=DT_turnConstraint/turnConstraint}, {root-autosar-data-prototype=linkLayerShortRange, context-data-prototype=DT_overtakingProhibition/type, target-data-prototype=overtakingProhibitionType}, {root-autosar-data-prototype=linkLayerShortRange, context-data-prototype=DT_attributePoint/laneList, target-data-prototype=DT_laneIndexList/arrayMember}, {root-autosar-data-prototype=linkLayerShortRange, context-data-prototype=rightOfWay, target-data-prototype=rightOfWayRegulation}, {root-autosar-data-prototype=linkLayerShortRange, context-data-prototype=DT_linkLayerShortRange_struct/layerInfo, target-data-prototype=referenceBaseList}, {root-autosar-data-prototype=linkLayerShortRange, context-data-prototype=DT_linkLayerShortRange_struct/layerInfo, target-data-prototype=metaDataList}, {root-autosar-data-prototype=linkLayerShortRange, context-data-prototype=referenceBaseList, target-data-prototype=DT_referenceBaseList/arrayMember}, {root-autosar-data-prototype=linkLayerShortRange, context-data-prototype=DT_referenceBaseList_arrayMember_ARRAY/subElement, target-data-prototype=productId}, {root-autosar-data-prototype=linkLayerShortRange, context-data-prototype=DT_referenceBaseList_arrayMember_ARRAY/subElement, target-data-prototype=updateRegion}, {root-autosar-data-prototype=linkLayerShortRange, context-data-prototype=DT_referenceBaseList_arrayMember_ARRAY/subElement, target-data-prototype=tileId}, {root-autosar-data-prototype=linkLayerShortRange, context-data-prototype=metaDataList, target-data-prototype=DT_metaDataList/arrayMember}, {root-autosar-data-prototype=linkLayerShortRange, context-data-prototype=DT_metaDataList_arrayMember_ARRAY/subElement, target-data-prototype=countryCode}, {root-autosar-data-prototype=linkLayerShortRange, context-data-prototype=DT_metaDataList_arrayMember_ARRAY/subElement, target-data-prototype=regionCode}, {root-autosar-data-prototype=linkLayerShortRange, context-data-prototype=DT_metaDataList_arrayMember_ARRAY/subElement, target-data-prototype=mapAge}, {root-autosar-data-prototype=linkLayerShortRange, context-data-prototype=DT_metaDataList_arrayMember_ARRAY/subElement, target-data-prototype=qualityIndicators}, {root-autosar-data-prototype=linkLayerShortRange, context-data-prototype=DT_metaDataList_arrayMember_ARRAY/subElement, target-data-prototype=DT_metaData/trafficDirection}, {root-autosar-data-prototype=linkLayerShortRange, context-data-prototype=DT_metaDataList_arrayMember_ARRAY/subElement, target-data-prototype=generalSpeedLimits}, {root-autosar-data-prototype=linkLayerShortRange, context-data-prototype=DT_metaDataList_arrayMember_ARRAY/subElement, target-data-prototype=DT_metaData/speedUnit}, {root-autosar-data-prototype=linkLayerShortRange, context-data-prototype=mapAge, target-data-prototype=month}, {root-autosar-data-prototype=linkLayerShortRange, context-data-prototype=mapAge, target-data-prototype=DT_monthOfYear/year}, {root-autosar-data-prototype=linkLayerShortRange, context-data-prototype=qualityIndicators, target-data-prototype=DT_qualityIndicatorList/arrayMember}, {root-autosar-data-prototype=linkLayerShortRange, context-data-prototype=DT_qualityIndicatorList_arrayMember_ARRAY/subElement, target-data-prototype=DT_qualityIndicator/type}, {root-autosar-data-prototype=linkLayerShortRange, context-data-prototype=DT_qualityIndicatorList_arrayMember_ARRAY/subElement, target-data-prototype=quality}, {root-autosar-data-prototype=linkLayerShortRange, context-data-prototype=DT_qualityIndicator/type, target-data-prototype=qualityIndicatorType}, {root-autosar-data-prototype=linkLayerShortRange, context-data-prototype=DT_metaData/trafficDirection, target-data-prototype=DT_trafficDirection/trafficDirection}, {root-autosar-data-prototype=linkLayerShortRange, context-data-prototype=generalSpeedLimits, target-data-prototype=DT_generalSpeedLimitList/arrayMember}, {root-autosar-data-prototype=linkLayerShortRange, context-data-prototype=DT_generalSpeedLimitList_arrayMember_ARRAY/subElement, target-data-prototype=DT_generalSpeedLimit/type}, {root-autosar-data-prototype=linkLayerShortRange, context-data-prototype=DT_generalSpeedLimitList_arrayMember_ARRAY/subElement, target-data-prototype=DT_generalSpeedLimit/speedValue}, {root-autosar-data-prototype=linkLayerShortRange, context-data-prototype=DT_generalSpeedLimitList_arrayMember_ARRAY/subElement, target-data-prototype=constraint}, {root-autosar-data-prototype=linkLayerShortRange, context-data-prototype=DT_generalSpeedLimit/type, target-data-prototype=generalSpeedLimitType}, {root-autosar-data-prototype=linkLayerShortRange, context-data-prototype=constraint, target-data-prototype=DT_constraintList/arrayMember}, {root-autosar-data-prototype=linkLayerShortRange, context-data-prototype=DT_constraintList_arrayMember_ARRAY/subElement, target-data-prototype=daysOfWeek}, {root-autosar-data-prototype=linkLayerShortRange, context-data-prototype=DT_constraintList_arrayMember_ARRAY/subElement, target-data-prototype=timeRangeOfDay}, {root-autosar-data-prototype=linkLayerShortRange, context-data-prototype=DT_constraintList_arrayMember_ARRAY/subElement, target-data-prototype=weatherConstraint}, {root-autosar-data-prototype=linkLayerShortRange, context-data-prototype=DT_constraintList_arrayMember_ARRAY/subElement, target-data-prototype=timeClassifier}, {root-autosar-data-prototype=linkLayerShortRange, context-data-prototype=DT_constraintList_arrayMember_ARRAY/subElement, target-data-prototype=zoneClassifier}, {root-autosar-data-prototype=linkLayerShortRange, context-data-prototype=DT_constraintList_arrayMember_ARRAY/subElement, target-data-prototype=applicableVehicles}, {root-autosar-data-prototype=linkLayerShortRange, context-data-prototype=DT_constraintList_arrayMember_ARRAY/subElement, target-data-prototype=DT_constraint/turnConstraint}, {root-autosar-data-prototype=linkLayerShortRange, context-data-prototype=daysOfWeek, target-data-prototype=DT_listOfDays/arrayMember}, {root-autosar-data-prototype=linkLayerShortRange, context-data-prototype=timeRangeOfDay, target-data-prototype=startTimeHour}, {root-autosar-data-prototype=linkLayerShortRange, context-data-prototype=timeRangeOfDay, target-data-prototype=startTimeMinute}, {root-autosar-data-prototype=linkLayerShortRange, context-data-prototype=timeRangeOfDay, target-data-prototype=endTimeHour}, {root-autosar-data-prototype=linkLayerShortRange, context-data-prototype=timeRangeOfDay, target-data-prototype=endTimeMinute}, {root-autosar-data-prototype=linkLayerShortRange, context-data-prototype=weatherConstraint, target-data-prototype=Weather}, {root-autosar-data-prototype=linkLayerShortRange, context-data-prototype=timeClassifier, target-data-prototype=timeConstraintType}, {root-autosar-data-prototype=linkLayerShortRange, context-data-prototype=zoneClassifier, target-data-prototype=zoneConstraintType}, {root-autosar-data-prototype=linkLayerShortRange, context-data-prototype=applicableVehicles, target-data-prototype=applicableVehiclesType}, {root-autosar-data-prototype=linkLayerShortRange, context-data-prototype=DT_constraint/turnConstraint, target-data-prototype=DT_turnConstraint/turnConstraint}, {root-autosar-data-prototype=linkLayerShortRange, context-data-prototype=DT_metaData/speedUnit, target-data-prototype=DT_speedUnit/speedUnit}, {root-autosar-data-prototype=laneLayer, context-data-prototype=DT_laneLayer_vector/subElement, target-data-prototype=DT_laneLayer_struct/id}, {root-autosar-data-prototype=laneLayer, context-data-prototype=DT_laneLayer_vector/subElement, target-data-prototype=laneLayer}, {root-autosar-data-prototype=laneLayer, context-data-prototype=DT_laneLayer_vector/subElement, target-data-prototype=DT_laneLayer_struct/layerInfo}, {root-autosar-data-prototype=laneLayer, context-data-prototype=DT_laneLayerlaneLayer/subElement, target-data-prototype=DT_laneGroup/laneGroupReference}, {root-autosar-data-prototype=laneLayer, context-data-prototype=DT_laneLayerlaneLayer/subElement, target-data-prototype=linkReferenceList}, {root-autosar-data-prototype=laneLayer, context-data-prototype=DT_laneLayerlaneLayer/subElement, target-data-prototype=DT_laneGroup/laneList}, {root-autosar-data-prototype=laneLayer, context-data-prototype=DT_laneLayerlaneLayer/subElement, target-data-prototype=laneBoundaryGroupList}, {root-autosar-data-prototype=laneLayer, context-data-prototype=DT_laneLayerlaneLayer/subElement, target-data-prototype=laneGroupAssociationList}, {root-autosar-data-prototype=laneLayer, context-data-prototype=DT_laneLayerlaneLayer/subElement, target-data-prototype=DT_laneGroup/metaDataIndex}, {root-autosar-data-prototype=laneLayer, context-data-prototype=DT_laneGroup/laneGroupReference, target-data-prototype=localId}, {root-autosar-data-prototype=laneLayer, context-data-prototype=DT_laneGroup/laneGroupReference, target-data-prototype=referenceBaseIndex}, {root-autosar-data-prototype=laneLayer, context-data-prototype=DT_laneGroup/laneGroupReference, target-data-prototype=inPositiveDirection}, {root-autosar-data-prototype=laneLayer, context-data-prototype=linkReferenceList, target-data-prototype=DT_linkReferenceList/arrayMember}, {root-autosar-data-prototype=laneLayer, context-data-prototype=DT_linkReferenceList_arrayMember_ARRAY/subElement, target-data-prototype=DT_rangedReference/reference}, {root-autosar-data-prototype=laneLayer, context-data-prototype=DT_linkReferenceList_arrayMember_ARRAY/subElement, target-data-prototype=DT_rangedReference/rangeStart}, {root-autosar-data-prototype=laneLayer, context-data-prototype=DT_linkReferenceList_arrayMember_ARRAY/subElement, target-data-prototype=DT_rangedReference/rangeEnd}, {root-autosar-data-prototype=laneLayer, context-data-prototype=DT_rangedReference/reference, target-data-prototype=localId}, {root-autosar-data-prototype=laneLayer, context-data-prototype=DT_rangedReference/reference, target-data-prototype=referenceBaseIndex}, {root-autosar-data-prototype=laneLayer, context-data-prototype=DT_rangedReference/reference, target-data-prototype=inPositiveDirection}, {root-autosar-data-prototype=laneLayer, context-data-prototype=DT_laneGroup/laneList, target-data-prototype=DT_laneList/arrayMember}, {root-autosar-data-prototype=laneLayer, context-data-prototype=DT_laneList_arrayMember_ARRAY/subElement, target-data-prototype=sourceLaneReferenceList}, {root-autosar-data-prototype=laneLayer, context-data-prototype=DT_laneList_arrayMember_ARRAY/subElement, target-data-prototype=destinationLaneReferenceList}, {root-autosar-data-prototype=laneLayer, context-data-prototype=DT_laneList_arrayMember_ARRAY/subElement, target-data-prototype=laneWidth}, {root-autosar-data-prototype=laneLayer, context-data-prototype=DT_laneList_arrayMember_ARRAY/subElement, target-data-prototype=centerlineGeometry}, {root-autosar-data-prototype=laneLayer, context-data-prototype=DT_laneList_arrayMember_ARRAY/subElement, target-data-prototype=DT_lane/laneConnectionType}, {root-autosar-data-prototype=laneLayer, context-data-prototype=DT_laneList_arrayMember_ARRAY/subElement, target-data-prototype=DT_lane/laneConnectivityElementType}, {root-autosar-data-prototype=laneLayer, context-data-prototype=DT_laneList_arrayMember_ARRAY/subElement, target-data-prototype=DT_lane/laneReference}, {root-autosar-data-prototype=laneLayer, context-data-prototype=DT_laneList_arrayMember_ARRAY/subElement, target-data-prototype=DT_lane/laneGroupReference}, {root-autosar-data-prototype=laneLayer, context-data-prototype=DT_laneList_arrayMember_ARRAY/subElement, target-data-prototype=laneIndex}, {root-autosar-data-prototype=laneLayer, context-data-prototype=DT_laneList_arrayMember_ARRAY/subElement, target-data-prototype=DT_lane/attributeList}, {root-autosar-data-prototype=laneLayer, context-data-prototype=DT_laneList_arrayMember_ARRAY/subElement, target-data-prototype=DT_lane/length}, {root-autosar-data-prototype=laneLayer, context-data-prototype=sourceLaneReferenceList, target-data-prototype=DT_referenceList/arrayMember}, {root-autosar-data-prototype=laneLayer, context-data-prototype=DT_referenceList_arrayMember_ARRAY/subElement, target-data-prototype=localId}, {root-autosar-data-prototype=laneLayer, context-data-prototype=DT_referenceList_arrayMember_ARRAY/subElement, target-data-prototype=referenceBaseIndex}, {root-autosar-data-prototype=laneLayer, context-data-prototype=DT_referenceList_arrayMember_ARRAY/subElement, target-data-prototype=inPositiveDirection}, {root-autosar-data-prototype=laneLayer, context-data-prototype=destinationLaneReferenceList, target-data-prototype=DT_referenceList/arrayMember}, {root-autosar-data-prototype=laneLayer, context-data-prototype=DT_referenceList_arrayMember_ARRAY/subElement, target-data-prototype=localId}, {root-autosar-data-prototype=laneLayer, context-data-prototype=DT_referenceList_arrayMember_ARRAY/subElement, target-data-prototype=referenceBaseIndex}, {root-autosar-data-prototype=laneLayer, context-data-prototype=DT_referenceList_arrayMember_ARRAY/subElement, target-data-prototype=inPositiveDirection}, {root-autosar-data-prototype=laneLayer, context-data-prototype=centerlineGeometry, target-data-prototype=DT_polyline/arrayMember}, {root-autosar-data-prototype=laneLayer, context-data-prototype=DT_polyline_arrayMember_ARRAY/subElement, target-data-prototype=longitude}, {root-autosar-data-prototype=laneLayer, context-data-prototype=DT_polyline_arrayMember_ARRAY/subElement, target-data-prototype=latitude}, {root-autosar-data-prototype=laneLayer, context-data-prototype=DT_polyline_arrayMember_ARRAY/subElement, target-data-prototype=DT_wgs84Coordinate/height}, {root-autosar-data-prototype=laneLayer, context-data-prototype=DT_lane/laneConnectionType, target-data-prototype=DT_laneConnectionType/laneConnectionType}, {root-autosar-data-prototype=laneLayer, context-data-prototype=DT_lane/laneConnectivityElementType, target-data-prototype=DT_laneConnectivityElementType/laneConnectivityElementType}, {root-autosar-data-prototype=laneLayer, context-data-prototype=DT_lane/laneReference, target-data-prototype=localId}, {root-autosar-data-prototype=laneLayer, context-data-prototype=DT_lane/laneReference, target-data-prototype=referenceBaseIndex}, {root-autosar-data-prototype=laneLayer, context-data-prototype=DT_lane/laneReference, target-data-prototype=inPositiveDirection}, {root-autosar-data-prototype=laneLayer, context-data-prototype=DT_lane/laneGroupReference, target-data-prototype=localId}, {root-autosar-data-prototype=laneLayer, context-data-prototype=DT_lane/laneGroupReference, target-data-prototype=referenceBaseIndex}, {root-autosar-data-prototype=laneLayer, context-data-prototype=DT_lane/laneGroupReference, target-data-prototype=inPositiveDirection}, {root-autosar-data-prototype=laneLayer, context-data-prototype=DT_lane/attributeList, target-data-prototype=DT_attributeList/arrayMember}, {root-autosar-data-prototype=laneLayer, context-data-prototype=DT_attributeList_arrayMember_ARRAY/subElement, target-data-prototype=DT_attribute/confidence}, {root-autosar-data-prototype=laneLayer, context-data-prototype=DT_attributeList_arrayMember_ARRAY/subElement, target-data-prototype=attributeType}, {root-autosar-data-prototype=laneLayer, context-data-prototype=DT_attributeList_arrayMember_ARRAY/subElement, target-data-prototype=DT_attribute/direction}, {root-autosar-data-prototype=laneLayer, context-data-prototype=DT_attributeList_arrayMember_ARRAY/subElement, target-data-prototype=attributePointList}, {root-autosar-data-prototype=laneLayer, context-data-prototype=DT_attribute/direction, target-data-prototype=DT_direction/direction}, {root-autosar-data-prototype=laneLayer, context-data-prototype=attributePointList, target-data-prototype=DT_attributePointList/arrayMember}, {root-autosar-data-prototype=laneLayer, context-data-prototype=DT_attributePointList_arrayMember_ARRAY/subElement, target-data-prototype=DT_attributePoint/offset}, {root-autosar-data-prototype=laneLayer, context-data-prototype=DT_attributePointList_arrayMember_ARRAY/subElement, target-data-prototype=attributeValue}, {root-autosar-data-prototype=laneLayer, context-data-prototype=DT_attributePointList_arrayMember_ARRAY/subElement, target-data-prototype=DT_attributePoint/laneList}, {root-autosar-data-prototype=laneLayer, context-data-prototype=attributeValue, target-data-prototype=intValue}, {root-autosar-data-prototype=laneLayer, context-data-prototype=attributeValue, target-data-prototype=floatValue}, {root-autosar-data-prototype=laneLayer, context-data-prototype=attributeValue, target-data-prototype=blobValue}, {root-autosar-data-prototype=laneLayer, context-data-prototype=attributeValue, target-data-prototype=speedLimit}, {root-autosar-data-prototype=laneLayer, context-data-prototype=attributeValue, target-data-prototype=overtakingProhibition}, {root-autosar-data-prototype=laneLayer, context-data-prototype=blobValue, target-data-prototype=DT_byteArray/arrayMember}, {root-autosar-data-prototype=laneLayer, context-data-prototype=speedLimit, target-data-prototype=DT_speedLimit/speedValue}, {root-autosar-data-prototype=laneLayer, context-data-prototype=speedLimit, target-data-prototype=source}, {root-autosar-data-prototype=laneLayer, context-data-prototype=speedLimit, target-data-prototype=DT_speedLimit/constraintList}, {root-autosar-data-prototype=laneLayer, context-data-prototype=speedLimit, target-data-prototype=DT_speedLimit/online}, {root-autosar-data-prototype=laneLayer, context-data-prototype=source, target-data-prototype=speedLimitSource}, {root-autosar-data-prototype=laneLayer, context-data-prototype=DT_speedLimit/constraintList, target-data-prototype=DT_constraintList/arrayMember}, {root-autosar-data-prototype=laneLayer, context-data-prototype=DT_constraintList_arrayMember_ARRAY/subElement, target-data-prototype=daysOfWeek}, {root-autosar-data-prototype=laneLayer, context-data-prototype=DT_constraintList_arrayMember_ARRAY/subElement, target-data-prototype=timeRangeOfDay}, {root-autosar-data-prototype=laneLayer, context-data-prototype=DT_constraintList_arrayMember_ARRAY/subElement, target-data-prototype=weatherConstraint}, {root-autosar-data-prototype=laneLayer, context-data-prototype=DT_constraintList_arrayMember_ARRAY/subElement, target-data-prototype=timeClassifier}, {root-autosar-data-prototype=laneLayer, context-data-prototype=DT_constraintList_arrayMember_ARRAY/subElement, target-data-prototype=zoneClassifier}, {root-autosar-data-prototype=laneLayer, context-data-prototype=DT_constraintList_arrayMember_ARRAY/subElement, target-data-prototype=applicableVehicles}, {root-autosar-data-prototype=laneLayer, context-data-prototype=DT_constraintList_arrayMember_ARRAY/subElement, target-data-prototype=DT_constraint/turnConstraint}, {root-autosar-data-prototype=laneLayer, context-data-prototype=daysOfWeek, target-data-prototype=DT_listOfDays/arrayMember}, {root-autosar-data-prototype=laneLayer, context-data-prototype=timeRangeOfDay, target-data-prototype=startTimeHour}, {root-autosar-data-prototype=laneLayer, context-data-prototype=timeRangeOfDay, target-data-prototype=startTimeMinute}, {root-autosar-data-prototype=laneLayer, context-data-prototype=timeRangeOfDay, target-data-prototype=endTimeHour}, {root-autosar-data-prototype=laneLayer, context-data-prototype=timeRangeOfDay, target-data-prototype=endTimeMinute}, {root-autosar-data-prototype=laneLayer, context-data-prototype=weatherConstraint, target-data-prototype=Weather}, {root-autosar-data-prototype=laneLayer, context-data-prototype=timeClassifier, target-data-prototype=timeConstraintType}, {root-autosar-data-prototype=laneLayer, context-data-prototype=zoneClassifier, target-data-prototype=zoneConstraintType}, {root-autosar-data-prototype=laneLayer, context-data-prototype=applicableVehicles, target-data-prototype=applicableVehiclesType}, {root-autosar-data-prototype=laneLayer, context-data-prototype=DT_constraint/turnConstraint, target-data-prototype=DT_turnConstraint/turnConstraint}, {root-autosar-data-prototype=laneLayer, context-data-prototype=overtakingProhibition, target-data-prototype=DT_overtakingProhibition/online}, {root-autosar-data-prototype=laneLayer, context-data-prototype=overtakingProhibition, target-data-prototype=DT_overtakingProhibition/constraintList}, {root-autosar-data-prototype=laneLayer, context-data-prototype=overtakingProhibition, target-data-prototype=DT_overtakingProhibition/type}, {root-autosar-data-prototype=laneLayer, context-data-prototype=DT_overtakingProhibition/constraintList, target-data-prototype=DT_constraintList/arrayMember}, {root-autosar-data-prototype=laneLayer, context-data-prototype=DT_constraintList_arrayMember_ARRAY/subElement, target-data-prototype=daysOfWeek}, {root-autosar-data-prototype=laneLayer, context-data-prototype=DT_constraintList_arrayMember_ARRAY/subElement, target-data-prototype=timeRangeOfDay}, {root-autosar-data-prototype=laneLayer, context-data-prototype=DT_constraintList_arrayMember_ARRAY/subElement, target-data-prototype=weatherConstraint}, {root-autosar-data-prototype=laneLayer, context-data-prototype=DT_constraintList_arrayMember_ARRAY/subElement, target-data-prototype=timeClassifier}, {root-autosar-data-prototype=laneLayer, context-data-prototype=DT_constraintList_arrayMember_ARRAY/subElement, target-data-prototype=zoneClassifier}, {root-autosar-data-prototype=laneLayer, context-data-prototype=DT_constraintList_arrayMember_ARRAY/subElement, target-data-prototype=applicableVehicles}, {root-autosar-data-prototype=laneLayer, context-data-prototype=DT_constraintList_arrayMember_ARRAY/subElement, target-data-prototype=DT_constraint/turnConstraint}, {root-autosar-data-prototype=laneLayer, context-data-prototype=daysOfWeek, target-data-prototype=DT_listOfDays/arrayMember}, {root-autosar-data-prototype=laneLayer, context-data-prototype=timeRangeOfDay, target-data-prototype=startTimeHour}, {root-autosar-data-prototype=laneLayer, context-data-prototype=timeRangeOfDay, target-data-prototype=startTimeMinute}, {root-autosar-data-prototype=laneLayer, context-data-prototype=timeRangeOfDay, target-data-prototype=endTimeHour}, {root-autosar-data-prototype=laneLayer, context-data-prototype=timeRangeOfDay, target-data-prototype=endTimeMinute}, {root-autosar-data-prototype=laneLayer, context-data-prototype=weatherConstraint, target-data-prototype=Weather}, {root-autosar-data-prototype=laneLayer, context-data-prototype=timeClassifier, target-data-prototype=timeConstraintType}, {root-autosar-data-prototype=laneLayer, context-data-prototype=zoneClassifier, target-data-prototype=zoneConstraintType}, {root-autosar-data-prototype=laneLayer, context-data-prototype=applicableVehicles, target-data-prototype=applicableVehiclesType}, {root-autosar-data-prototype=laneLayer, context-data-prototype=DT_constraint/turnConstraint, target-data-prototype=DT_turnConstraint/turnConstraint}, {root-autosar-data-prototype=laneLayer, context-data-prototype=DT_overtakingProhibition/type, target-data-prototype=overtakingProhibitionType}, {root-autosar-data-prototype=laneLayer, context-data-prototype=DT_attributePoint/laneList, target-data-prototype=DT_laneIndexList/arrayMember}, {root-autosar-data-prototype=laneLayer, context-data-prototype=laneBoundaryGroupList, target-data-prototype=DT_laneBoundaryGroupList/arrayMember}, {root-autosar-data-prototype=laneLayer, context-data-prototype=DT_laneBoundaryGroupList_arrayMember_ARRAY/subElement, target-data-prototype=laneBoundaryParallelElementList}, {root-autosar-data-prototype=laneLayer, context-data-prototype=laneBoundaryParallelElementList, target-data-prototype=DT_laneBoundaryParallelElementList/arrayMember}, {root-autosar-data-prototype=laneLayer, context-data-prototype=DT_laneBoundaryParallelElementList_arrayMember_ARRAY/subElement, target-data-prototype=laneBoundarySequentialList}, {root-autosar-data-prototype=laneLayer, context-data-prototype=laneBoundarySequentialList, target-data-prototype=DT_laneBoundarySequentialList/arrayMember}, {root-autosar-data-prototype=laneLayer, context-data-prototype=DT_laneBoundarySequentialList_arrayMember_ARRAY/subElement, target-data-prototype=DT_laneBoundary/type}, {root-autosar-data-prototype=laneLayer, context-data-prototype=DT_laneBoundarySequentialList_arrayMember_ARRAY/subElement, target-data-prototype=openToCurbSide}, {root-autosar-data-prototype=laneLayer, context-data-prototype=DT_laneBoundarySequentialList_arrayMember_ARRAY/subElement, target-data-prototype=openToMiddleSide}, {root-autosar-data-prototype=laneLayer, context-data-prototype=DT_laneBoundarySequentialList_arrayMember_ARRAY/subElement, target-data-prototype=range}, {root-autosar-data-prototype=laneLayer, context-data-prototype=DT_laneBoundarySequentialList_arrayMember_ARRAY/subElement, target-data-prototype=boundaryGeometry}, {root-autosar-data-prototype=laneLayer, context-data-prototype=DT_laneBoundarySequentialList_arrayMember_ARRAY/subElement, target-data-prototype=color}, {root-autosar-data-prototype=laneLayer, context-data-prototype=DT_laneBoundarySequentialList_arrayMember_ARRAY/subElement, target-data-prototype=width}, {root-autosar-data-prototype=laneLayer, context-data-prototype=DT_laneBoundary/type, target-data-prototype=laneBoundaryType}, {root-autosar-data-prototype=laneLayer, context-data-prototype=range, target-data-prototype=DT_rangedAttribute/rangeStart}, {root-autosar-data-prototype=laneLayer, context-data-prototype=range, target-data-prototype=DT_rangedAttribute/rangeEnd}, {root-autosar-data-prototype=laneLayer, context-data-prototype=boundaryGeometry, target-data-prototype=DT_polyline/arrayMember}, {root-autosar-data-prototype=laneLayer, context-data-prototype=DT_polyline_arrayMember_ARRAY/subElement, target-data-prototype=longitude}, {root-autosar-data-prototype=laneLayer, context-data-prototype=DT_polyline_arrayMember_ARRAY/subElement, target-data-prototype=latitude}, {root-autosar-data-prototype=laneLayer, context-data-prototype=DT_polyline_arrayMember_ARRAY/subElement, target-data-prototype=DT_wgs84Coordinate/height}, {root-autosar-data-prototype=laneLayer, context-data-prototype=color, target-data-prototype=laneMarkingColor}, {root-autosar-data-prototype=laneLayer, context-data-prototype=laneGroupAssociationList, target-data-prototype=DT_laneGroupAssociatonList/arrayMember}, {root-autosar-data-prototype=laneLayer, context-data-prototype=DT_laneGroupAssociatonList_arrayMember_ARRAY/subElement, target-data-prototype=DT_laneGroupAssociation/laneGroupAssociationType}, {root-autosar-data-prototype=laneLayer, context-data-prototype=DT_laneGroupAssociatonList_arrayMember_ARRAY/subElement, target-data-prototype=laneGroupReferenceList}, {root-autosar-data-prototype=laneLayer, context-data-prototype=DT_laneGroupAssociation/laneGroupAssociationType, target-data-prototype=DT_laneGroupAssociationType/laneGroupAssociationType}, {root-autosar-data-prototype=laneLayer, context-data-prototype=laneGroupReferenceList, target-data-prototype=DT_referenceList/arrayMember}, {root-autosar-data-prototype=laneLayer, context-data-prototype=DT_referenceList_arrayMember_ARRAY/subElement, target-data-prototype=localId}, {root-autosar-data-prototype=laneLayer, context-data-prototype=DT_referenceList_arrayMember_ARRAY/subElement, target-data-prototype=referenceBaseIndex}, {root-autosar-data-prototype=laneLayer, context-data-prototype=DT_referenceList_arrayMember_ARRAY/subElement, target-data-prototype=inPositiveDirection}, {root-autosar-data-prototype=laneLayer, context-data-prototype=DT_laneLayer_struct/layerInfo, target-data-prototype=referenceBaseList}, {root-autosar-data-prototype=laneLayer, context-data-prototype=DT_laneLayer_struct/layerInfo, target-data-prototype=metaDataList}, {root-autosar-data-prototype=laneLayer, context-data-prototype=referenceBaseList, target-data-prototype=DT_referenceBaseList/arrayMember}, {root-autosar-data-prototype=laneLayer, context-data-prototype=DT_referenceBaseList_arrayMember_ARRAY/subElement, target-data-prototype=productId}, {root-autosar-data-prototype=laneLayer, context-data-prototype=DT_referenceBaseList_arrayMember_ARRAY/subElement, target-data-prototype=updateRegion}, {root-autosar-data-prototype=laneLayer, context-data-prototype=DT_referenceBaseList_arrayMember_ARRAY/subElement, target-data-prototype=tileId}, {root-autosar-data-prototype=laneLayer, context-data-prototype=metaDataList, target-data-prototype=DT_metaDataList/arrayMember}, {root-autosar-data-prototype=laneLayer, context-data-prototype=DT_metaDataList_arrayMember_ARRAY/subElement, target-data-prototype=countryCode}, {root-autosar-data-prototype=laneLayer, context-data-prototype=DT_metaDataList_arrayMember_ARRAY/subElement, target-data-prototype=regionCode}, {root-autosar-data-prototype=laneLayer, context-data-prototype=DT_metaDataList_arrayMember_ARRAY/subElement, target-data-prototype=mapAge}, {root-autosar-data-prototype=laneLayer, context-data-prototype=DT_metaDataList_arrayMember_ARRAY/subElement, target-data-prototype=qualityIndicators}, {root-autosar-data-prototype=laneLayer, context-data-prototype=DT_metaDataList_arrayMember_ARRAY/subElement, target-data-prototype=DT_metaData/trafficDirection}, {root-autosar-data-prototype=laneLayer, context-data-prototype=DT_metaDataList_arrayMember_ARRAY/subElement, target-data-prototype=generalSpeedLimits}, {root-autosar-data-prototype=laneLayer, context-data-prototype=DT_metaDataList_arrayMember_ARRAY/subElement, target-data-prototype=DT_metaData/speedUnit}, {root-autosar-data-prototype=laneLayer, context-data-prototype=mapAge, target-data-prototype=month}, {root-autosar-data-prototype=laneLayer, context-data-prototype=mapAge, target-data-prototype=DT_monthOfYear/year}, {root-autosar-data-prototype=laneLayer, context-data-prototype=qualityIndicators, target-data-prototype=DT_qualityIndicatorList/arrayMember}, {root-autosar-data-prototype=laneLayer, context-data-prototype=DT_qualityIndicatorList_arrayMember_ARRAY/subElement, target-data-prototype=DT_qualityIndicator/type}, {root-autosar-data-prototype=laneLayer, context-data-prototype=DT_qualityIndicatorList_arrayMember_ARRAY/subElement, target-data-prototype=quality}, {root-autosar-data-prototype=laneLayer, context-data-prototype=DT_qualityIndicator/type, target-data-prototype=qualityIndicatorType}, {root-autosar-data-prototype=laneLayer, context-data-prototype=DT_metaData/trafficDirection, target-data-prototype=DT_trafficDirection/trafficDirection}, {root-autosar-data-prototype=laneLayer, context-data-prototype=generalSpeedLimits, target-data-prototype=DT_generalSpeedLimitList/arrayMember}, {root-autosar-data-prototype=laneLayer, context-data-prototype=DT_generalSpeedLimitList_arrayMember_ARRAY/subElement, target-data-prototype=DT_generalSpeedLimit/type}, {root-autosar-data-prototype=laneLayer, context-data-prototype=DT_generalSpeedLimitList_arrayMember_ARRAY/subElement, target-data-prototype=DT_generalSpeedLimit/speedValue}, {root-autosar-data-prototype=laneLayer, context-data-prototype=DT_generalSpeedLimitList_arrayMember_ARRAY/subElement, target-data-prototype=constraint}, {root-autosar-data-prototype=laneLayer, context-data-prototype=DT_generalSpeedLimit/type, target-data-prototype=generalSpeedLimitType}, {root-autosar-data-prototype=laneLayer, context-data-prototype=constraint, target-data-prototype=DT_constraintList/arrayMember}, {root-autosar-data-prototype=laneLayer, context-data-prototype=DT_constraintList_arrayMember_ARRAY/subElement, target-data-prototype=daysOfWeek}, {root-autosar-data-prototype=laneLayer, context-data-prototype=DT_constraintList_arrayMember_ARRAY/subElement, target-data-prototype=timeRangeOfDay}, {root-autosar-data-prototype=laneLayer, context-data-prototype=DT_constraintList_arrayMember_ARRAY/subElement, target-data-prototype=weatherConstraint}, {root-autosar-data-prototype=laneLayer, context-data-prototype=DT_constraintList_arrayMember_ARRAY/subElement, target-data-prototype=timeClassifier}, {root-autosar-data-prototype=laneLayer, context-data-prototype=DT_constraintList_arrayMember_ARRAY/subElement, target-data-prototype=zoneClassifier}, {root-autosar-data-prototype=laneLayer, context-data-prototype=DT_constraintList_arrayMember_ARRAY/subElement, target-data-prototype=applicableVehicles}, {root-autosar-data-prototype=laneLayer, context-data-prototype=DT_constraintList_arrayMember_ARRAY/subElement, target-data-prototype=DT_constraint/turnConstraint}, {root-autosar-data-prototype=laneLayer, context-data-prototype=daysOfWeek, target-data-prototype=DT_listOfDays/arrayMember}, {root-autosar-data-prototype=laneLayer, context-data-prototype=timeRangeOfDay, target-data-prototype=startTimeHour}, {root-autosar-data-prototype=laneLayer, context-data-prototype=timeRangeOfDay, target-data-prototype=startTimeMinute}, {root-autosar-data-prototype=laneLayer, context-data-prototype=timeRangeOfDay, target-data-prototype=endTimeHour}, {root-autosar-data-prototype=laneLayer, context-data-prototype=timeRangeOfDay, target-data-prototype=endTimeMinute}, {root-autosar-data-prototype=laneLayer, context-data-prototype=weatherConstraint, target-data-prototype=Weather}, {root-autosar-data-prototype=laneLayer, context-data-prototype=timeClassifier, target-data-prototype=timeConstraintType}, {root-autosar-data-prototype=laneLayer, context-data-prototype=zoneClassifier, target-data-prototype=zoneConstraintType}, {root-autosar-data-prototype=laneLayer, context-data-prototype=applicableVehicles, target-data-prototype=applicableVehiclesType}, {root-autosar-data-prototype=laneLayer, context-data-prototype=DT_constraint/turnConstraint, target-data-prototype=DT_turnConstraint/turnConstraint}, {root-autosar-data-prototype=laneLayer, context-data-prototype=DT_metaData/speedUnit, target-data-prototype=DT_speedUnit/speedUnit}, {root-autosar-data-prototype=positioningObjectsLayer, context-data-prototype=DT_positioningObjectsLayer_vector/subElement, target-data-prototype=DT_positioningObjectsLayer_struct/id}, {root-autosar-data-prototype=positioningObjectsLayer, context-data-prototype=DT_positioningObjectsLayer_vector/subElement, target-data-prototype=positioningObjectsLayer}, {root-autosar-data-prototype=positioningObjectsLayer, context-data-prototype=DT_positioningObjectsLayer_vector/subElement, target-data-prototype=DT_positioningObjectsLayer_struct/layerInfo}, {root-autosar-data-prototype=positioningObjectsLayer, context-data-prototype=DT_positioningObjectsLayerpositioningObjectsLayer/subElement, target-data-prototype=confidenceLevel}, {root-autosar-data-prototype=positioningObjectsLayer, context-data-prototype=DT_positioningObjectsLayerpositioningObjectsLayer/subElement, target-data-prototype=detailedObjectList}, {root-autosar-data-prototype=positioningObjectsLayer, context-data-prototype=DT_positioningObjectsLayerpositioningObjectsLayer/subElement, target-data-prototype=position}, {root-autosar-data-prototype=positioningObjectsLayer, context-data-prototype=detailedObjectList, target-data-prototype=DT_landmarkObjectDetailsList/arrayMember}, {root-autosar-data-prototype=positioningObjectsLayer, context-data-prototype=DT_landmarkObjectDetailsList_arrayMember_ARRAY/subElement, target-data-prototype=objectType}, {root-autosar-data-prototype=positioningObjectsLayer, context-data-prototype=DT_landmarkObjectDetailsList_arrayMember_ARRAY/subElement, target-data-prototype=sign}, {root-autosar-data-prototype=positioningObjectsLayer, context-data-prototype=DT_landmarkObjectDetailsList_arrayMember_ARRAY/subElement, target-data-prototype=pole}, {root-autosar-data-prototype=positioningObjectsLayer, context-data-prototype=DT_landmarkObjectDetailsList_arrayMember_ARRAY/subElement, target-data-prototype=marking}, {root-autosar-data-prototype=positioningObjectsLayer, context-data-prototype=DT_landmarkObjectDetailsList_arrayMember_ARRAY/subElement, target-data-prototype=covariance}, {root-autosar-data-prototype=positioningObjectsLayer, context-data-prototype=DT_landmarkObjectDetailsList_arrayMember_ARRAY/subElement, target-data-prototype=marker}, {root-autosar-data-prototype=positioningObjectsLayer, context-data-prototype=objectType, target-data-prototype=landmarkObjectType}, {root-autosar-data-prototype=positioningObjectsLayer, context-data-prototype=sign, target-data-prototype=signShape}, {root-autosar-data-prototype=positioningObjectsLayer, context-data-prototype=sign, target-data-prototype=signMeaning}, {root-autosar-data-prototype=positioningObjectsLayer, context-data-prototype=sign, target-data-prototype=DT_landmarkObjectSign/diameter}, {root-autosar-data-prototype=positioningObjectsLayer, context-data-prototype=sign, target-data-prototype=DT_landmarkObjectSign/boundingBox}, {root-autosar-data-prototype=positioningObjectsLayer, context-data-prototype=signShape, target-data-prototype=landmarkObjectSignShape}, {root-autosar-data-prototype=positioningObjectsLayer, context-data-prototype=signMeaning, target-data-prototype=warningSign}, {root-autosar-data-prototype=positioningObjectsLayer, context-data-prototype=DT_landmarkObjectSign/boundingBox, target-data-prototype=DT_polyline/arrayMember}, {root-autosar-data-prototype=positioningObjectsLayer, context-data-prototype=DT_polyline_arrayMember_ARRAY/subElement, target-data-prototype=longitude}, {root-autosar-data-prototype=positioningObjectsLayer, context-data-prototype=DT_polyline_arrayMember_ARRAY/subElement, target-data-prototype=latitude}, {root-autosar-data-prototype=positioningObjectsLayer, context-data-prototype=DT_polyline_arrayMember_ARRAY/subElement, target-data-prototype=DT_wgs84Coordinate/height}, {root-autosar-data-prototype=positioningObjectsLayer, context-data-prototype=pole, target-data-prototype=polePositionGround}, {root-autosar-data-prototype=positioningObjectsLayer, context-data-prototype=pole, target-data-prototype=polePositionTop}, {root-autosar-data-prototype=positioningObjectsLayer, context-data-prototype=pole, target-data-prototype=DT_landmarkObjectDetailsPole/diameter}, {root-autosar-data-prototype=positioningObjectsLayer, context-data-prototype=pole, target-data-prototype=diameterTop}, {root-autosar-data-prototype=positioningObjectsLayer, context-data-prototype=pole, target-data-prototype=DT_landmarkObjectDetailsPole/height}, {root-autosar-data-prototype=positioningObjectsLayer, context-data-prototype=pole, target-data-prototype=poleType}, {root-autosar-data-prototype=positioningObjectsLayer, context-data-prototype=polePositionGround, target-data-prototype=longitude}, {root-autosar-data-prototype=positioningObjectsLayer, context-data-prototype=polePositionGround, target-data-prototype=latitude}, {root-autosar-data-prototype=positioningObjectsLayer, context-data-prototype=polePositionGround, target-data-prototype=DT_wgs84Coordinate/height}, {root-autosar-data-prototype=positioningObjectsLayer, context-data-prototype=polePositionTop, target-data-prototype=longitude}, {root-autosar-data-prototype=positioningObjectsLayer, context-data-prototype=polePositionTop, target-data-prototype=latitude}, {root-autosar-data-prototype=positioningObjectsLayer, context-data-prototype=polePositionTop, target-data-prototype=DT_wgs84Coordinate/height}, {root-autosar-data-prototype=positioningObjectsLayer, context-data-prototype=poleType, target-data-prototype=landmarkObjectPoleType}, {root-autosar-data-prototype=positioningObjectsLayer, context-data-prototype=marking, target-data-prototype=markingType}, {root-autosar-data-prototype=positioningObjectsLayer, context-data-prototype=marking, target-data-prototype=colorType}, {root-autosar-data-prototype=positioningObjectsLayer, context-data-prototype=marking, target-data-prototype=DT_landmarkObjectDetailsMarking/boundingBox}, {root-autosar-data-prototype=positioningObjectsLayer, context-data-prototype=marking, target-data-prototype=line}, {root-autosar-data-prototype=positioningObjectsLayer, context-data-prototype=markingType, target-data-prototype=landmarkObjectMarkingType}, {root-autosar-data-prototype=positioningObjectsLayer, context-data-prototype=colorType, target-data-prototype=laneMarkingColor}, {root-autosar-data-prototype=positioningObjectsLayer, context-data-prototype=DT_landmarkObjectDetailsMarking/boundingBox, target-data-prototype=DT_polyline/arrayMember}, {root-autosar-data-prototype=positioningObjectsLayer, context-data-prototype=DT_polyline_arrayMember_ARRAY/subElement, target-data-prototype=longitude}, {root-autosar-data-prototype=positioningObjectsLayer, context-data-prototype=DT_polyline_arrayMember_ARRAY/subElement, target-data-prototype=latitude}, {root-autosar-data-prototype=positioningObjectsLayer, context-data-prototype=DT_polyline_arrayMember_ARRAY/subElement, target-data-prototype=DT_wgs84Coordinate/height}, {root-autosar-data-prototype=positioningObjectsLayer, context-data-prototype=line, target-data-prototype=DT_polyline/arrayMember}, {root-autosar-data-prototype=positioningObjectsLayer, context-data-prototype=DT_polyline_arrayMember_ARRAY/subElement, target-data-prototype=longitude}, {root-autosar-data-prototype=positioningObjectsLayer, context-data-prototype=DT_polyline_arrayMember_ARRAY/subElement, target-data-prototype=latitude}, {root-autosar-data-prototype=positioningObjectsLayer, context-data-prototype=DT_polyline_arrayMember_ARRAY/subElement, target-data-prototype=DT_wgs84Coordinate/height}, {root-autosar-data-prototype=positioningObjectsLayer, context-data-prototype=covariance, target-data-prototype=varianceXX}, {root-autosar-data-prototype=positioningObjectsLayer, context-data-prototype=covariance, target-data-prototype=varianceYY}, {root-autosar-data-prototype=positioningObjectsLayer, context-data-prototype=covariance, target-data-prototype=varianceZZ}, {root-autosar-data-prototype=positioningObjectsLayer, context-data-prototype=covariance, target-data-prototype=covarianceXY}, {root-autosar-data-prototype=positioningObjectsLayer, context-data-prototype=marker, target-data-prototype=applicableVehiclesType}, {root-autosar-data-prototype=positioningObjectsLayer, context-data-prototype=position, target-data-prototype=longitude}, {root-autosar-data-prototype=positioningObjectsLayer, context-data-prototype=position, target-data-prototype=latitude}, {root-autosar-data-prototype=positioningObjectsLayer, context-data-prototype=position, target-data-prototype=DT_wgs84Coordinate/height}, {root-autosar-data-prototype=positioningObjectsLayer, context-data-prototype=DT_positioningObjectsLayer_struct/layerInfo, target-data-prototype=referenceBaseList}, {root-autosar-data-prototype=positioningObjectsLayer, context-data-prototype=DT_positioningObjectsLayer_struct/layerInfo, target-data-prototype=metaDataList}, {root-autosar-data-prototype=positioningObjectsLayer, context-data-prototype=referenceBaseList, target-data-prototype=DT_referenceBaseList/arrayMember}, {root-autosar-data-prototype=positioningObjectsLayer, context-data-prototype=DT_referenceBaseList_arrayMember_ARRAY/subElement, target-data-prototype=productId}, {root-autosar-data-prototype=positioningObjectsLayer, context-data-prototype=DT_referenceBaseList_arrayMember_ARRAY/subElement, target-data-prototype=updateRegion}, {root-autosar-data-prototype=positioningObjectsLayer, context-data-prototype=DT_referenceBaseList_arrayMember_ARRAY/subElement, target-data-prototype=tileId}, {root-autosar-data-prototype=positioningObjectsLayer, context-data-prototype=metaDataList, target-data-prototype=DT_metaDataList/arrayMember}, {root-autosar-data-prototype=positioningObjectsLayer, context-data-prototype=DT_metaDataList_arrayMember_ARRAY/subElement, target-data-prototype=countryCode}, {root-autosar-data-prototype=positioningObjectsLayer, context-data-prototype=DT_metaDataList_arrayMember_ARRAY/subElement, target-data-prototype=regionCode}, {root-autosar-data-prototype=positioningObjectsLayer, context-data-prototype=DT_metaDataList_arrayMember_ARRAY/subElement, target-data-prototype=mapAge}, {root-autosar-data-prototype=positioningObjectsLayer, context-data-prototype=DT_metaDataList_arrayMember_ARRAY/subElement, target-data-prototype=qualityIndicators}, {root-autosar-data-prototype=positioningObjectsLayer, context-data-prototype=DT_metaDataList_arrayMember_ARRAY/subElement, target-data-prototype=DT_metaData/trafficDirection}, {root-autosar-data-prototype=positioningObjectsLayer, context-data-prototype=DT_metaDataList_arrayMember_ARRAY/subElement, target-data-prototype=generalSpeedLimits}, {root-autosar-data-prototype=positioningObjectsLayer, context-data-prototype=DT_metaDataList_arrayMember_ARRAY/subElement, target-data-prototype=DT_metaData/speedUnit}, {root-autosar-data-prototype=positioningObjectsLayer, context-data-prototype=mapAge, target-data-prototype=month}, {root-autosar-data-prototype=positioningObjectsLayer, context-data-prototype=mapAge, target-data-prototype=DT_monthOfYear/year}, {root-autosar-data-prototype=positioningObjectsLayer, context-data-prototype=qualityIndicators, target-data-prototype=DT_qualityIndicatorList/arrayMember}, {root-autosar-data-prototype=positioningObjectsLayer, context-data-prototype=DT_qualityIndicatorList_arrayMember_ARRAY/subElement, target-data-prototype=DT_qualityIndicator/type}, {root-autosar-data-prototype=positioningObjectsLayer, context-data-prototype=DT_qualityIndicatorList_arrayMember_ARRAY/subElement, target-data-prototype=quality}, {root-autosar-data-prototype=positioningObjectsLayer, context-data-prototype=DT_qualityIndicator/type, target-data-prototype=qualityIndicatorType}, {root-autosar-data-prototype=positioningObjectsLayer, context-data-prototype=DT_metaData/trafficDirection, target-data-prototype=DT_trafficDirection/trafficDirection}, {root-autosar-data-prototype=positioningObjectsLayer, context-data-prototype=generalSpeedLimits, target-data-prototype=DT_generalSpeedLimitList/arrayMember}, {root-autosar-data-prototype=positioningObjectsLayer, context-data-prototype=DT_generalSpeedLimitList_arrayMember_ARRAY/subElement, target-data-prototype=DT_generalSpeedLimit/type}, {root-autosar-data-prototype=positioningObjectsLayer, context-data-prototype=DT_generalSpeedLimitList_arrayMember_ARRAY/subElement, target-data-prototype=DT_generalSpeedLimit/speedValue}, {root-autosar-data-prototype=positioningObjectsLayer, context-data-prototype=DT_generalSpeedLimitList_arrayMember_ARRAY/subElement, target-data-prototype=constraint}, {root-autosar-data-prototype=positioningObjectsLayer, context-data-prototype=DT_generalSpeedLimit/type, target-data-prototype=generalSpeedLimitType}, {root-autosar-data-prototype=positioningObjectsLayer, context-data-prototype=constraint, target-data-prototype=DT_constraintList/arrayMember}, {root-autosar-data-prototype=positioningObjectsLayer, context-data-prototype=DT_constraintList_arrayMember_ARRAY/subElement, target-data-prototype=daysOfWeek}, {root-autosar-data-prototype=positioningObjectsLayer, context-data-prototype=DT_constraintList_arrayMember_ARRAY/subElement, target-data-prototype=timeRangeOfDay}, {root-autosar-data-prototype=positioningObjectsLayer, context-data-prototype=DT_constraintList_arrayMember_ARRAY/subElement, target-data-prototype=weatherConstraint}, {root-autosar-data-prototype=positioningObjectsLayer, context-data-prototype=DT_constraintList_arrayMember_ARRAY/subElement, target-data-prototype=timeClassifier}, {root-autosar-data-prototype=positioningObjectsLayer, context-data-prototype=DT_constraintList_arrayMember_ARRAY/subElement, target-data-prototype=zoneClassifier}, {root-autosar-data-prototype=positioningObjectsLayer, context-data-prototype=DT_constraintList_arrayMember_ARRAY/subElement, target-data-prototype=applicableVehicles}, {root-autosar-data-prototype=positioningObjectsLayer, context-data-prototype=DT_constraintList_arrayMember_ARRAY/subElement, target-data-prototype=DT_constraint/turnConstraint}, {root-autosar-data-prototype=positioningObjectsLayer, context-data-prototype=daysOfWeek, target-data-prototype=DT_listOfDays/arrayMember}, {root-autosar-data-prototype=positioningObjectsLayer, context-data-prototype=timeRangeOfDay, target-data-prototype=startTimeHour}, {root-autosar-data-prototype=positioningObjectsLayer, context-data-prototype=timeRangeOfDay, target-data-prototype=startTimeMinute}, {root-autosar-data-prototype=positioningObjectsLayer, context-data-prototype=timeRangeOfDay, target-data-prototype=endTimeHour}, {root-autosar-data-prototype=positioningObjectsLayer, context-data-prototype=timeRangeOfDay, target-data-prototype=endTimeMinute}, {root-autosar-data-prototype=positioningObjectsLayer, context-data-prototype=weatherConstraint, target-data-prototype=Weather}, {root-autosar-data-prototype=positioningObjectsLayer, context-data-prototype=timeClassifier, target-data-prototype=timeConstraintType}, {root-autosar-data-prototype=positioningObjectsLayer, context-data-prototype=zoneClassifier, target-data-prototype=zoneConstraintType}, {root-autosar-data-prototype=positioningObjectsLayer, context-data-prototype=applicableVehicles, target-data-prototype=applicableVehiclesType}, {root-autosar-data-prototype=positioningObjectsLayer, context-data-prototype=DT_constraint/turnConstraint, target-data-prototype=DT_turnConstraint/turnConstraint}, {root-autosar-data-prototype=positioningObjectsLayer, context-data-prototype=DT_metaData/speedUnit, target-data-prototype=DT_speedUnit/speedUnit}, {root-autosar-data-prototype=egoPositionLayer, context-data-prototype=DT_egoPositionLayer_vector/subElement, target-data-prototype=DT_egoPositionLayer_struct/id}, {root-autosar-data-prototype=egoPositionLayer, context-data-prototype=DT_egoPositionLayer_vector/subElement, target-data-prototype=egoPositionLayer}, {root-autosar-data-prototype=egoPositionLayer, context-data-prototype=DT_egoPositionLayer_vector/subElement, target-data-prototype=DT_egoPositionLayer_struct/layerInfo}, {root-autosar-data-prototype=egoPositionLayer, context-data-prototype=egoPositionLayer, target-data-prototype=egoPosition}, {root-autosar-data-prototype=egoPositionLayer, context-data-prototype=egoPositionLayer, target-data-prototype=routeGuidanceActive}, {root-autosar-data-prototype=egoPositionLayer, context-data-prototype=egoPositionLayer, target-data-prototype=routeGuidanceChanged}, {root-autosar-data-prototype=egoPositionLayer, context-data-prototype=egoPositionLayer, target-data-prototype=pathList}, {root-autosar-data-prototype=egoPositionLayer, context-data-prototype=egoPositionLayer, target-data-prototype=routeLength}, {root-autosar-data-prototype=egoPositionLayer, context-data-prototype=egoPosition, target-data-prototype=linkPose}, {root-autosar-data-prototype=egoPositionLayer, context-data-prototype=egoPosition, target-data-prototype=lanePose}, {root-autosar-data-prototype=egoPositionLayer, context-data-prototype=egoPosition, target-data-prototype=rawPose}, {root-autosar-data-prototype=egoPositionLayer, context-data-prototype=egoPosition, target-data-prototype=timeStamp}, {root-autosar-data-prototype=egoPositionLayer, context-data-prototype=egoPosition, target-data-prototype=speed}, {root-autosar-data-prototype=egoPositionLayer, context-data-prototype=linkPose, target-data-prototype=DT_linkPose/pose}, {root-autosar-data-prototype=egoPositionLayer, context-data-prototype=linkPose, target-data-prototype=linkRelativeCoordinate}, {root-autosar-data-prototype=egoPositionLayer, context-data-prototype=linkPose, target-data-prototype=DT_linkPose/mapMatchingAccuracy}, {root-autosar-data-prototype=egoPositionLayer, context-data-prototype=DT_linkPose/pose, target-data-prototype=coordinate}, {root-autosar-data-prototype=egoPositionLayer, context-data-prototype=DT_linkPose/pose, target-data-prototype=heading}, {root-autosar-data-prototype=egoPositionLayer, context-data-prototype=coordinate, target-data-prototype=longitude}, {root-autosar-data-prototype=egoPositionLayer, context-data-prototype=coordinate, target-data-prototype=latitude}, {root-autosar-data-prototype=egoPositionLayer, context-data-prototype=coordinate, target-data-prototype=DT_wgs84Coordinate/height}, {root-autosar-data-prototype=egoPositionLayer, context-data-prototype=linkRelativeCoordinate, target-data-prototype=DT_relativeCoordinate/reference}, {root-autosar-data-prototype=egoPositionLayer, context-data-prototype=linkRelativeCoordinate, target-data-prototype=DT_relativeCoordinate/offset}, {root-autosar-data-prototype=egoPositionLayer, context-data-prototype=DT_relativeCoordinate/reference, target-data-prototype=localId}, {root-autosar-data-prototype=egoPositionLayer, context-data-prototype=DT_relativeCoordinate/reference, target-data-prototype=referenceBaseIndex}, {root-autosar-data-prototype=egoPositionLayer, context-data-prototype=DT_relativeCoordinate/reference, target-data-prototype=inPositiveDirection}, {root-autosar-data-prototype=egoPositionLayer, context-data-prototype=lanePose, target-data-prototype=DT_lanePose/pose}, {root-autosar-data-prototype=egoPositionLayer, context-data-prototype=lanePose, target-data-prototype=laneRelativeCoordinate}, {root-autosar-data-prototype=egoPositionLayer, context-data-prototype=lanePose, target-data-prototype=DT_lanePose/mapMatchingAccuracy}, {root-autosar-data-prototype=egoPositionLayer, context-data-prototype=DT_lanePose/pose, target-data-prototype=coordinate}, {root-autosar-data-prototype=egoPositionLayer, context-data-prototype=DT_lanePose/pose, target-data-prototype=heading}, {root-autosar-data-prototype=egoPositionLayer, context-data-prototype=coordinate, target-data-prototype=longitude}, {root-autosar-data-prototype=egoPositionLayer, context-data-prototype=coordinate, target-data-prototype=latitude}, {root-autosar-data-prototype=egoPositionLayer, context-data-prototype=coordinate, target-data-prototype=DT_wgs84Coordinate/height}, {root-autosar-data-prototype=egoPositionLayer, context-data-prototype=laneRelativeCoordinate, target-data-prototype=DT_relativeCoordinate/reference}, {root-autosar-data-prototype=egoPositionLayer, context-data-prototype=laneRelativeCoordinate, target-data-prototype=DT_relativeCoordinate/offset}, {root-autosar-data-prototype=egoPositionLayer, context-data-prototype=DT_relativeCoordinate/reference, target-data-prototype=localId}, {root-autosar-data-prototype=egoPositionLayer, context-data-prototype=DT_relativeCoordinate/reference, target-data-prototype=referenceBaseIndex}, {root-autosar-data-prototype=egoPositionLayer, context-data-prototype=DT_relativeCoordinate/reference, target-data-prototype=inPositiveDirection}, {root-autosar-data-prototype=egoPositionLayer, context-data-prototype=rawPose, target-data-prototype=coordinate}, {root-autosar-data-prototype=egoPositionLayer, context-data-prototype=rawPose, target-data-prototype=heading}, {root-autosar-data-prototype=egoPositionLayer, context-data-prototype=coordinate, target-data-prototype=longitude}, {root-autosar-data-prototype=egoPositionLayer, context-data-prototype=coordinate, target-data-prototype=latitude}, {root-autosar-data-prototype=egoPositionLayer, context-data-prototype=coordinate, target-data-prototype=DT_wgs84Coordinate/height}, {root-autosar-data-prototype=egoPositionLayer, context-data-prototype=pathList, target-data-prototype=DT_pathList/arrayMember}, {root-autosar-data-prototype=egoPositionLayer, context-data-prototype=DT_pathList_arrayMember_ARRAY/subElement, target-data-prototype=DT_path/pathType}, {root-autosar-data-prototype=egoPositionLayer, context-data-prototype=DT_pathList_arrayMember_ARRAY/subElement, target-data-prototype=pathElementList}, {root-autosar-data-prototype=egoPositionLayer, context-data-prototype=DT_pathList_arrayMember_ARRAY/subElement, target-data-prototype=pathID}, {root-autosar-data-prototype=egoPositionLayer, context-data-prototype=DT_pathList_arrayMember_ARRAY/subElement, target-data-prototype=DT_path/confidence}, {root-autosar-data-prototype=egoPositionLayer, context-data-prototype=DT_path/pathType, target-data-prototype=DT_pathType/pathType}, {root-autosar-data-prototype=egoPositionLayer, context-data-prototype=pathElementList, target-data-prototype=DT_pathElementList/arrayMember}, {root-autosar-data-prototype=egoPositionLayer, context-data-prototype=DT_pathElementList_arrayMember_ARRAY/subElement, target-data-prototype=DT_pathElement/linkReference}, {root-autosar-data-prototype=egoPositionLayer, context-data-prototype=DT_pathElementList_arrayMember_ARRAY/subElement, target-data-prototype=positiveGeometryDirection}, {root-autosar-data-prototype=egoPositionLayer, context-data-prototype=DT_pathElement/linkReference, target-data-prototype=localId}, {root-autosar-data-prototype=egoPositionLayer, context-data-prototype=DT_pathElement/linkReference, target-data-prototype=referenceBaseIndex}, {root-autosar-data-prototype=egoPositionLayer, context-data-prototype=DT_pathElement/linkReference, target-data-prototype=inPositiveDirection}, {root-autosar-data-prototype=egoPositionLayer, context-data-prototype=DT_egoPositionLayer_struct/layerInfo, target-data-prototype=referenceBaseList}, {root-autosar-data-prototype=egoPositionLayer, context-data-prototype=DT_egoPositionLayer_struct/layerInfo, target-data-prototype=metaDataList}, {root-autosar-data-prototype=egoPositionLayer, context-data-prototype=referenceBaseList, target-data-prototype=DT_referenceBaseList/arrayMember}, {root-autosar-data-prototype=egoPositionLayer, context-data-prototype=DT_referenceBaseList_arrayMember_ARRAY/subElement, target-data-prototype=productId}, {root-autosar-data-prototype=egoPositionLayer, context-data-prototype=DT_referenceBaseList_arrayMember_ARRAY/subElement, target-data-prototype=updateRegion}, {root-autosar-data-prototype=egoPositionLayer, context-data-prototype=DT_referenceBaseList_arrayMember_ARRAY/subElement, target-data-prototype=tileId}, {root-autosar-data-prototype=egoPositionLayer, context-data-prototype=metaDataList, target-data-prototype=DT_metaDataList/arrayMember}, {root-autosar-data-prototype=egoPositionLayer, context-data-prototype=DT_metaDataList_arrayMember_ARRAY/subElement, target-data-prototype=countryCode}, {root-autosar-data-prototype=egoPositionLayer, context-data-prototype=DT_metaDataList_arrayMember_ARRAY/subElement, target-data-prototype=regionCode}, {root-autosar-data-prototype=egoPositionLayer, context-data-prototype=DT_metaDataList_arrayMember_ARRAY/subElement, target-data-prototype=mapAge}, {root-autosar-data-prototype=egoPositionLayer, context-data-prototype=DT_metaDataList_arrayMember_ARRAY/subElement, target-data-prototype=qualityIndicators}, {root-autosar-data-prototype=egoPositionLayer, context-data-prototype=DT_metaDataList_arrayMember_ARRAY/subElement, target-data-prototype=DT_metaData/trafficDirection}, {root-autosar-data-prototype=egoPositionLayer, context-data-prototype=DT_metaDataList_arrayMember_ARRAY/subElement, target-data-prototype=generalSpeedLimits}, {root-autosar-data-prototype=egoPositionLayer, context-data-prototype=DT_metaDataList_arrayMember_ARRAY/subElement, target-data-prototype=DT_metaData/speedUnit}, {root-autosar-data-prototype=egoPositionLayer, context-data-prototype=mapAge, target-data-prototype=month}, {root-autosar-data-prototype=egoPositionLayer, context-data-prototype=mapAge, target-data-prototype=DT_monthOfYear/year}, {root-autosar-data-prototype=egoPositionLayer, context-data-prototype=qualityIndicators, target-data-prototype=DT_qualityIndicatorList/arrayMember}, {root-autosar-data-prototype=egoPositionLayer, context-data-prototype=DT_qualityIndicatorList_arrayMember_ARRAY/subElement,
  ... target-data-prototype=DT_qualityIndicator/type}, {root-autosar-data-prototype=egoPositionLayer, context-data-prototype=DT_qualityIndicatorList_arrayMember_ARRAY/subElement, target-data-prototype=quality}, {root-autosar-data-prototype=egoPositionLayer, context-data-prototype=DT_qualityIndicator/type, target-data-prototype=qualityIndicatorType}, {root-autosar-data-prototype=egoPositionLayer, context-data-prototype=DT_metaData/trafficDirection, target-data-prototype=DT_trafficDirection/trafficDirection}, {root-autosar-data-prototype=egoPositionLayer, context-data-prototype=generalSpeedLimits, target-data-prototype=DT_generalSpeedLimitList/arrayMember}, {root-autosar-data-prototype=egoPositionLayer, context-data-prototype=DT_generalSpeedLimitList_arrayMember_ARRAY/subElement, target-data-prototype=DT_generalSpeedLimit/type}, {root-autosar-data-prototype=egoPositionLayer, context-data-prototype=DT_generalSpeedLimitList_arrayMember_ARRAY/subElement, target-data-prototype=DT_generalSpeedLimit/speedValue}, {root-autosar-data-prototype=egoPositionLayer, context-data-prototype=DT_generalSpeedLimitList_arrayMember_ARRAY/subElement, target-data-prototype=constraint}, {root-autosar-data-prototype=egoPositionLayer, context-data-prototype=DT_generalSpeedLimit/type, target-data-prototype=generalSpeedLimitType}, {root-autosar-data-prototype=egoPositionLayer, context-data-prototype=constraint, target-data-prototype=DT_constraintList/arrayMember}, {root-autosar-data-prototype=egoPositionLayer, context-data-prototype=DT_constraintList_arrayMember_ARRAY/subElement, target-data-prototype=daysOfWeek}, {root-autosar-data-prototype=egoPositionLayer, context-data-prototype=DT_constraintList_arrayMember_ARRAY/subElement, target-data-prototype=timeRangeOfDay}, {root-autosar-data-prototype=egoPositionLayer, context-data-prototype=DT_constraintList_arrayMember_ARRAY/subElement, target-data-prototype=weatherConstraint}, {root-autosar-data-prototype=egoPositionLayer, context-data-prototype=DT_constraintList_arrayMember_ARRAY/subElement, target-data-prototype=timeClassifier}, {root-autosar-data-prototype=egoPositionLayer, context-data-prototype=DT_constraintList_arrayMember_ARRAY/subElement, target-data-prototype=zoneClassifier}, {root-autosar-data-prototype=egoPositionLayer, context-data-prototype=DT_constraintList_arrayMember_ARRAY/subElement, target-data-prototype=applicableVehicles}, {root-autosar-data-prototype=egoPositionLayer, context-data-prototype=DT_constraintList_arrayMember_ARRAY/subElement, target-data-prototype=DT_constraint/turnConstraint}, {root-autosar-data-prototype=egoPositionLayer, context-data-prototype=daysOfWeek, target-data-prototype=DT_listOfDays/arrayMember}, {root-autosar-data-prototype=egoPositionLayer, context-data-prototype=timeRangeOfDay, target-data-prototype=startTimeHour}, {root-autosar-data-prototype=egoPositionLayer, context-data-prototype=timeRangeOfDay, target-data-prototype=startTimeMinute}, {root-autosar-data-prototype=egoPositionLayer, context-data-prototype=timeRangeOfDay, target-data-prototype=endTimeHour}, {root-autosar-data-prototype=egoPositionLayer, context-data-prototype=timeRangeOfDay, target-data-prototype=endTimeMinute}, {root-autosar-data-prototype=egoPositionLayer, context-data-prototype=weatherConstraint, target-data-prototype=Weather}, {root-autosar-data-prototype=egoPositionLayer, context-data-prototype=timeClassifier, target-data-prototype=timeConstraintType}, {root-autosar-data-prototype=egoPositionLayer, context-data-prototype=zoneClassifier, target-data-prototype=zoneConstraintType}, {root-autosar-data-prototype=egoPositionLayer, context-data-prototype=applicableVehicles, target-data-prototype=applicableVehiclesType}, {root-autosar-data-prototype=egoPositionLayer, context-data-prototype=DT_constraint/turnConstraint, target-data-prototype=DT_turnConstraint/turnConstraint}, {root-autosar-data-prototype=egoPositionLayer, context-data-prototype=DT_metaData/speedUnit, target-data-prototype=DT_speedUnit/speedUnit}, {root-autosar-data-prototype=dynamicContentLayer, context-data-prototype=DT_dynamicContentLayer_vector/subElement, target-data-prototype=DT_dynamicContentLayer_struct/id}, {root-autosar-data-prototype=dynamicContentLayer, context-data-prototype=DT_dynamicContentLayer_vector/subElement, target-data-prototype=dynamicContentLayer}, {root-autosar-data-prototype=dynamicContentLayer, context-data-prototype=DT_dynamicContentLayer_vector/subElement, target-data-prototype=DT_dynamicContentLayer_struct/layerInfo}, {root-autosar-data-prototype=dynamicContentLayer, context-data-prototype=dynamicContentLayer, target-data-prototype=dynamicAttributes}, {root-autosar-data-prototype=dynamicContentLayer, context-data-prototype=dynamicAttributes, target-data-prototype=DT_referencedAttributeList/arrayMember}, {root-autosar-data-prototype=dynamicContentLayer, context-data-prototype=DT_referencedAttributeList_arrayMember_ARRAY/subElement, target-data-prototype=DT_referencedAttribute/linkReference}, {root-autosar-data-prototype=dynamicContentLayer, context-data-prototype=DT_referencedAttributeList_arrayMember_ARRAY/subElement, target-data-prototype=DT_referencedAttribute/laneReference}, {root-autosar-data-prototype=dynamicContentLayer, context-data-prototype=DT_referencedAttributeList_arrayMember_ARRAY/subElement, target-data-prototype=DT_referencedAttribute/attributeList}, {root-autosar-data-prototype=dynamicContentLayer, context-data-prototype=DT_referencedAttributeList_arrayMember_ARRAY/subElement, target-data-prototype=psd15SegmentReference}, {root-autosar-data-prototype=dynamicContentLayer, context-data-prototype=DT_referencedAttribute/linkReference, target-data-prototype=localId}, {root-autosar-data-prototype=dynamicContentLayer, context-data-prototype=DT_referencedAttribute/linkReference, target-data-prototype=referenceBaseIndex}, {root-autosar-data-prototype=dynamicContentLayer, context-data-prototype=DT_referencedAttribute/linkReference, target-data-prototype=inPositiveDirection}, {root-autosar-data-prototype=dynamicContentLayer, context-data-prototype=DT_referencedAttribute/laneReference, target-data-prototype=localId}, {root-autosar-data-prototype=dynamicContentLayer, context-data-prototype=DT_referencedAttribute/laneReference, target-data-prototype=referenceBaseIndex}, {root-autosar-data-prototype=dynamicContentLayer, context-data-prototype=DT_referencedAttribute/laneReference, target-data-prototype=inPositiveDirection}, {root-autosar-data-prototype=dynamicContentLayer, context-data-prototype=DT_referencedAttribute/attributeList, target-data-prototype=DT_attributeList/arrayMember}, {root-autosar-data-prototype=dynamicContentLayer, context-data-prototype=DT_attributeList_arrayMember_ARRAY/subElement, target-data-prototype=DT_attribute/confidence}, {root-autosar-data-prototype=dynamicContentLayer, context-data-prototype=DT_attributeList_arrayMember_ARRAY/subElement, target-data-prototype=attributeType}, {root-autosar-data-prototype=dynamicContentLayer, context-data-prototype=DT_attributeList_arrayMember_ARRAY/subElement, target-data-prototype=DT_attribute/direction}, {root-autosar-data-prototype=dynamicContentLayer, context-data-prototype=DT_attributeList_arrayMember_ARRAY/subElement, target-data-prototype=attributePointList}, {root-autosar-data-prototype=dynamicContentLayer, context-data-prototype=DT_attribute/direction, target-data-prototype=DT_direction/direction}, {root-autosar-data-prototype=dynamicContentLayer, context-data-prototype=attributePointList, target-data-prototype=DT_attributePointList/arrayMember}, {root-autosar-data-prototype=dynamicContentLayer, context-data-prototype=DT_attributePointList_arrayMember_ARRAY/subElement, target-data-prototype=DT_attributePoint/offset}, {root-autosar-data-prototype=dynamicContentLayer, context-data-prototype=DT_attributePointList_arrayMember_ARRAY/subElement, target-data-prototype=attributeValue}, {root-autosar-data-prototype=dynamicContentLayer, context-data-prototype=DT_attributePointList_arrayMember_ARRAY/subElement, target-data-prototype=DT_attributePoint/laneList}, {root-autosar-data-prototype=dynamicContentLayer, context-data-prototype=attributeValue, target-data-prototype=intValue}, {root-autosar-data-prototype=dynamicContentLayer, context-data-prototype=attributeValue, target-data-prototype=floatValue}, {root-autosar-data-prototype=dynamicContentLayer, context-data-prototype=attributeValue, target-data-prototype=blobValue}, {root-autosar-data-prototype=dynamicContentLayer, context-data-prototype=attributeValue, target-data-prototype=speedLimit}, {root-autosar-data-prototype=dynamicContentLayer, context-data-prototype=attributeValue, target-data-prototype=overtakingProhibition}, {root-autosar-data-prototype=dynamicContentLayer, context-data-prototype=blobValue, target-data-prototype=DT_byteArray/arrayMember}, {root-autosar-data-prototype=dynamicContentLayer, context-data-prototype=speedLimit, target-data-prototype=DT_speedLimit/speedValue}, {root-autosar-data-prototype=dynamicContentLayer, context-data-prototype=speedLimit, target-data-prototype=source}, {root-autosar-data-prototype=dynamicContentLayer, context-data-prototype=speedLimit, target-data-prototype=DT_speedLimit/constraintList}, {root-autosar-data-prototype=dynamicContentLayer, context-data-prototype=speedLimit, target-data-prototype=DT_speedLimit/online}, {root-autosar-data-prototype=dynamicContentLayer, context-data-prototype=source, target-data-prototype=speedLimitSource}, {root-autosar-data-prototype=dynamicContentLayer, context-data-prototype=DT_speedLimit/constraintList, target-data-prototype=DT_constraintList/arrayMember}, {root-autosar-data-prototype=dynamicContentLayer, context-data-prototype=DT_constraintList_arrayMember_ARRAY/subElement, target-data-prototype=daysOfWeek}, {root-autosar-data-prototype=dynamicContentLayer, context-data-prototype=DT_constraintList_arrayMember_ARRAY/subElement, target-data-prototype=timeRangeOfDay}, {root-autosar-data-prototype=dynamicContentLayer, context-data-prototype=DT_constraintList_arrayMember_ARRAY/subElement, target-data-prototype=weatherConstraint}, {root-autosar-data-prototype=dynamicContentLayer, context-data-prototype=DT_constraintList_arrayMember_ARRAY/subElement, target-data-prototype=timeClassifier}, {root-autosar-data-prototype=dynamicContentLayer, context-data-prototype=DT_constraintList_arrayMember_ARRAY/subElement, target-data-prototype=zoneClassifier}, {root-autosar-data-prototype=dynamicContentLayer, context-data-prototype=DT_constraintList_arrayMember_ARRAY/subElement, target-data-prototype=applicableVehicles}, {root-autosar-data-prototype=dynamicContentLayer, context-data-prototype=DT_constraintList_arrayMember_ARRAY/subElement, target-data-prototype=DT_constraint/turnConstraint}, {root-autosar-data-prototype=dynamicContentLayer, context-data-prototype=daysOfWeek, target-data-prototype=DT_listOfDays/arrayMember}, {root-autosar-data-prototype=dynamicContentLayer, context-data-prototype=timeRangeOfDay, target-data-prototype=startTimeHour}, {root-autosar-data-prototype=dynamicContentLayer, context-data-prototype=timeRangeOfDay, target-data-prototype=startTimeMinute}, {root-autosar-data-prototype=dynamicContentLayer, context-data-prototype=timeRangeOfDay, target-data-prototype=endTimeHour}, {root-autosar-data-prototype=dynamicContentLayer, context-data-prototype=timeRangeOfDay, target-data-prototype=endTimeMinute}, {root-autosar-data-prototype=dynamicContentLayer, context-data-prototype=weatherConstraint, target-data-prototype=Weather}, {root-autosar-data-prototype=dynamicContentLayer, context-data-prototype=timeClassifier, target-data-prototype=timeConstraintType}, {root-autosar-data-prototype=dynamicContentLayer, context-data-prototype=zoneClassifier, target-data-prototype=zoneConstraintType}, {root-autosar-data-prototype=dynamicContentLayer, context-data-prototype=applicableVehicles, target-data-prototype=applicableVehiclesType}, {root-autosar-data-prototype=dynamicContentLayer, context-data-prototype=DT_constraint/turnConstraint, target-data-prototype=DT_turnConstraint/turnConstraint}, {root-autosar-data-prototype=dynamicContentLayer, context-data-prototype=overtakingProhibition, target-data-prototype=DT_overtakingProhibition/online}, {root-autosar-data-prototype=dynamicContentLayer, context-data-prototype=overtakingProhibition, target-data-prototype=DT_overtakingProhibition/constraintList}, {root-autosar-data-prototype=dynamicContentLayer, context-data-prototype=overtakingProhibition, target-data-prototype=DT_overtakingProhibition/type}, {root-autosar-data-prototype=dynamicContentLayer, context-data-prototype=DT_overtakingProhibition/constraintList, target-data-prototype=DT_constraintList/arrayMember}, {root-autosar-data-prototype=dynamicContentLayer, context-data-prototype=DT_constraintList_arrayMember_ARRAY/subElement, target-data-prototype=daysOfWeek}, {root-autosar-data-prototype=dynamicContentLayer, context-data-prototype=DT_constraintList_arrayMember_ARRAY/subElement, target-data-prototype=timeRangeOfDay}, {root-autosar-data-prototype=dynamicContentLayer, context-data-prototype=DT_constraintList_arrayMember_ARRAY/subElement, target-data-prototype=weatherConstraint}, {root-autosar-data-prototype=dynamicContentLayer, context-data-prototype=DT_constraintList_arrayMember_ARRAY/subElement, target-data-prototype=timeClassifier}, {root-autosar-data-prototype=dynamicContentLayer, context-data-prototype=DT_constraintList_arrayMember_ARRAY/subElement, target-data-prototype=zoneClassifier}, {root-autosar-data-prototype=dynamicContentLayer, context-data-prototype=DT_constraintList_arrayMember_ARRAY/subElement, target-data-prototype=applicableVehicles}, {root-autosar-data-prototype=dynamicContentLayer, context-data-prototype=DT_constraintList_arrayMember_ARRAY/subElement, target-data-prototype=DT_constraint/turnConstraint}, {root-autosar-data-prototype=dynamicContentLayer, context-data-prototype=daysOfWeek, target-data-prototype=DT_listOfDays/arrayMember}, {root-autosar-data-prototype=dynamicContentLayer, context-data-prototype=timeRangeOfDay, target-data-prototype=startTimeHour}, {root-autosar-data-prototype=dynamicContentLayer, context-data-prototype=timeRangeOfDay, target-data-prototype=startTimeMinute}, {root-autosar-data-prototype=dynamicContentLayer, context-data-prototype=timeRangeOfDay, target-data-prototype=endTimeHour}, {root-autosar-data-prototype=dynamicContentLayer, context-data-prototype=timeRangeOfDay, target-data-prototype=endTimeMinute}, {root-autosar-data-prototype=dynamicContentLayer, context-data-prototype=weatherConstraint, target-data-prototype=Weather}, {root-autosar-data-prototype=dynamicContentLayer, context-data-prototype=timeClassifier, target-data-prototype=timeConstraintType}, {root-autosar-data-prototype=dynamicContentLayer, context-data-prototype=zoneClassifier, target-data-prototype=zoneConstraintType}, {root-autosar-data-prototype=dynamicContentLayer, context-data-prototype=applicableVehicles, target-data-prototype=applicableVehiclesType}, {root-autosar-data-prototype=dynamicContentLayer, context-data-prototype=DT_constraint/turnConstraint, target-data-prototype=DT_turnConstraint/turnConstraint}, {root-autosar-data-prototype=dynamicContentLayer, context-data-prototype=DT_overtakingProhibition/type, target-data-prototype=overtakingProhibitionType}, {root-autosar-data-prototype=dynamicContentLayer, context-data-prototype=DT_attributePoint/laneList, target-data-prototype=DT_laneIndexList/arrayMember}, {root-autosar-data-prototype=dynamicContentLayer, context-data-prototype=psd15SegmentReference, target-data-prototype=DT_psd15ClothoidOrder/arrayMember}, {root-autosar-data-prototype=dynamicContentLayer, context-data-prototype=DT_psd15ClothoidOrder_arrayMember_ARRAY/subElement, target-data-prototype=DT_psd15segmentIdList/arrayMember}, {root-autosar-data-prototype=dynamicContentLayer, context-data-prototype=DT_dynamicContentLayer_struct/layerInfo, target-data-prototype=referenceBaseList}, {root-autosar-data-prototype=dynamicContentLayer, context-data-prototype=DT_dynamicContentLayer_struct/layerInfo, target-data-prototype=metaDataList}, {root-autosar-data-prototype=dynamicContentLayer, context-data-prototype=referenceBaseList, target-data-prototype=DT_referenceBaseList/arrayMember}, {root-autosar-data-prototype=dynamicContentLayer, context-data-prototype=DT_referenceBaseList_arrayMember_ARRAY/subElement, target-data-prototype=productId}, {root-autosar-data-prototype=dynamicContentLayer, context-data-prototype=DT_referenceBaseList_arrayMember_ARRAY/subElement, target-data-prototype=updateRegion}, {root-autosar-data-prototype=dynamicContentLayer, context-data-prototype=DT_referenceBaseList_arrayMember_ARRAY/subElement, target-data-prototype=tileId}, {root-autosar-data-prototype=dynamicContentLayer, context-data-prototype=metaDataList, target-data-prototype=DT_metaDataList/arrayMember}, {root-autosar-data-prototype=dynamicContentLayer, context-data-prototype=DT_metaDataList_arrayMember_ARRAY/subElement, target-data-prototype=countryCode}, {root-autosar-data-prototype=dynamicContentLayer, context-data-prototype=DT_metaDataList_arrayMember_ARRAY/subElement, target-data-prototype=regionCode}, {root-autosar-data-prototype=dynamicContentLayer, context-data-prototype=DT_metaDataList_arrayMember_ARRAY/subElement, target-data-prototype=mapAge}, {root-autosar-data-prototype=dynamicContentLayer, context-data-prototype=DT_metaDataList_arrayMember_ARRAY/subElement, target-data-prototype=qualityIndicators}, {root-autosar-data-prototype=dynamicContentLayer, context-data-prototype=DT_metaDataList_arrayMember_ARRAY/subElement, target-data-prototype=DT_metaData/trafficDirection}, {root-autosar-data-prototype=dynamicContentLayer, context-data-prototype=DT_metaDataList_arrayMember_ARRAY/subElement, target-data-prototype=generalSpeedLimits}, {root-autosar-data-prototype=dynamicContentLayer, context-data-prototype=DT_metaDataList_arrayMember_ARRAY/subElement, target-data-prototype=DT_metaData/speedUnit}, {root-autosar-data-prototype=dynamicContentLayer, context-data-prototype=mapAge, target-data-prototype=month}, {root-autosar-data-prototype=dynamicContentLayer, context-data-prototype=mapAge, target-data-prototype=DT_monthOfYear/year}, {root-autosar-data-prototype=dynamicContentLayer, context-data-prototype=qualityIndicators, target-data-prototype=DT_qualityIndicatorList/arrayMember}, {root-autosar-data-prototype=dynamicContentLayer, context-data-prototype=DT_qualityIndicatorList_arrayMember_ARRAY/subElement, target-data-prototype=DT_qualityIndicator/type}, {root-autosar-data-prototype=dynamicContentLayer, context-data-prototype=DT_qualityIndicatorList_arrayMember_ARRAY/subElement, target-data-prototype=quality}, {root-autosar-data-prototype=dynamicContentLayer, context-data-prototype=DT_qualityIndicator/type, target-data-prototype=qualityIndicatorType}, {root-autosar-data-prototype=dynamicContentLayer, context-data-prototype=DT_metaData/trafficDirection, target-data-prototype=DT_trafficDirection/trafficDirection}, {root-autosar-data-prototype=dynamicContentLayer, context-data-prototype=generalSpeedLimits, target-data-prototype=DT_generalSpeedLimitList/arrayMember}, {root-autosar-data-prototype=dynamicContentLayer, context-data-prototype=DT_generalSpeedLimitList_arrayMember_ARRAY/subElement, target-data-prototype=DT_generalSpeedLimit/type}, {root-autosar-data-prototype=dynamicContentLayer, context-data-prototype=DT_generalSpeedLimitList_arrayMember_ARRAY/subElement, target-data-prototype=DT_generalSpeedLimit/speedValue}, {root-autosar-data-prototype=dynamicContentLayer, context-data-prototype=DT_generalSpeedLimitList_arrayMember_ARRAY/subElement, target-data-prototype=constraint}, {root-autosar-data-prototype=dynamicContentLayer, context-data-prototype=DT_generalSpeedLimit/type, target-data-prototype=generalSpeedLimitType}, {root-autosar-data-prototype=dynamicContentLayer, context-data-prototype=constraint, target-data-prototype=DT_constraintList/arrayMember}, {root-autosar-data-prototype=dynamicContentLayer, context-data-prototype=DT_constraintList_arrayMember_ARRAY/subElement, target-data-prototype=daysOfWeek}, {root-autosar-data-prototype=dynamicContentLayer, context-data-prototype=DT_constraintList_arrayMember_ARRAY/subElement, target-data-prototype=timeRangeOfDay}, {root-autosar-data-prototype=dynamicContentLayer, context-data-prototype=DT_constraintList_arrayMember_ARRAY/subElement, target-data-prototype=weatherConstraint}, {root-autosar-data-prototype=dynamicContentLayer, context-data-prototype=DT_constraintList_arrayMember_ARRAY/subElement, target-data-prototype=timeClassifier}, {root-autosar-data-prototype=dynamicContentLayer, context-data-prototype=DT_constraintList_arrayMember_ARRAY/subElement, target-data-prototype=zoneClassifier}, {root-autosar-data-prototype=dynamicContentLayer, context-data-prototype=DT_constraintList_arrayMember_ARRAY/subElement, target-data-prototype=applicableVehicles}, {root-autosar-data-prototype=dynamicContentLayer, context-data-prototype=DT_constraintList_arrayMember_ARRAY/subElement, target-data-prototype=DT_constraint/turnConstraint}, {root-autosar-data-prototype=dynamicContentLayer, context-data-prototype=daysOfWeek, target-data-prototype=DT_listOfDays/arrayMember}, {root-autosar-data-prototype=dynamicContentLayer, context-data-prototype=timeRangeOfDay, target-data-prototype=startTimeHour}, {root-autosar-data-prototype=dynamicContentLayer, context-data-prototype=timeRangeOfDay, target-data-prototype=startTimeMinute}, {root-autosar-data-prototype=dynamicContentLayer, context-data-prototype=timeRangeOfDay, target-data-prototype=endTimeHour}, {root-autosar-data-prototype=dynamicContentLayer, context-data-prototype=timeRangeOfDay, target-data-prototype=endTimeMinute}, {root-autosar-data-prototype=dynamicContentLayer, context-data-prototype=weatherConstraint, target-data-prototype=Weather}, {root-autosar-data-prototype=dynamicContentLayer, context-data-prototype=timeClassifier, target-data-prototype=timeConstraintType}, {root-autosar-data-prototype=dynamicContentLayer, context-data-prototype=zoneClassifier, target-data-prototype=zoneConstraintType}, {root-autosar-data-prototype=dynamicContentLayer, context-data-prototype=applicableVehicles, target-data-prototype=applicableVehiclesType}, {root-autosar-data-prototype=dynamicContentLayer, context-data-prototype=DT_constraint/turnConstraint, target-data-prototype=DT_turnConstraint/turnConstraint}, {root-autosar-data-prototype=dynamicContentLayer, context-data-prototype=DT_metaData/speedUnit, target-data-prototype=DT_speedUnit/speedUnit}, {root-autosar-data-prototype=automatedParkingLayer, context-data-prototype=DT_automatedParkingLayer_vector/subElement, target-data-prototype=DT_automatedParkingLayer_struct/id}, {root-autosar-data-prototype=automatedParkingLayer, context-data-prototype=DT_automatedParkingLayer_vector/subElement, target-data-prototype=automatedParkingLayer}, {root-autosar-data-prototype=automatedParkingLayer, context-data-prototype=DT_automatedParkingLayer_vector/subElement, target-data-prototype=DT_automatedParkingLayer_struct/layerInfo}, {root-autosar-data-prototype=automatedParkingLayer, context-data-prototype=DT_automatedParkingLayerautomatedParkingLayer/subElement, target-data-prototype=parkingSectionList}, {root-autosar-data-prototype=automatedParkingLayer, context-data-prototype=DT_automatedParkingLayerautomatedParkingLayer/subElement, target-data-prototype=DT_parkingGarage/parkingRowList}, {root-autosar-data-prototype=automatedParkingLayer, context-data-prototype=DT_automatedParkingLayerautomatedParkingLayer/subElement, target-data-prototype=outerPolygon}, {root-autosar-data-prototype=automatedParkingLayer, context-data-prototype=DT_automatedParkingLayerautomatedParkingLayer/subElement, target-data-prototype=facilityType}, {root-autosar-data-prototype=automatedParkingLayer, context-data-prototype=DT_automatedParkingLayerautomatedParkingLayer/subElement, target-data-prototype=facilityId}, {root-autosar-data-prototype=automatedParkingLayer, context-data-prototype=parkingSectionList, target-data-prototype=DT_parkingGarageSectionList/arrayMember}, {root-autosar-data-prototype=automatedParkingLayer, context-data-prototype=DT_parkingGarageSectionList_arrayMember_ARRAY/subElement, target-data-prototype=sectionId}, {root-autosar-data-prototype=automatedParkingLayer, context-data-prototype=DT_parkingGarageSectionList_arrayMember_ARRAY/subElement, target-data-prototype=DT_parkingGarageSection/parkingRowList}, {root-autosar-data-prototype=automatedParkingLayer, context-data-prototype=DT_parkingGarageSectionList_arrayMember_ARRAY/subElement, target-data-prototype=sectionConnectionList}, {root-autosar-data-prototype=automatedParkingLayer, context-data-prototype=DT_parkingGarageSectionList_arrayMember_ARRAY/subElement, target-data-prototype=laneAccessList}, {root-autosar-data-prototype=automatedParkingLayer, context-data-prototype=DT_parkingGarageSectionList_arrayMember_ARRAY/subElement, target-data-prototype=linkAccessList}, {root-autosar-data-prototype=automatedParkingLayer, context-data-prototype=DT_parkingGarageSectionList_arrayMember_ARRAY/subElement, target-data-prototype=sectionType}, {root-autosar-data-prototype=automatedParkingLayer, context-data-prototype=DT_parkingGarageSectionList_arrayMember_ARRAY/subElement, target-data-prototype=DT_parkingGarageSection/name}, {root-autosar-data-prototype=automatedParkingLayer, context-data-prototype=DT_parkingGarageSectionList_arrayMember_ARRAY/subElement, target-data-prototype=DT_parkingGarageSection/outerBoundary}, {root-autosar-data-prototype=automatedParkingLayer, context-data-prototype=DT_parkingGarageSectionList_arrayMember_ARRAY/subElement, target-data-prototype=floorNumber}, {root-autosar-data-prototype=automatedParkingLayer, context-data-prototype=DT_parkingGarageSectionList_arrayMember_ARRAY/subElement, target-data-prototype=areaList}, {root-autosar-data-prototype=automatedParkingLayer, context-data-prototype=DT_parkingGarageSectionList_arrayMember_ARRAY/subElement, target-data-prototype=childSectionList}, {root-autosar-data-prototype=automatedParkingLayer, context-data-prototype=sectionId, target-data-prototype=localId}, {root-autosar-data-prototype=automatedParkingLayer, context-data-prototype=sectionId, target-data-prototype=referenceBaseIndex}, {root-autosar-data-prototype=automatedParkingLayer, context-data-prototype=sectionId, target-data-prototype=inPositiveDirection}, {root-autosar-data-prototype=automatedParkingLayer, context-data-prototype=DT_parkingGarageSection/parkingRowList, target-data-prototype=DT_parkingRowList/arrayMember}, {root-autosar-data-prototype=automatedParkingLayer, context-data-prototype=DT_parkingRowList_arrayMember_ARRAY/subElement, target-data-prototype=parkingRowId}, {root-autosar-data-prototype=automatedParkingLayer, context-data-prototype=DT_parkingRowList_arrayMember_ARRAY/subElement, target-data-prototype=DT_parkingRow/laneRangeList}, {root-autosar-data-prototype=automatedParkingLayer, context-data-prototype=DT_parkingRowList_arrayMember_ARRAY/subElement, target-data-prototype=DT_parkingRow/linkRangeList}, {root-autosar-data-prototype=automatedParkingLayer, context-data-prototype=DT_parkingRowList_arrayMember_ARRAY/subElement, target-data-prototype=parkingSpotList}, {root-autosar-data-prototype=automatedParkingLayer, context-data-prototype=parkingRowId, target-data-prototype=localId}, {root-autosar-data-prototype=automatedParkingLayer, context-data-prototype=parkingRowId, target-data-prototype=referenceBaseIndex}, {root-autosar-data-prototype=automatedParkingLayer, context-data-prototype=parkingRowId, target-data-prototype=inPositiveDirection}, {root-autosar-data-prototype=automatedParkingLayer, context-data-prototype=DT_parkingRow/laneRangeList, target-data-prototype=DT_laneReferenceList/arrayMember}, {root-autosar-data-prototype=automatedParkingLayer, context-data-prototype=DT_laneReferenceList_arrayMember_ARRAY/subElement, target-data-prototype=DT_rangedReference/reference}, {root-autosar-data-prototype=automatedParkingLayer, context-data-prototype=DT_laneReferenceList_arrayMember_ARRAY/subElement, target-data-prototype=DT_rangedReference/rangeStart}, {root-autosar-data-prototype=automatedParkingLayer, context-data-prototype=DT_laneReferenceList_arrayMember_ARRAY/subElement, target-data-prototype=DT_rangedReference/rangeEnd}, {root-autosar-data-prototype=automatedParkingLayer, context-data-prototype=DT_rangedReference/reference, target-data-prototype=localId}, {root-autosar-data-prototype=automatedParkingLayer, context-data-prototype=DT_rangedReference/reference, target-data-prototype=referenceBaseIndex}, {root-autosar-data-prototype=automatedParkingLayer, context-data-prototype=DT_rangedReference/reference, target-data-prototype=inPositiveDirection}, {root-autosar-data-prototype=automatedParkingLayer, context-data-prototype=DT_parkingRow/linkRangeList, target-data-prototype=DT_linkReferenceList/arrayMember}, {root-autosar-data-prototype=automatedParkingLayer, context-data-prototype=DT_linkReferenceList_arrayMember_ARRAY/subElement, target-data-prototype=DT_rangedReference/reference}, {root-autosar-data-prototype=automatedParkingLayer, context-data-prototype=DT_linkReferenceList_arrayMember_ARRAY/subElement, target-data-prototype=DT_rangedReference/rangeStart}, {root-autosar-data-prototype=automatedParkingLayer, context-data-prototype=DT_linkReferenceList_arrayMember_ARRAY/subElement, target-data-prototype=DT_rangedReference/rangeEnd}, {root-autosar-data-prototype=automatedParkingLayer, context-data-prototype=DT_rangedReference/reference, target-data-prototype=localId}, {root-autosar-data-prototype=automatedParkingLayer, context-data-prototype=DT_rangedReference/reference, target-data-prototype=referenceBaseIndex}, {root-autosar-data-prototype=automatedParkingLayer, context-data-prototype=DT_rangedReference/reference, target-data-prototype=inPositiveDirection}, {root-autosar-data-prototype=automatedParkingLayer, context-data-prototype=parkingSpotList, target-data-prototype=spotId}, {root-autosar-data-prototype=automatedParkingLayer, context-data-prototype=parkingSpotList, target-data-prototype=DT_parkingSpot/laneRangeList}, {root-autosar-data-prototype=automatedParkingLayer, context-data-prototype=parkingSpotList, target-data-prototype=DT_parkingSpot/linkRangeList}, {root-autosar-data-prototype=automatedParkingLayer, context-data-prototype=spotId, target-data-prototype=localId}, {root-autosar-data-prototype=automatedParkingLayer, context-data-prototype=spotId, target-data-prototype=referenceBaseIndex}, {root-autosar-data-prototype=automatedParkingLayer, context-data-prototype=spotId, target-data-prototype=inPositiveDirection}, {root-autosar-data-prototype=automatedParkingLayer, context-data-prototype=DT_parkingSpot/laneRangeList, target-data-prototype=DT_laneRelativeCoordinateList/arrayMember}, {root-autosar-data-prototype=automatedParkingLayer, context-data-prototype=DT_laneRelativeCoordinateList_arrayMember_ARRAY/subElement, target-data-prototype=DT_relativeCoordinate/reference}, {root-autosar-data-prototype=automatedParkingLayer, context-data-prototype=DT_laneRelativeCoordinateList_arrayMember_ARRAY/subElement, target-data-prototype=DT_relativeCoordinate/offset}, {root-autosar-data-prototype=automatedParkingLayer, context-data-prototype=DT_relativeCoordinate/reference, target-data-prototype=localId}, {root-autosar-data-prototype=automatedParkingLayer, context-data-prototype=DT_relativeCoordinate/reference, target-data-prototype=referenceBaseIndex}, {root-autosar-data-prototype=automatedParkingLayer, context-data-prototype=DT_relativeCoordinate/reference, target-data-prototype=inPositiveDirection}, {root-autosar-data-prototype=automatedParkingLayer, context-data-prototype=DT_parkingSpot/linkRangeList, target-data-prototype=DT_linkRelativeCoordinateList/arrayMember}, {root-autosar-data-prototype=automatedParkingLayer, context-data-prototype=DT_linkRelativeCoordinateList_arrayMember_ARRAY/subElement, target-data-prototype=DT_relativeCoordinate/reference}, {root-autosar-data-prototype=automatedParkingLayer, context-data-prototype=DT_linkRelativeCoordinateList_arrayMember_ARRAY/subElement, target-data-prototype=DT_relativeCoordinate/offset}, {root-autosar-data-prototype=automatedParkingLayer, context-data-prototype=DT_relativeCoordinate/reference, target-data-prototype=localId}, {root-autosar-data-prototype=automatedParkingLayer, context-data-prototype=DT_relativeCoordinate/reference, target-data-prototype=referenceBaseIndex}, {root-autosar-data-prototype=automatedParkingLayer, context-data-prototype=DT_relativeCoordinate/reference, target-data-prototype=inPositiveDirection}, {root-autosar-data-prototype=automatedParkingLayer, context-data-prototype=sectionConnectionList, target-data-prototype=DT_referenceList/arrayMember}, {root-autosar-data-prototype=automatedParkingLayer, context-data-prototype=DT_referenceList_arrayMember_ARRAY/subElement, target-data-prototype=localId}, {root-autosar-data-prototype=automatedParkingLayer, context-data-prototype=DT_referenceList_arrayMember_ARRAY/subElement, target-data-prototype=referenceBaseIndex}, {root-autosar-data-prototype=automatedParkingLayer, context-data-prototype=DT_referenceList_arrayMember_ARRAY/subElement, target-data-prototype=inPositiveDirection}, {root-autosar-data-prototype=automatedParkingLayer, context-data-prototype=laneAccessList, target-data-prototype=DT_laneRelativeCoordinateList/arrayMember}, {root-autosar-data-prototype=automatedParkingLayer, context-data-prototype=DT_laneRelativeCoordinateList_arrayMember_ARRAY/subElement, target-data-prototype=DT_relativeCoordinate/reference}, {root-autosar-data-prototype=automatedParkingLayer, context-data-prototype=DT_laneRelativeCoordinateList_arrayMember_ARRAY/subElement, target-data-prototype=DT_relativeCoordinate/offset}, {root-autosar-data-prototype=automatedParkingLayer, context-data-prototype=DT_relativeCoordinate/reference, target-data-prototype=localId}, {root-autosar-data-prototype=automatedParkingLayer, context-data-prototype=DT_relativeCoordinate/reference, target-data-prototype=referenceBaseIndex}, {root-autosar-data-prototype=automatedParkingLayer, context-data-prototype=DT_relativeCoordinate/reference, target-data-prototype=inPositiveDirection}, {root-autosar-data-prototype=automatedParkingLayer, context-data-prototype=linkAccessList, target-data-prototype=DT_linkRelativeCoordinateList/arrayMember}, {root-autosar-data-prototype=automatedParkingLayer, context-data-prototype=DT_linkRelativeCoordinateList_arrayMember_ARRAY/subElement, target-data-prototype=DT_relativeCoordinate/reference}, {root-autosar-data-prototype=automatedParkingLayer, context-data-prototype=DT_linkRelativeCoordinateList_arrayMember_ARRAY/subElement, target-data-prototype=DT_relativeCoordinate/offset}, {root-autosar-data-prototype=automatedParkingLayer, context-data-prototype=DT_relativeCoordinate/reference, target-data-prototype=localId}, {root-autosar-data-prototype=automatedParkingLayer, context-data-prototype=DT_relativeCoordinate/reference, target-data-prototype=referenceBaseIndex}, {root-autosar-data-prototype=automatedParkingLayer, context-data-prototype=DT_relativeCoordinate/reference, target-data-prototype=inPositiveDirection}, {root-autosar-data-prototype=automatedParkingLayer, context-data-prototype=sectionType, target-data-prototype=parkingSectionType}, {root-autosar-data-prototype=automatedParkingLayer, context-data-prototype=DT_parkingGarageSection/name, target-data-prototype=DT_parkingSectionName/name}, {root-autosar-data-prototype=automatedParkingLayer, context-data-prototype=DT_parkingGarageSection/outerBoundary, target-data-prototype=DT_polyline/arrayMember}, {root-autosar-data-prototype=automatedParkingLayer, context-data-prototype=DT_polyline_arrayMember_ARRAY/subElement, target-data-prototype=longitude}, {root-autosar-data-prototype=automatedParkingLayer, context-data-prototype=DT_polyline_arrayMember_ARRAY/subElement, target-data-prototype=latitude}, {root-autosar-data-prototype=automatedParkingLayer, context-data-prototype=DT_polyline_arrayMember_ARRAY/subElement, target-data-prototype=DT_wgs84Coordinate/height}, {root-autosar-data-prototype=automatedParkingLayer, context-data-prototype=areaList, target-data-prototype=DT_parkingAreaList/arrayMember}, {root-autosar-data-prototype=automatedParkingLayer, context-data-prototype=DT_parkingAreaList_arrayMember_ARRAY/subElement, target-data-prototype=areaId}, {root-autosar-data-prototype=automatedParkingLayer, context-data-prototype=DT_parkingAreaList_arrayMember_ARRAY/subElement, target-data-prototype=areaType}, {root-autosar-data-prototype=automatedParkingLayer, context-data-prototype=DT_parkingAreaList_arrayMember_ARRAY/subElement, target-data-prototype=DT_parkingArea/outerBoundary}, {root-autosar-data-prototype=automatedParkingLayer, context-data-prototype=areaType, target-data-prototype=parkingAreaType}, {root-autosar-data-prototype=automatedParkingLayer, context-data-prototype=DT_parkingArea/outerBoundary, target-data-prototype=DT_polyline/arrayMember}, {root-autosar-data-prototype=automatedParkingLayer, context-data-prototype=DT_polyline_arrayMember_ARRAY/subElement, target-data-prototype=longitude}, {root-autosar-data-prototype=automatedParkingLayer, context-data-prototype=DT_polyline_arrayMember_ARRAY/subElement, target-data-prototype=latitude}, {root-autosar-data-prototype=automatedParkingLayer, context-data-prototype=DT_polyline_arrayMember_ARRAY/subElement, target-data-prototype=DT_wgs84Coordinate/height}, {root-autosar-data-prototype=automatedParkingLayer, context-data-prototype=childSectionList, target-data-prototype=DT_referenceList/arrayMember}, {root-autosar-data-prototype=automatedParkingLayer, context-data-prototype=DT_referenceList_arrayMember_ARRAY/subElement, target-data-prototype=localId}, {root-autosar-data-prototype=automatedParkingLayer, context-data-prototype=DT_referenceList_arrayMember_ARRAY/subElement, target-data-prototype=referenceBaseIndex}, {root-autosar-data-prototype=automatedParkingLayer, context-data-prototype=DT_referenceList_arrayMember_ARRAY/subElement, target-data-prototype=inPositiveDirection}, {root-autosar-data-prototype=automatedParkingLayer, context-data-prototype=DT_parkingGarage/parkingRowList, target-data-prototype=DT_parkingRowList/arrayMember}, {root-autosar-data-prototype=automatedParkingLayer, context-data-prototype=DT_parkingRowList_arrayMember_ARRAY/subElement, target-data-prototype=parkingRowId}, {root-autosar-data-prototype=automatedParkingLayer, context-data-prototype=DT_parkingRowList_arrayMember_ARRAY/subElement, target-data-prototype=DT_parkingRow/laneRangeList}, {root-autosar-data-prototype=automatedParkingLayer, context-data-prototype=DT_parkingRowList_arrayMember_ARRAY/subElement, target-data-prototype=DT_parkingRow/linkRangeList}, {root-autosar-data-prototype=automatedParkingLayer, context-data-prototype=DT_parkingRowList_arrayMember_ARRAY/subElement, target-data-prototype=parkingSpotList}, {root-autosar-data-prototype=automatedParkingLayer, context-data-prototype=parkingRowId, target-data-prototype=localId}, {root-autosar-data-prototype=automatedParkingLayer, context-data-prototype=parkingRowId, target-data-prototype=referenceBaseIndex}, {root-autosar-data-prototype=automatedParkingLayer, context-data-prototype=parkingRowId, target-data-prototype=inPositiveDirection}, {root-autosar-data-prototype=automatedParkingLayer, context-data-prototype=DT_parkingRow/laneRangeList, target-data-prototype=DT_laneReferenceList/arrayMember}, {root-autosar-data-prototype=automatedParkingLayer, context-data-prototype=DT_laneReferenceList_arrayMember_ARRAY/subElement, target-data-prototype=DT_rangedReference/reference}, {root-autosar-data-prototype=automatedParkingLayer, context-data-prototype=DT_laneReferenceList_arrayMember_ARRAY/subElement, target-data-prototype=DT_rangedReference/rangeStart}, {root-autosar-data-prototype=automatedParkingLayer, context-data-prototype=DT_laneReferenceList_arrayMember_ARRAY/subElement, target-data-prototype=DT_rangedReference/rangeEnd}, {root-autosar-data-prototype=automatedParkingLayer, context-data-prototype=DT_rangedReference/reference, target-data-prototype=localId}, {root-autosar-data-prototype=automatedParkingLayer, context-data-prototype=DT_rangedReference/reference, target-data-prototype=referenceBaseIndex}, {root-autosar-data-prototype=automatedParkingLayer, context-data-prototype=DT_rangedReference/reference, target-data-prototype=inPositiveDirection}, {root-autosar-data-prototype=automatedParkingLayer, context-data-prototype=DT_parkingRow/linkRangeList, target-data-prototype=DT_linkReferenceList/arrayMember}, {root-autosar-data-prototype=automatedParkingLayer, context-data-prototype=DT_linkReferenceList_arrayMember_ARRAY/subElement, target-data-prototype=DT_rangedReference/reference}, {root-autosar-data-prototype=automatedParkingLayer, context-data-prototype=DT_linkReferenceList_arrayMember_ARRAY/subElement, target-data-prototype=DT_rangedReference/rangeStart}, {root-autosar-data-prototype=automatedParkingLayer, context-data-prototype=DT_linkReferenceList_arrayMember_ARRAY/subElement, target-data-prototype=DT_rangedReference/rangeEnd}, {root-autosar-data-prototype=automatedParkingLayer, context-data-prototype=DT_rangedReference/reference, target-data-prototype=localId}, {root-autosar-data-prototype=automatedParkingLayer, context-data-prototype=DT_rangedReference/reference, target-data-prototype=referenceBaseIndex}, {root-autosar-data-prototype=automatedParkingLayer, context-data-prototype=DT_rangedReference/reference, target-data-prototype=inPositiveDirection}, {root-autosar-data-prototype=automatedParkingLayer, context-data-prototype=parkingSpotList, target-data-prototype=spotId}, {root-autosar-data-prototype=automatedParkingLayer, context-data-prototype=parkingSpotList, target-data-prototype=DT_parkingSpot/laneRangeList}, {root-autosar-data-prototype=automatedParkingLayer, context-data-prototype=parkingSpotList, target-data-prototype=DT_parkingSpot/linkRangeList}, {root-autosar-data-prototype=automatedParkingLayer, context-data-prototype=spotId, target-data-prototype=localId}, {root-autosar-data-prototype=automatedParkingLayer, context-data-prototype=spotId, target-data-prototype=referenceBaseIndex}, {root-autosar-data-prototype=automatedParkingLayer, context-data-prototype=spotId, target-data-prototype=inPositiveDirection}, {root-autosar-data-prototype=automatedParkingLayer, context-data-prototype=DT_parkingSpot/laneRangeList, target-data-prototype=DT_laneRelativeCoordinateList/arrayMember}, {root-autosar-data-prototype=automatedParkingLayer, context-data-prototype=DT_laneRelativeCoordinateList_arrayMember_ARRAY/subElement, target-data-prototype=DT_relativeCoordinate/reference}, {root-autosar-data-prototype=automatedParkingLayer, context-data-prototype=DT_laneRelativeCoordinateList_arrayMember_ARRAY/subElement, target-data-prototype=DT_relativeCoordinate/offset}, {root-autosar-data-prototype=automatedParkingLayer, context-data-prototype=DT_relativeCoordinate/reference, target-data-prototype=localId}, {root-autosar-data-prototype=automatedParkingLayer, context-data-prototype=DT_relativeCoordinate/reference, target-data-prototype=referenceBaseIndex}, {root-autosar-data-prototype=automatedParkingLayer, context-data-prototype=DT_relativeCoordinate/reference, target-data-prototype=inPositiveDirection}, {root-autosar-data-prototype=automatedParkingLayer, context-data-prototype=DT_parkingSpot/linkRangeList, target-data-prototype=DT_linkRelativeCoordinateList/arrayMember}, {root-autosar-data-prototype=automatedParkingLayer, context-data-prototype=DT_linkRelativeCoordinateList_arrayMember_ARRAY/subElement, target-data-prototype=DT_relativeCoordinate/reference}, {root-autosar-data-prototype=automatedParkingLayer, context-data-prototype=DT_linkRelativeCoordinateList_arrayMember_ARRAY/subElement, target-data-prototype=DT_relativeCoordinate/offset}, {root-autosar-data-prototype=automatedParkingLayer, context-data-prototype=DT_relativeCoordinate/reference, target-data-prototype=localId}, {root-autosar-data-prototype=automatedParkingLayer, context-data-prototype=DT_relativeCoordinate/reference, target-data-prototype=referenceBaseIndex}, {root-autosar-data-prototype=automatedParkingLayer, context-data-prototype=DT_relativeCoordinate/reference, target-data-prototype=inPositiveDirection}, {root-autosar-data-prototype=automatedParkingLayer, context-data-prototype=outerPolygon, target-data-prototype=DT_polyline/arrayMember}, {root-autosar-data-prototype=automatedParkingLayer, context-data-prototype=DT_polyline_arrayMember_ARRAY/subElement, target-data-prototype=longitude}, {root-autosar-data-prototype=automatedParkingLayer, context-data-prototype=DT_polyline_arrayMember_ARRAY/subElement, target-data-prototype=latitude}, {root-autosar-data-prototype=automatedParkingLayer, context-data-prototype=DT_polyline_arrayMember_ARRAY/subElement, target-data-prototype=DT_wgs84Coordinate/height}, {root-autosar-data-prototype=automatedParkingLayer, context-data-prototype=facilityType, target-data-prototype=parkingFacilityType}, {root-autosar-data-prototype=automatedParkingLayer, context-data-prototype=facilityId, target-data-prototype=localId}, {root-autosar-data-prototype=automatedParkingLayer, context-data-prototype=facilityId, target-data-prototype=referenceBaseIndex}, {root-autosar-data-prototype=automatedParkingLayer, context-data-prototype=facilityId, target-data-prototype=inPositiveDirection}, {root-autosar-data-prototype=automatedParkingLayer, context-data-prototype=DT_automatedParkingLayer_struct/layerInfo, target-data-prototype=referenceBaseList}, {root-autosar-data-prototype=automatedParkingLayer, context-data-prototype=DT_automatedParkingLayer_struct/layerInfo, target-data-prototype=metaDataList}, {root-autosar-data-prototype=automatedParkingLayer, context-data-prototype=referenceBaseList, target-data-prototype=DT_referenceBaseList/arrayMember}, {root-autosar-data-prototype=automatedParkingLayer, context-data-prototype=DT_referenceBaseList_arrayMember_ARRAY/subElement, target-data-prototype=productId}, {root-autosar-data-prototype=automatedParkingLayer, context-data-prototype=DT_referenceBaseList_arrayMember_ARRAY/subElement, target-data-prototype=updateRegion}, {root-autosar-data-prototype=automatedParkingLayer, context-data-prototype=DT_referenceBaseList_arrayMember_ARRAY/subElement, target-data-prototype=tileId}, {root-autosar-data-prototype=automatedParkingLayer, context-data-prototype=metaDataList, target-data-prototype=DT_metaDataList/arrayMember}, {root-autosar-data-prototype=automatedParkingLayer, context-data-prototype=DT_metaDataList_arrayMember_ARRAY/subElement, target-data-prototype=countryCode}, {root-autosar-data-prototype=automatedParkingLayer, context-data-prototype=DT_metaDataList_arrayMember_ARRAY/subElement, target-data-prototype=regionCode}, {root-autosar-data-prototype=automatedParkingLayer, context-data-prototype=DT_metaDataList_arrayMember_ARRAY/subElement, target-data-prototype=mapAge}, {root-autosar-data-prototype=automatedParkingLayer, context-data-prototype=DT_metaDataList_arrayMember_ARRAY/subElement, target-data-prototype=qualityIndicators}, {root-autosar-data-prototype=automatedParkingLayer, context-data-prototype=DT_metaDataList_arrayMember_ARRAY/subElement, target-data-prototype=DT_metaData/trafficDirection}, {root-autosar-data-prototype=automatedParkingLayer, context-data-prototype=DT_metaDataList_arrayMember_ARRAY/subElement, target-data-prototype=generalSpeedLimits}, {root-autosar-data-prototype=automatedParkingLayer, context-data-prototype=DT_metaDataList_arrayMember_ARRAY/subElement, target-data-prototype=DT_metaData/speedUnit}, {root-autosar-data-prototype=automatedParkingLayer, context-data-prototype=mapAge, target-data-prototype=month}, {root-autosar-data-prototype=automatedParkingLayer, context-data-prototype=mapAge, target-data-prototype=DT_monthOfYear/year}, {root-autosar-data-prototype=automatedParkingLayer, context-data-prototype=qualityIndicators, target-data-prototype=DT_qualityIndicatorList/arrayMember}, {root-autosar-data-prototype=automatedParkingLayer, context-data-prototype=DT_qualityIndicatorList_arrayMember_ARRAY/subElement, target-data-prototype=DT_qualityIndicator/type}, {root-autosar-data-prototype=automatedParkingLayer, context-data-prototype=DT_qualityIndicatorList_arrayMember_ARRAY/subElement, target-data-prototype=quality}, {root-autosar-data-prototype=automatedParkingLayer, context-data-prototype=DT_qualityIndicator/type, target-data-prototype=qualityIndicatorType}, {root-autosar-data-prototype=automatedParkingLayer, context-data-prototype=DT_metaData/trafficDirection, target-data-prototype=DT_trafficDirection/trafficDirection}, {root-autosar-data-prototype=automatedParkingLayer, context-data-prototype=generalSpeedLimits, target-data-prototype=DT_generalSpeedLimitList/arrayMember}, {root-autosar-data-prototype=automatedParkingLayer, context-data-prototype=DT_generalSpeedLimitList_arrayMember_ARRAY/subElement, target-data-prototype=DT_generalSpeedLimit/type}, {root-autosar-data-prototype=automatedParkingLayer, context-data-prototype=DT_generalSpeedLimitList_arrayMember_ARRAY/subElement, target-data-prototype=DT_generalSpeedLimit/speedValue}, {root-autosar-data-prototype=automatedParkingLayer, context-data-prototype=DT_generalSpeedLimitList_arrayMember_ARRAY/subElement, target-data-prototype=constraint}, {root-autosar-data-prototype=automatedParkingLayer, context-data-prototype=DT_generalSpeedLimit/type, target-data-prototype=generalSpeedLimitType}, {root-autosar-data-prototype=automatedParkingLayer, context-data-prototype=constraint, target-data-prototype=DT_constraintList/arrayMember}, {root-autosar-data-prototype=automatedParkingLayer, context-data-prototype=DT_constraintList_arrayMember_ARRAY/subElement, target-data-prototype=daysOfWeek}, {root-autosar-data-prototype=automatedParkingLayer, context-data-prototype=DT_constraintList_arrayMember_ARRAY/subElement, target-data-prototype=timeRangeOfDay}, {root-autosar-data-prototype=automatedParkingLayer, context-data-prototype=DT_constraintList_arrayMember_ARRAY/subElement, target-data-prototype=weatherConstraint}, {root-autosar-data-prototype=automatedParkingLayer, context-data-prototype=DT_constraintList_arrayMember_ARRAY/subElement, target-data-prototype=timeClassifier}, {root-autosar-data-prototype=automatedParkingLayer, context-data-prototype=DT_constraintList_arrayMember_ARRAY/subElement, target-data-prototype=zoneClassifier}, {root-autosar-data-prototype=automatedParkingLayer, context-data-prototype=DT_constraintList_arrayMember_ARRAY/subElement, target-data-prototype=applicableVehicles}, {root-autosar-data-prototype=automatedParkingLayer, context-data-prototype=DT_constraintList_arrayMember_ARRAY/subElement, target-data-prototype=DT_constraint/turnConstraint}, {root-autosar-data-prototype=automatedParkingLayer, context-data-prototype=daysOfWeek, target-data-prototype=DT_listOfDays/arrayMember}, {root-autosar-data-prototype=automatedParkingLayer, context-data-prototype=timeRangeOfDay, target-data-prototype=startTimeHour}, {root-autosar-data-prototype=automatedParkingLayer, context-data-prototype=timeRangeOfDay, target-data-prototype=startTimeMinute}, {root-autosar-data-prototype=automatedParkingLayer, context-data-prototype=timeRangeOfDay, target-data-prototype=endTimeHour}, {root-autosar-data-prototype=automatedParkingLayer, context-data-prototype=timeRangeOfDay, target-data-prototype=endTimeMinute}, {root-autosar-data-prototype=automatedParkingLayer, context-data-prototype=weatherConstraint, target-data-prototype=Weather}, {root-autosar-data-prototype=automatedParkingLayer, context-data-prototype=timeClassifier, target-data-prototype=timeConstraintType}, {root-autosar-data-prototype=automatedParkingLayer, context-data-prototype=zoneClassifier, target-data-prototype=zoneConstraintType}, {root-autosar-data-prototype=automatedParkingLayer, context-data-prototype=applicableVehicles, target-data-prototype=applicableVehiclesType}, {root-autosar-data-prototype=automatedParkingLayer, context-data-prototype=DT_constraint/turnConstraint, target-data-prototype=DT_turnConstraint/turnConstraint}, {root-autosar-data-prototype=automatedParkingLayer, context-data-prototype=DT_metaData/speedUnit, target-data-prototype=DT_speedUnit/speedUnit}, {root-autosar-data-prototype=timezoneInformation, context-data-prototype=DT_timezoneInformation_vector/subElement, target-data-prototype=DT_timezoneInformation_struct/id}, {root-autosar-data-prototype=timezoneInformation, context-data-prototype=DT_timezoneInformation_vector/subElement, target-data-prototype=timezoneInformation}, {root-autosar-data-prototype=timezoneInformation, context-data-prototype=timezoneInformation, target-data-prototype=DT_timezoneInformation/type}, {root-autosar-data-prototype=timezoneInformation, context-data-prototype=timezoneInformation, target-data-prototype=timezoneST}, {root-autosar-data-prototype=timezoneInformation, context-data-prototype=timezoneInformation, target-data-prototype=timezoneDST}, {root-autosar-data-prototype=timezoneInformation, context-data-prototype=timezoneInformation, target-data-prototype=timezoneDSTactive}, {root-autosar-data-prototype=timezoneInformation, context-data-prototype=DT_timezoneInformation/type, target-data-prototype=timezoneInformationType}, {root-autosar-data-prototype=timezoneInformation, context-data-prototype=timezoneST, target-data-prototype=timezoneOffsetUtcHours}, {root-autosar-data-prototype=timezoneInformation, context-data-prototype=timezoneST, target-data-prototype=timezoneOffsetUtcMinutes}, {root-autosar-data-prototype=timezoneInformation, context-data-prototype=timezoneST, target-data-prototype=DT_timezone/year}, {root-autosar-data-prototype=timezoneInformation, context-data-prototype=timezoneST, target-data-prototype=monthOfYear}, {root-autosar-data-prototype=timezoneInformation, context-data-prototype=timezoneST, target-data-prototype=dayOfMonth}, {root-autosar-data-prototype=timezoneInformation, context-data-prototype=timezoneST, target-data-prototype=hourOfDay}, {root-autosar-data-prototype=timezoneInformation, context-data-prototype=timezoneST, target-data-prototype=minuteOfHour}, {root-autosar-data-prototype=timezoneInformation, context-data-prototype=timezoneDST, target-data-prototype=timezoneOffsetUtcHours}, {root-autosar-data-prototype=timezoneInformation, context-data-prototype=timezoneDST, target-data-prototype=timezoneOffsetUtcMinutes}, {root-autosar-data-prototype=timezoneInformation, context-data-prototype=timezoneDST, target-data-prototype=DT_timezone/year}, {root-autosar-data-prototype=timezoneInformation, context-data-prototype=timezoneDST, target-data-prototype=monthOfYear}, {root-autosar-data-prototype=timezoneInformation, context-data-prototype=timezoneDST, target-data-prototype=dayOfMonth}, {root-autosar-data-prototype=timezoneInformation, context-data-prototype=timezoneDST, target-data-prototype=hourOfDay}, {root-autosar-data-prototype=timezoneInformation, context-data-prototype=timezoneDST, target-data-prototype=minuteOfHour}]
    8 x field, all with has-getter=true, has-notifier=true, has-setter=false:
      linkLayerLongRange: type=DT_linkLayerLongRange_vector
      linkLayerShortRange: type=DT_linkLayerShortRange_vector
      laneLayer: type=DT_laneLayer_vector
      positioningObjectsLayer: type=DT_positioningObjectsLayer_vector
      egoPositionLayer: type=DT_egoPositionLayer_vector
      dynamicContentLayer: type=DT_dynamicContentLayer_vector
      automatedParkingLayer: type=DT_automatedParkingLayer_vector
      timezoneInformation: type=DT_timezoneInformation_vector
