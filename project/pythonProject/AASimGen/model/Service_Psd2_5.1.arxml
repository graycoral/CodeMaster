[part 2 of 2: package /vwg/services/Psd2/datatypes]
AUTOSAR XML (schema 00043)
package /vwg/services/Psd2/datatypes
  173 x impl type:
    DT_wgs84Coordinate: category=STRUCTURE
      element longitude: implementation-data-type=UInt32
      element latitude: implementation-data-type=UInt32
      element height: implementation-data-type=Int32
    DT_direction: category=STRUCTURE
      element direction: implementation-data-type=direction_direction
    DT_reference: category=STRUCTURE
      element localId: implementation-data-type=UInt64
      element referenceBaseIndex: implementation-data-type=UInt8
      element inPositiveDirection: implementation-data-type=Boolean
    DT_rangedReference: category=STRUCTURE
      element reference: implementation-data-type=DT_reference
      element rangeStart: implementation-data-type=Float
      element rangeEnd: implementation-data-type=Float
    DT_polyline: category=STRUCTURE
      element arrayMember: implementation-data-type=DT_polyline_arrayMember_ARRAY
    DT_relativeCoordinate: category=STRUCTURE
      element reference: implementation-data-type=DT_reference
      element offset: implementation-data-type=Float
    DT_attributeList: category=STRUCTURE
      element arrayMember: implementation-data-type=DT_attributeList_arrayMember_ARRAY
    DT_referenceList: category=STRUCTURE
      element arrayMember: implementation-data-type=DT_referenceList_arrayMember_ARRAY
    DT_constraintList: category=STRUCTURE
      element arrayMember: implementation-data-type=DT_constraintList_arrayMember_ARRAY
    DT_attribute: category=STRUCTURE
      4 x element, all with category=TYPE_REFERENCE:
        confidence: implementation-data-type=Float
        attributeType: implementation-data-type=UInt16
        direction: implementation-data-type=DT_direction
        attributePointList: implementation-data-type=DT_attributePointList
    DT_attributePointList: category=STRUCTURE
      element arrayMember: implementation-data-type=DT_attributePointList_arrayMember_ARRAY
    DT_attributePoint: category=STRUCTURE
      element offset: implementation-data-type=Float
      element attributeValue: implementation-data-type=DT_attributeValue
      element laneList: implementation-data-type=DT_laneIndexList
    DT_attributeValue: category=STRUCTURE
      5 x element, all with category=TYPE_REFERENCE:
        intValue: implementation-data-type=UInt16
        floatValue: implementation-data-type=Float
        blobValue: implementation-data-type=DT_byteArray
        speedLimit: implementation-data-type=DT_speedLimit
        overtakingProhibition: implementation-data-type=DT_overtakingProhibition
    DT_speedLimit: category=STRUCTURE
      4 x element, all with category=TYPE_REFERENCE:
        speedValue: implementation-data-type=UInt32
        source: implementation-data-type=DT_speedLimitSource
        constraintList: implementation-data-type=DT_constraintList
        online: implementation-data-type=Boolean
    DT_overtakingProhibition: category=STRUCTURE
      element online: implementation-data-type=Boolean
      element constraintList: implementation-data-type=DT_constraintList
      element type: implementation-data-type=DT_overtakingProhibitionType
    DT_speedLimitSource: category=STRUCTURE
      element speedLimitSource: implementation-data-type=speedLimitSource_speedLimitSource
    DT_byteArray: category=STRUCTURE
      element arrayMember: implementation-data-type=DT_byteArray_arrayMember_ARRAY
    DT_laneIndexList: category=STRUCTURE
      element arrayMember: implementation-data-type=DT_laneIndexList_arrayMember_ARRAY
    DT_listOfDays: category=STRUCTURE
      element arrayMember: implementation-data-type=DT_listOfDays_arrayMember_ARRAY
    DT_overtakingProhibitionType: category=STRUCTURE
      element overtakingProhibitionType: implementation-data-type=overtakingProhibitionType_overtakingProhibitionType
    DT_constraint: category=STRUCTURE
      7 x element, all with category=TYPE_REFERENCE:
        daysOfWeek: implementation-data-type=DT_listOfDays
        timeRangeOfDay: implementation-data-type=DT_timeRangeOfDay
        weatherConstraint: implementation-data-type=DT_weather
        timeClassifier: implementation-data-type=DT_timeConstraintType
        zoneClassifier: implementation-data-type=DT_zoneConstraintType
        applicableVehicles: implementation-data-type=DT_applicableVehiclesType
        turnConstraint: implementation-data-type=DT_turnConstraint
    DT_timeRangeOfDay: category=STRUCTURE
      4 x element, all with category=TYPE_REFERENCE, implementation-data-type=UInt8:
        startTimeHour
        startTimeMinute
        endTimeHour
        endTimeMinute
    DT_weather: category=STRUCTURE
      element Weather: implementation-data-type=weather_Weather
    DT_timeConstraintType: category=STRUCTURE
      element timeConstraintType: implementation-data-type=timeConstraintType_timeConstraintType
    DT_zoneConstraintType: category=STRUCTURE
      element zoneConstraintType: implementation-data-type=zoneConstraintType_zoneConstraintType
    DT_applicableVehiclesType: category=STRUCTURE
      element applicableVehiclesType: implementation-data-type=applicableVehiclesType_applicableVehiclesType
    DT_turnConstraint: category=STRUCTURE
      element turnConstraint: implementation-data-type=turnConstraint_turnConstraint
    DT_layerInfo: category=STRUCTURE
      element referenceBaseList: implementation-data-type=DT_referenceBaseList
      element metaDataList: implementation-data-type=DT_metaDataList
    DT_metaDataList: category=STRUCTURE
      element arrayMember: implementation-data-type=DT_metaDataList_arrayMember_ARRAY
    DT_metaData: category=STRUCTURE
      7 x element, all with category=TYPE_REFERENCE:
        countryCode: implementation-data-type=String
        regionCode: implementation-data-type=String
        mapAge: implementation-data-type=DT_monthOfYear
        qualityIndicators: implementation-data-type=DT_qualityIndicatorList
        trafficDirection: implementation-data-type=DT_trafficDirection
        generalSpeedLimits: implementation-data-type=DT_generalSpeedLimitList
        speedUnit: implementation-data-type=DT_speedUnit
    DT_referenceBaseList: category=STRUCTURE
      element arrayMember: implementation-data-type=DT_referenceBaseList_arrayMember_ARRAY
    DT_referenceBase: category=STRUCTURE
      element productId: implementation-data-type=UInt16
      element updateRegion: implementation-data-type=UInt16
      element tileId: implementation-data-type=UInt32
    DT_generalSpeedLimitList: category=STRUCTURE
      element arrayMember: implementation-data-type=DT_generalSpeedLimitList_arrayMember_ARRAY
    DT_generalSpeedLimit: category=STRUCTURE
      element type: implementation-data-type=DT_generalSpeedLimitType
      element speedValue: implementation-data-type=UInt8
      element constraint: implementation-data-type=DT_constraintList
    DT_generalSpeedLimitType: category=STRUCTURE
      element generalSpeedLimitType: implementation-data-type=generalSpeedLimitType_generalSpeedLimitType
    DT_speedUnit: category=STRUCTURE
      element speedUnit: implementation-data-type=speedUnit_speedUnit
    DT_qualityIndicatorList: category=STRUCTURE
      element arrayMember: implementation-data-type=DT_qualityIndicatorList_arrayMember_ARRAY
    DT_qualityIndicator: category=STRUCTURE
      element type: implementation-data-type=DT_qualityIndicatorType
      element quality: implementation-data-type=UInt8
    DT_qualityIndicatorType: category=STRUCTURE
      element qualityIndicatorType: implementation-data-type=qualityIndicatorType_qualityIndicatorType
    DT_trafficDirection: category=STRUCTURE
      element trafficDirection: implementation-data-type=trafficDirection_trafficDirection
    DT_monthOfYear: category=STRUCTURE
      element month: implementation-data-type=UInt8
      element year: implementation-data-type=UInt16
    DT_ego: category=STRUCTURE
      5 x element, all with category=TYPE_REFERENCE:
        egoPosition: implementation-data-type=DT_egoPositionAttribute
        routeGuidanceActive: implementation-data-type=Boolean
        routeGuidanceChanged: implementation-data-type=Boolean
        pathList: implementation-data-type=DT_pathList
        routeLength: implementation-data-type=Float
    DT_egoPositionAttribute: category=STRUCTURE
      5 x element, all with category=TYPE_REFERENCE:
        linkPose: implementation-data-type=DT_linkPose
        lanePose: implementation-data-type=DT_lanePose
        rawPose: implementation-data-type=DT_pose
        timeStamp: implementation-data-type=UInt64
        speed: implementation-data-type=Float
    DT_pathList: category=STRUCTURE
      element arrayMember: implementation-data-type=DT_pathList_arrayMember_ARRAY
    DT_path: category=STRUCTURE
      4 x element, all with category=TYPE_REFERENCE:
        pathType: implementation-data-type=DT_pathType
        pathElementList: implementation-data-type=DT_pathElementList
        pathID: implementation-data-type=UInt8
        confidence: implementation-data-type=Float
    DT_pathType: category=STRUCTURE
      element pathType: implementation-data-type=pathType_pathType
    DT_pathElementList: category=STRUCTURE
      element arrayMember: implementation-data-type=DT_pathElementList_arrayMember_ARRAY
    DT_pathElement: category=STRUCTURE
      element linkReference: implementation-data-type=DT_reference
      element positiveGeometryDirection: implementation-data-type=Boolean
    DT_pose: category=STRUCTURE
      element coordinate: implementation-data-type=DT_wgs84Coordinate
      element heading: implementation-data-type=Float
    DT_linkPose: category=STRUCTURE
      element pose: implementation-data-type=DT_pose
      element linkRelativeCoordinate: implementation-data-type=DT_relativeCoordinate
      element mapMatchingAccuracy: implementation-data-type=Float
    DT_lanePose: category=STRUCTURE
      element pose: implementation-data-type=DT_pose
      element laneRelativeCoordinate: implementation-data-type=DT_relativeCoordinate
      element mapMatchingAccuracy: implementation-data-type=Float
    DT_link: category=STRUCTURE
      19 x element, all with category=TYPE_REFERENCE:
        metaDataIndex: implementation-data-type=UInt8
        fromLinkList: implementation-data-type=DT_referenceList
        toLinkList: implementation-data-type=DT_referenceList
        linkType: implementation-data-type=DT_linkType
        reference: implementation-data-type=DT_reference
        controlledAccess: implementation-data-type=Boolean
        drivingDirection: implementation-data-type=DT_direction
        functionalRoadClass: implementation-data-type=DT_functionalRoadClass
        clothoidList: implementation-data-type=DT_clothoidList
        polyline: implementation-data-type=DT_polyline
        insideCityLimits: implementation-data-type=Boolean
        tollway: implementation-data-type=Boolean
        adas: implementation-data-type=DT_adasAccuracyType
        urban: implementation-data-type=Boolean
        paved: implementation-data-type=Boolean
        attributeList: implementation-data-type=DT_attributeList
        avgSpeed: implementation-data-type=UInt8
        rightOfWay: implementation-data-type=DT_rightOfWayRegulation
        length: implementation-data-type=UInt32
    DT_linkType: category=STRUCTURE
      element linkType: implementation-data-type=linkType_linkType
    DT_functionalRoadClass: category=STRUCTURE
      element functionalRoadClass: implementation-data-type=functionalRoadClass_functionalRoadClass
    DT_clothoidList: category=STRUCTURE
      element arrayMember: implementation-data-type=DT_clothoidList_arrayMember_ARRAY
    DT_clothoid: category=STRUCTURE
      6 x element, all with category=TYPE_REFERENCE:
        startCurvature: implementation-data-type=Float
        endCurvature: implementation-data-type=Float
        length: implementation-data-type=Float
        angle: implementation-data-type=Float
        ndsCoordinates: implementation-data-type=DT_wgs84Coordinate
        geometryQuality: implementation-data-type=UInt8
    DT_rightOfWayRegulation: category=STRUCTURE
      element rightOfWayRegulation: implementation-data-type=rightOfWayRegulation_rightOfWayRegulation
    DT_adasAccuracyType: category=STRUCTURE
      element adasAccuracyType: implementation-data-type=adasAccuracyType_adasAccuracyType
    DT_laneGroup: category=STRUCTURE
      6 x element, all with category=TYPE_REFERENCE:
        laneGroupReference: implementation-data-type=DT_reference
        linkReferenceList: implementation-data-type=DT_linkReferenceList
        laneList: implementation-data-type=DT_laneList
        laneBoundaryGroupList: implementation-data-type=DT_laneBoundaryGroupList
        laneGroupAssociationList: implementation-data-type=DT_laneGroupAssociatonList
        metaDataIndex: implementation-data-type=UInt8
    DT_laneList: category=STRUCTURE
      element arrayMember: implementation-data-type=DT_laneList_arrayMember_ARRAY
    DT_lane: category=STRUCTURE
      11 x element, all with category=TYPE_REFERENCE:
        sourceLaneReferenceList: implementation-data-type=DT_referenceList
        destinationLaneReferenceList: implementation-data-type=DT_referenceList
        laneWidth: implementation-data-type=Float
        centerlineGeometry: implementation-data-type=DT_polyline
        laneConnectionType: implementation-data-type=DT_laneConnectionType
        laneConnectivityElementType: implementation-data-type=DT_laneConnectivityElementType
        laneReference: implementation-data-type=DT_reference
        laneGroupReference: implementation-data-type=DT_reference
        laneIndex: implementation-data-type=UInt8
        attributeList: implementation-data-type=DT_attributeList
        length: implementation-data-type=UInt32
    DT_laneBoundary: category=STRUCTURE
      7 x element, all with category=TYPE_REFERENCE:
        type: implementation-data-type=DT_laneBoundaryType
        openToCurbSide: implementation-data-type=Boolean
        openToMiddleSide: implementation-data-type=Boolean
        range: implementation-data-type=DT_rangedAttribute
        boundaryGeometry: implementation-data-type=DT_polyline
        color: implementation-data-type=DT_landmarkObjectMarkingColor
        width: implementation-data-type=UInt8
    DT_laneBoundaryType: category=STRUCTURE
      element laneBoundaryType: implementation-data-type=laneBoundaryType_laneBoundaryType
    DT_rangedAttribute: category=STRUCTURE
      element rangeStart: implementation-data-type=Float
      element rangeEnd: implementation-data-type=Float
    DT_laneBoundarySequentialList: category=STRUCTURE
      element arrayMember: implementation-data-type=DT_laneBoundarySequentialList_arrayMember_ARRAY
    DT_laneBoundaryGroup: category=STRUCTURE
      element laneBoundaryParallelElementList: implementation-data-type=DT_laneBoundaryParallelElementList
    DT_linkReferenceList: category=STRUCTURE
      element arrayMember: implementation-data-type=DT_linkReferenceList_arrayMember_ARRAY
    DT_laneBoundaryGroupList: category=STRUCTURE
      element arrayMember: implementation-data-type=DT_laneBoundaryGroupList_arrayMember_ARRAY
    DT_laneGroupList: category=STRUCTURE
      element arrayMember: implementation-data-type=DT_laneGroupList_arrayMember_ARRAY
    DT_laneBoundaryParallelElement: category=STRUCTURE
      element laneBoundarySequentialList: implementation-data-type=DT_laneBoundarySequentialList
    DT_laneBoundaryParallelElementList: category=STRUCTURE
      element arrayMember: implementation-data-type=DT_laneBoundaryParallelElementList_arrayMember_ARRAY
    DT_laneConnectionType: category=STRUCTURE
      element laneConnectionType: implementation-data-type=laneConnectionType_laneConnectionType
    DT_laneConnectivityElementType: category=STRUCTURE
      element laneConnectivityElementType: implementation-data-type=laneConnectivityElementType_laneConnectivityElementType
    DT_laneGroupAssociation: category=STRUCTURE
      element laneGroupAssociationType: implementation-data-type=DT_laneGroupAssociationType
      element laneGroupReferenceList: implementation-data-type=DT_referenceList
    DT_laneGroupAssociationType: category=STRUCTURE
      element laneGroupAssociationType: implementation-data-type=laneGroupAssociationType_laneGroupAssociationType
    DT_laneGroupAssociatonList: category=STRUCTURE
      element arrayMember: implementation-data-type=DT_laneGroupAssociatonList_arrayMember_ARRAY
    DT_timezoneInformation: category=STRUCTURE
      4 x element, all with category=TYPE_REFERENCE:
        type: implementation-data-type=DT_timezoneInformationType
        timezoneST: implementation-data-type=DT_timezone
        timezoneDST: implementation-data-type=DT_timezone
        timezoneDSTactive: implementation-data-type=Boolean
    DT_timezoneInformationType: category=STRUCTURE
      element timezoneInformationType: implementation-data-type=timezoneInformationType_timezoneInformationType
    DT_timezone: category=STRUCTURE
      7 x element, all with category=TYPE_REFERENCE:
        timezoneOffsetUtcHours: implementation-data-type=Int32
        timezoneOffsetUtcMinutes: implementation-data-type=UInt8
        year: implementation-data-type=UInt16
        monthOfYear: implementation-data-type=UInt8
        dayOfMonth: implementation-data-type=UInt8
        hourOfDay: implementation-data-type=UInt8
        minuteOfHour: implementation-data-type=UInt8
    DT_dynamicContent: category=STRUCTURE
      element dynamicAttributes: implementation-data-type=DT_referencedAttributeList
    DT_referencedAttributeList: category=STRUCTURE
      element arrayMember: implementation-data-type=DT_referencedAttributeList_arrayMember_ARRAY
    DT_referencedAttribute: category=STRUCTURE
      4 x element, all with category=TYPE_REFERENCE:
        linkReference: implementation-data-type=DT_reference
        laneReference: implementation-data-type=DT_reference
        attributeList: implementation-data-type=DT_attributeList
        psd15SegmentReference: implementation-data-type=DT_psd15ClothoidOrder
    DT_psd15ClothoidOrder: category=STRUCTURE
      element arrayMember: implementation-data-type=DT_psd15ClothoidOrder_arrayMember_ARRAY
    DT_psd15segmentIdList: category=STRUCTURE
      element arrayMember: implementation-data-type=DT_psd15segmentIdList_arrayMember_ARRAY
    DT_landmarkObjectMarker: category=STRUCTURE
      element id: implementation-data-type=UInt16
      element boundingBox: implementation-data-type=DT_polyline
    DT_landmarkObjectMarkerType: category=STRUCTURE
      element landmarkObjectMarkerType: implementation-data-type=landmarkObjectMarkerType_landmarkObjectMarkerType
    DT_landmarkList: category=STRUCTURE
      element arrayMember: implementation-data-type=DT_landmarkList_arrayMember_ARRAY
    DT_landmark: category=STRUCTURE
      element confidenceLevel: implementation-data-type=UInt8
      element detailedObjectList: implementation-data-type=DT_landmarkObjectDetailsList
      element position: implementation-data-type=DT_wgs84Coordinate
    DT_landmarkObjectDetails: category=STRUCTURE
      6 x element, all with category=TYPE_REFERENCE:
        objectType: implementation-data-type=DT_landmarkObjectType
        sign: implementation-data-type=DT_landmarkObjectSign
        pole: implementation-data-type=DT_landmarkObjectDetailsPole
        marking: implementation-data-type=DT_landmarkObjectDetailsMarking
        covariance: implementation-data-type=DT_covariance3D
        marker: implementation-data-type=DT_applicableVehiclesType
    DT_landmarkObjectDetailsList: category=STRUCTURE
      element arrayMember: implementation-data-type=DT_landmarkObjectDetailsList_arrayMember_ARRAY
    DT_landmarkObjectDetailsPole: category=STRUCTURE
      6 x element, all with category=TYPE_REFERENCE:
        polePositionGround: implementation-data-type=DT_wgs84Coordinate
        polePositionTop: implementation-data-type=DT_wgs84Coordinate
        diameter: implementation-data-type=UInt16
        diameterTop: implementation-data-type=UInt16
        height: implementation-data-type=UInt16
        poleType: implementation-data-type=DT_landmarkObjectPoleType
    DT_landmarkObjectDetailsMarking: category=STRUCTURE
      4 x element, all with category=TYPE_REFERENCE:
        markingType: implementation-data-type=DT_landmarkObjectMarkingType
        colorType: implementation-data-type=DT_landmarkObjectMarkingColor
        boundingBox: implementation-data-type=DT_polyline
        line: implementation-data-type=DT_polyline
    DT_landmarkObjectType: category=STRUCTURE
      element landmarkObjectType: implementation-data-type=landmarkObjectType_landmarkObjectType
    DT_landmarkObjectSign: category=STRUCTURE
      4 x element, all with category=TYPE_REFERENCE:
        signShape: implementation-data-type=DT_landmarkObjectSignShape
        signMeaning: implementation-data-type=DT_warningSign
        diameter: implementation-data-type=UInt16
        boundingBox: implementation-data-type=DT_polyline
    DT_covariance3D: category=STRUCTURE
      4 x element, all with category=TYPE_REFERENCE, implementation-data-type=UInt16:
        varianceXX
        varianceYY
        varianceZZ
        covarianceXY
    DT_landmarkObjectMarkingType: category=STRUCTURE
      element landmarkObjectMarkingType: implementation-data-type=landmarkObjectMarkingType_landmarkObjectMarkingType
    DT_landmarkObjectPoleType: category=STRUCTURE
      element landmarkObjectPoleType: implementation-data-type=landmarkObjectPoleType_landmarkObjectPoleType
    DT_landmarkObjectSignShape: category=STRUCTURE
      element landmarkObjectSignShape: implementation-data-type=landmarkObjectSignShape_landmarkObjectSignShape
    DT_landmarkObjectMarkingColor: category=STRUCTURE
      element laneMarkingColor: implementation-data-type=landmarkObjectMarkingColor_laneMarkingColor
    DT_warningSign: category=STRUCTURE
      element warningSign: implementation-data-type=warningSign_warningSign
    DT_parkingGarage: category=STRUCTURE
      5 x element, all with category=TYPE_REFERENCE:
        parkingSectionList: implementation-data-type=DT_parkingGarageSectionList
        parkingRowList: implementation-data-type=DT_parkingRowList
        outerPolygon: implementation-data-type=DT_polyline
        facilityType: implementation-data-type=DT_parkingFacilityType
        facilityId: implementation-data-type=DT_reference
    DT_parkingGarageList: category=STRUCTURE
      element arrayMember: implementation-data-type=DT_parkingGarageList_arrayMember_ARRAY
    DT_parkingGarageSection: category=STRUCTURE
      11 x element, all with category=TYPE_REFERENCE:
        sectionId: implementation-data-type=DT_reference
        parkingRowList: implementation-data-type=DT_parkingRowList
        sectionConnectionList: implementation-data-type=DT_referenceList
        laneAccessList: implementation-data-type=DT_laneRelativeCoordinateList
        linkAccessList: implementation-data-type=DT_linkRelativeCoordinateList
        sectionType: implementation-data-type=DT_parkingSectionType
        name: implementation-data-type=DT_parkingSectionName
        outerBoundary: implementation-data-type=DT_polyline
        floorNumber: implementation-data-type=UInt8
        areaList: implementation-data-type=DT_parkingAreaList
        childSectionList: implementation-data-type=DT_referenceList
    DT_parkingGarageSectionList: category=STRUCTURE
      element arrayMember: implementation-data-type=DT_parkingGarageSectionList_arrayMember_ARRAY
    DT_parkingRow: category=STRUCTURE
      4 x element, all with category=TYPE_REFERENCE:
        parkingRowId: implementation-data-type=DT_reference
        laneRangeList: implementation-data-type=DT_laneReferenceList
        linkRangeList: implementation-data-type=DT_linkReferenceList
        parkingSpotList: implementation-data-type=DT_parkingSpot
    DT_laneReferenceList: category=STRUCTURE
      element arrayMember: implementation-data-type=DT_laneReferenceList_arrayMember_ARRAY
    DT_parkingRowList: category=STRUCTURE
      element arrayMember: implementation-data-type=DT_parkingRowList_arrayMember_ARRAY
    DT_parkingSpot: category=STRUCTURE
      element spotId: implementation-data-type=DT_reference
      element laneRangeList: implementation-data-type=DT_laneRelativeCoordinateList
      element linkRangeList: implementation-data-type=DT_linkRelativeCoordinateList
    DT_parkingSpotList: category=STRUCTURE
      element arrayMember: implementation-data-type=DT_parkingSpotList_arrayMember_ARRAY
    DT_laneRelativeCoordinateList: category=STRUCTURE
      element arrayMember: implementation-data-type=DT_laneRelativeCoordinateList_arrayMember_ARRAY
    DT_linkRelativeCoordinateList: category=STRUCTURE
      element arrayMember: implementation-data-type=DT_linkRelativeCoordinateList_arrayMember_ARRAY
    DT_parkingSectionType: category=STRUCTURE
      element parkingSectionType: implementation-data-type=parkingSectionType_parkingSectionType
    DT_parkingArea: category=STRUCTURE
      element areaId: implementation-data-type=UInt16
      element areaType: implementation-data-type=DT_parkingAreaType
      element outerBoundary: implementation-data-type=DT_polyline
    DT_parkingFacilityType: category=STRUCTURE
      element parkingFacilityType: implementation-data-type=parkingFacilityType_parkingFacilityType
    DT_parkingAreaList: category=STRUCTURE
      element arrayMember: implementation-data-type=DT_parkingAreaList_arrayMember_ARRAY
    DT_parkingAreaType: category=STRUCTURE
      element parkingAreaType: implementation-data-type=parkingAreaType_parkingAreaType
    DT_parkingSectionName: category=STRUCTURE
      element name: implementation-data-type=String
    DT_linkLayerLongRange_struct: category=STRUCTURE
      element id: implementation-data-type=DT_uuid
      element linkLayerLongRange: implementation-data-type=DT_linkLayerLongRangelinkLayerLongRange
      element layerInfo: implementation-data-type=DT_layerInfo
    DT_linkLayerShortRange_struct: category=STRUCTURE
      element id: implementation-data-type=DT_uuid
      element linkLayerShortRange: implementation-data-type=DT_linkLayerShortRangelinkLayerShortRange
      element layerInfo: implementation-data-type=DT_layerInfo
    DT_laneLayer_struct: category=STRUCTURE
      element id: implementation-data-type=DT_uuid
      element laneLayer: implementation-data-type=DT_laneLayerlaneLayer
      element layerInfo: implementation-data-type=DT_layerInfo
    DT_positioningObjectsLayer_struct: category=STRUCTURE
      element id: implementation-data-type=DT_uuid
      element positioningObjectsLayer: implementation-data-type=DT_positioningObjectsLayerpositioningObjectsLayer
      element layerInfo: implementation-data-type=DT_layerInfo
    DT_egoPositionLayer_struct: category=STRUCTURE
      element id: implementation-data-type=DT_uuid
      element egoPositionLayer: implementation-data-type=DT_ego
      element layerInfo: implementation-data-type=DT_layerInfo
    DT_dynamicContentLayer_struct: category=STRUCTURE
      element id: implementation-data-type=DT_uuid
      element dynamicContentLayer: implementation-data-type=DT_dynamicContent
      element layerInfo: implementation-data-type=DT_layerInfo
    DT_automatedParkingLayer_struct: category=STRUCTURE
      element id: implementation-data-type=DT_uuid
      element automatedParkingLayer: implementation-data-type=DT_automatedParkingLayerautomatedParkingLayer
      element layerInfo: implementation-data-type=DT_layerInfo
    DT_timezoneInformation_struct: category=STRUCTURE
      element id: implementation-data-type=DT_uuid
      element timezoneInformation: implementation-data-type=DT_timezoneInformation
    DT_polyline_arrayMember_ARRAY: category=VECTOR, dynamic-array-size-profile=VSA_LINEAR
      element subElement: implementation-data-type=DT_wgs84Coordinate
    DT_attributeList_arrayMember_ARRAY: category=VECTOR, dynamic-array-size-profile=VSA_LINEAR
      element subElement: implementation-data-type=DT_attribute
    DT_referenceList_arrayMember_ARRAY: category=VECTOR, dynamic-array-size-profile=VSA_LINEAR
      element subElement: implementation-data-type=DT_reference
    DT_constraintList_arrayMember_ARRAY: category=VECTOR, dynamic-array-size-profile=VSA_LINEAR
      element subElement: implementation-data-type=DT_constraint
    DT_attributePointList_arrayMember_ARRAY: category=VECTOR, dynamic-array-size-profile=VSA_LINEAR
      element subElement: implementation-data-type=DT_attributePoint
    DT_byteArray_arrayMember_ARRAY: category=VECTOR, dynamic-array-size-profile=VSA_LINEAR
      element subElement: implementation-data-type=UInt8
    DT_laneIndexList_arrayMember_ARRAY: category=VECTOR, dynamic-array-size-profile=VSA_LINEAR
      element subElement: implementation-data-type=UInt8
    DT_listOfDays_arrayMember_ARRAY: category=VECTOR, dynamic-array-size-profile=VSA_LINEAR
      element subElement: implementation-data-type=UInt8
    DT_metaDataList_arrayMember_ARRAY: category=VECTOR, dynamic-array-size-profile=VSA_LINEAR
      element subElement: implementation-data-type=DT_metaData
    DT_referenceBaseList_arrayMember_ARRAY: category=VECTOR, dynamic-array-size-profile=VSA_LINEAR
      element subElement: implementation-data-type=DT_referenceBase
    DT_generalSpeedLimitList_arrayMember_ARRAY: category=VECTOR, dynamic-array-size-profile=VSA_LINEAR
      element subElement: implementation-data-type=DT_generalSpeedLimit
    DT_qualityIndicatorList_arrayMember_ARRAY: category=VECTOR, dynamic-array-size-profile=VSA_LINEAR
      element subElement: implementation-data-type=DT_qualityIndicator
    DT_pathList_arrayMember_ARRAY: category=VECTOR, dynamic-array-size-profile=VSA_LINEAR
      element subElement: implementation-data-type=DT_path
    DT_pathElementList_arrayMember_ARRAY: category=VECTOR, dynamic-array-size-profile=VSA_LINEAR
      element subElement: implementation-data-type=DT_pathElement
    DT_clothoidList_arrayMember_ARRAY: category=VECTOR, dynamic-array-size-profile=VSA_LINEAR
      element subElement: implementation-data-type=DT_clothoid
    DT_laneList_arrayMember_ARRAY: category=VECTOR, dynamic-array-size-profile=VSA_LINEAR
      element subElement: implementation-data-type=DT_lane
    DT_laneBoundarySequentialList_arrayMember_ARRAY: category=VECTOR, dynamic-array-size-profile=VSA_LINEAR
      element subElement: implementation-data-type=DT_laneBoundary
    DT_linkReferenceList_arrayMember_ARRAY: category=VECTOR, dynamic-array-size-profile=VSA_LINEAR
      element subElement: implementation-data-type=DT_rangedReference
    DT_laneBoundaryGroupList_arrayMember_ARRAY: category=VECTOR, dynamic-array-size-profile=VSA_LINEAR
      element subElement: implementation-data-type=DT_laneBoundaryGroup
    DT_laneGroupList_arrayMember_ARRAY: category=VECTOR, dynamic-array-size-profile=VSA_LINEAR
      element subElement: implementation-data-type=DT_laneGroup
    DT_laneBoundaryParallelElementList_arrayMember_ARRAY: category=VECTOR, dynamic-array-size-profile=VSA_LINEAR
      element subElement: implementation-data-type=DT_laneBoundaryParallelElement
    DT_laneGroupAssociatonList_arrayMember_ARRAY: category=VECTOR, dynamic-array-size-profile=VSA_LINEAR
      element subElement: implementation-data-type=DT_laneGroupAssociation
    DT_referencedAttributeList_arrayMember_ARRAY: category=VECTOR, dynamic-array-size-profile=VSA_LINEAR
      element subElement: implementation-data-type=DT_referencedAttribute
    DT_psd15ClothoidOrder_arrayMember_ARRAY: category=VECTOR, dynamic-array-size-profile=VSA_LINEAR
      element subElement: implementation-data-type=DT_psd15segmentIdList
    DT_psd15segmentIdList_arrayMember_ARRAY: category=VECTOR, dynamic-array-size-profile=VSA_LINEAR
      element subElement: implementation-data-type=UInt8
    DT_landmarkList_arrayMember_ARRAY: category=VECTOR, dynamic-array-size-profile=VSA_LINEAR
      element subElement: implementation-data-type=DT_landmark
    DT_landmarkObjectDetailsList_arrayMember_ARRAY: category=VECTOR, dynamic-array-size-profile=VSA_LINEAR
      element subElement: implementation-data-type=DT_landmarkObjectDetails
    DT_parkingGarageList_arrayMember_ARRAY: category=VECTOR, dynamic-array-size-profile=VSA_LINEAR
      element subElement: implementation-data-type=DT_parkingGarage
    DT_parkingGarageSectionList_arrayMember_ARRAY: category=VECTOR, dynamic-array-size-profile=VSA_LINEAR
      element subElement: implementation-data-type=DT_parkingGarageSection
    DT_laneReferenceList_arrayMember_ARRAY: category=VECTOR, dynamic-array-size-profile=VSA_LINEAR
      element subElement: implementation-data-type=DT_rangedReference
    DT_parkingRowList_arrayMember_ARRAY: category=VECTOR, dynamic-array-size-profile=VSA_LINEAR
      element subElement: implementation-data-type=DT_parkingRow
    DT_parkingSpotList_arrayMember_ARRAY: category=VECTOR, dynamic-array-size-profile=VSA_LINEAR
      element subElement: implementation-data-type=DT_parkingSpot
    DT_laneRelativeCoordinateList_arrayMember_ARRAY: category=VECTOR, dynamic-array-size-profile=VSA_LINEAR
      element subElement: implementation-data-type=DT_relativeCoordinate
    DT_linkRelativeCoordinateList_arrayMember_ARRAY: category=VECTOR, dynamic-array-size-profile=VSA_LINEAR
      element subElement: implementation-data-type=DT_relativeCoordinate
    DT_parkingAreaList_arrayMember_ARRAY: category=VECTOR, dynamic-array-size-profile=VSA_LINEAR
      element subElement: implementation-data-type=DT_parkingArea
    DT_linkLayerLongRangelinkLayerLongRange: category=VECTOR, dynamic-array-size-profile=VSA_LINEAR
      element subElement: implementation-data-type=DT_link
    DT_linkLayerLongRange_vector: category=VECTOR, dynamic-array-size-profile=VSA_LINEAR
      element subElement: implementation-data-type=DT_linkLayerLongRange_struct
    DT_linkLayerShortRangelinkLayerShortRange: category=VECTOR, dynamic-array-size-profile=VSA_LINEAR
      element subElement: implementation-data-type=DT_link
    DT_linkLayerShortRange_vector: category=VECTOR, dynamic-array-size-profile=VSA_LINEAR
      element subElement: implementation-data-type=DT_linkLayerShortRange_struct
    DT_laneLayerlaneLayer: category=VECTOR, dynamic-array-size-profile=VSA_LINEAR
      element subElement: implementation-data-type=DT_laneGroup
    DT_laneLayer_vector: category=VECTOR, dynamic-array-size-profile=VSA_LINEAR
      element subElement: implementation-data-type=DT_laneLayer_struct
    DT_positioningObjectsLayerpositioningObjectsLayer: category=VECTOR, dynamic-array-size-profile=VSA_LINEAR
      element subElement: implementation-data-type=DT_landmark
    DT_positioningObjectsLayer_vector: category=VECTOR, dynamic-array-size-profile=VSA_LINEAR
      element subElement: implementation-data-type=DT_positioningObjectsLayer_struct
    DT_egoPositionLayer_vector: category=VECTOR, dynamic-array-size-profile=VSA_LINEAR
      element subElement: implementation-data-type=DT_egoPositionLayer_struct
    DT_dynamicContentLayer_vector: category=VECTOR, dynamic-array-size-profile=VSA_LINEAR
      element subElement: implementation-data-type=DT_dynamicContentLayer_struct
    DT_automatedParkingLayerautomatedParkingLayer: category=VECTOR, dynamic-array-size-profile=VSA_LINEAR
      element subElement: implementation-data-type=DT_parkingGarage
    DT_automatedParkingLayer_vector: category=VECTOR, dynamic-array-size-profile=VSA_LINEAR
      element subElement: implementation-data-type=DT_automatedParkingLayer_struct
    DT_timezoneInformation_vector: category=VECTOR, dynamic-array-size-profile=VSA_LINEAR
      element subElement: implementation-data-type=DT_timezoneInformation_struct
  app type direction_direction_App: category=VALUE, compu {0=none, 1=forward, 2=backward, 3=both}
  impl type direction_direction: implementation-data-type=UInt32, compu {0=none, 1=forward, 2=backward, 3=both}
  data type mapping set DM_direction_direction: data-type-map{application-data-type=direction_direction_App, implementation-data-type=direction_direction}
  app type speedLimitSource_speedLimitSource_App: category=VALUE, compu {0=posted, 1=derived}
  impl type speedLimitSource_speedLimitSource: implementation-data-type=UInt32, compu {0=posted, 1=derived}
  data type mapping set DM_speedLimitSource_speedLimitSource: data-type-map{application-data-type=speedLimitSource_speedLimitSource_App, implementation-data-type=speedLimitSource_speedLimitSource}
  compu method CM_overtakingProhibitionType_overtakingProhibitionType: 0=noOvertaking, 1=noOvertakingEnd, 2=noOvertakingForTrucks, 3=noOvertakingForTrucksEnd
  app type overtakingProhibitionType_overtakingProhibitionType_App: category=VALUE, compu-method=CM_overtakingProhibitionType_overtakingProhibitionType
  impl type overtakingProhibitionType_overtakingProhibitionType: implementation-data-type=UInt32, compu-method=CM_overtakingProhibitionType_overtakingProhibitionType
  data type mapping set DM_overtakingProhibitionType_overtakingProhibitionType: data-type-map{application-data-type=overtakingProhibitionType_overtakingProhibitionType_App, implementation-data-type=overtakingProhibitionType_overtakingProhibitionType}
  compu method CM_weather_Weather: 0=snow, 1=rain, 2=sunshine, 3=fog, 4=thaw, 5=strongWind, 6=avalanche, 7=independent, 8=ice
  app type weather_Weather_App: category=VALUE, compu-method=CM_weather_Weather
  impl type weather_Weather: implementation-data-type=UInt32, compu-method=CM_weather_Weather
  data type mapping set DM_weather_Weather: data-type-map{application-data-type=weather_Weather_App, implementation-data-type=weather_Weather}
  compu method CM_timeConstraintType_timeConstraintType: 0=day, 1=night, 2=duskTillDawn, 3=schooldays, 4=timeDependent, 5=approximateSeasonalTime
  app type timeConstraintType_timeConstraintType_App: category=VALUE, compu-method=CM_timeConstraintType_timeConstraintType
  impl type timeConstraintType_timeConstraintType: implementation-data-type=UInt32, compu-method=CM_timeConstraintType_timeConstraintType
  data type mapping set DM_timeConstraintType_timeConstraintType: data-type-map{application-data-type=timeConstraintType_timeConstraintType_App, implementation-data-type=timeConstraintType_timeConstraintType}
  compu method CM_zoneConstraintType_zoneConstraintType: 0=schoolzone, 1=workzone, 2=separatedDrivingDirections, 3=advisory, 4=speedBump, 5=laneDependent
  app type zoneConstraintType_zoneConstraintType_App: category=VALUE, compu-method=CM_zoneConstraintType_zoneConstraintType
  impl type zoneConstraintType_zoneConstraintType: implementation-data-type=UInt32, compu-method=CM_zoneConstraintType_zoneConstraintType
  data type mapping set DM_zoneConstraintType_zoneConstraintType: data-type-map{application-data-type=zoneConstraintType_zoneConstraintType_App, implementation-data-type=zoneConstraintType_zoneConstraintType}
  compu method CM_applicableVehiclesType_applicableVehiclesType: 0=truck, 1=truckOver35Tons, 2=bus, 3=passengerVehicleWithTrailer, 4=motorhome, 5=motorcycle, 6=autonomous
  app type applicableVehiclesType_applicableVehiclesType_App: category=VALUE, compu-method=CM_applicableVehiclesType_applicableVehiclesType
  impl type applicableVehiclesType_applicableVehiclesType: implementation-data-type=UInt32, compu-method=CM_applicableVehiclesType_applicableVehiclesType
  data type mapping set DM_applicableVehiclesType_applicableVehiclesType: data-type-map{application-data-type=applicableVehiclesType_applicableVehiclesType_App, implementation-data-type=applicableVehiclesType_applicableVehiclesType}
  app type turnConstraint_turnConstraint_App: category=VALUE, compu {0=right, 1=left}
  impl type turnConstraint_turnConstraint: implementation-data-type=UInt32, compu {0=right, 1=left}
  data type mapping set DM_turnConstraint_turnConstraint: data-type-map{application-data-type=turnConstraint_turnConstraint_App, implementation-data-type=turnConstraint_turnConstraint}
  app type generalSpeedLimitType_generalSpeedLimitType_App: category=VALUE, compu {0=urban, 1=extraUrban, 2=expressway, 3=motorway}
  impl type generalSpeedLimitType_generalSpeedLimitType: implementation-data-type=UInt32, compu {0=urban, 1=extraUrban, 2=expressway, 3=motorway}
  data type mapping set DM_generalSpeedLimitType_generalSpeedLimitType: data-type-map{application-data-type=generalSpeedLimitType_generalSpeedLimitType_App, implementation-data-type=generalSpeedLimitType_generalSpeedLimitType}
  app type speedUnit_speedUnit_App: category=VALUE, compu {0=kmh, 1=mph}
  impl type speedUnit_speedUnit: implementation-data-type=UInt32, compu {0=kmh, 1=mph}
  data type mapping set DM_speedUnit_speedUnit: data-type-map{application-data-type=speedUnit_speedUnit_App, implementation-data-type=speedUnit_speedUnit}
  compu method CM_qualityIndicatorType_qualityIndicatorType: 0=buildUpArea, 1=geometry, 2=slopes, 3=rightOfWay, 4=roadMarkings, 5=speedLimits, 6=other
  app type qualityIndicatorType_qualityIndicatorType_App: category=VALUE, compu-method=CM_qualityIndicatorType_qualityIndicatorType
  impl type qualityIndicatorType_qualityIndicatorType: implementation-data-type=UInt32, compu-method=CM_qualityIndicatorType_qualityIndicatorType
  data type mapping set DM_qualityIndicatorType_qualityIndicatorType: data-type-map{application-data-type=qualityIndicatorType_qualityIndicatorType_App, implementation-data-type=qualityIndicatorType_qualityIndicatorType}
  app type trafficDirection_trafficDirection_App: category=VALUE, compu {0=rightHandTraffic, 1=leftHandTraffic}
  impl type trafficDirection_trafficDirection: implementation-data-type=UInt32, compu {0=rightHandTraffic, 1=leftHandTraffic}
  data type mapping set DM_trafficDirection_trafficDirection: data-type-map{application-data-type=trafficDirection_trafficDirection_App, implementation-data-type=trafficDirection_trafficDirection}
  app type pathType_pathType_App: category=VALUE, compu {0=heuristical, 1=routeGuidance, 2=pNav, 3=pNavSubsequent}
  impl type pathType_pathType: implementation-data-type=UInt32, compu {0=heuristical, 1=routeGuidance, 2=pNav, 3=pNavSubsequent}
  data type mapping set DM_pathType_pathType: data-type-map{application-data-type=pathType_pathType_App, implementation-data-type=pathType_pathType}
  compu method CM_linkType_linkType: 0=noSpecial, 1=ramp, 2=roundabout, 3=parallel, 4=serviceRoad, 5=mainRoad, 6=square, 8=pedestrianZone, 9=pedestrian, 10=roundaboutInterior, 11=slipRoad, 12=specialTrafficFigure, 13=boundary
  app type linkType_linkType_App: category=VALUE, compu-method=CM_linkType_linkType
  impl type linkType_linkType: implementation-data-type=UInt32, compu-method=CM_linkType_linkType
  data type mapping set DM_linkType_linkType: data-type-map{application-data-type=linkType_linkType_App, implementation-data-type=linkType_linkType}
  app type functionalRoadClass_functionalRoadClass_App: category=VALUE, compu {0..7=frc0..frc7}
  impl type functionalRoadClass_functionalRoadClass: implementation-data-type=UInt32, compu {0..7=frc0..frc7}
  data type mapping set DM_functionalRoadClass_functionalRoadClass: data-type-map{application-data-type=functionalRoadClass_functionalRoadClass_App, implementation-data-type=functionalRoadClass_functionalRoadClass}
  app type rightOfWayRegulation_rightOfWayRegulation_App: category=VALUE, compu {0=noSign, 1=rightOfWay, 2=giveWay, 3=stopGiveWay}
  impl type rightOfWayRegulation_rightOfWayRegulation: implementation-data-type=UInt32, compu {0=noSign, 1=rightOfWay, 2=giveWay, 3=stopGiveWay}
  data type mapping set DM_rightOfWayRegulation_rightOfWayRegulation: data-type-map{application-data-type=rightOfWayRegulation_rightOfWayRegulation_App, implementation-data-type=rightOfWayRegulation_rightOfWayRegulation}
  app type adasAccuracyType_adasAccuracyType_App: category=VALUE, compu {0=unknown, 1=low, 2=middle, 3=high}
  impl type adasAccuracyType_adasAccuracyType: implementation-data-type=UInt32, compu {0=unknown, 1=low, 2=middle, 3=high}
  data type mapping set DM_adasAccuracyType_adasAccuracyType: data-type-map{application-data-type=adasAccuracyType_adasAccuracyType_App, implementation-data-type=adasAccuracyType_adasAccuracyType}
  compu method CM_laneBoundaryType_laneBoundaryType: 0=noMarking, 1=longDashedLine, 2=doubleSolidLine, 3=singleSolidLine, 4=solidLineDashedLine, 5=dashedLineSolidLine, 6=shortDashedline, 7=shadedAreaMarking, 8=dashedBlocks, 9=doubleDashedLine, 10=crossingAlert, 11=curb, 12=wallFlat, 13=wallTunnel, 14=barrierJersey, 15=barrierSound, 16=barrierCable, 17=guardRail, 18=fence, 19=curbTraversable, 20=endOfRoad, 21=cliff, 22=ditch, 23=gore, 30=otherBarrier, 31=unknown
  app type laneBoundaryType_laneBoundaryType_App: category=VALUE, compu-method=CM_laneBoundaryType_laneBoundaryType
  impl type laneBoundaryType_laneBoundaryType: implementation-data-type=UInt32, compu-method=CM_laneBoundaryType_laneBoundaryType
  data type mapping set DM_laneBoundaryType_laneBoundaryType: data-type-map{application-data-type=laneBoundaryType_laneBoundaryType_App, implementation-data-type=laneBoundaryType_laneBoundaryType}
  app type laneConnectionType_laneConnectionType_App: category=VALUE, compu {0=split, 1=merge, 2=continueLeft, 3=continueRight, 4=start, 5=end}
  impl type laneConnectionType_laneConnectionType: implementation-data-type=UInt32, compu {0=split, 1=merge, 2=continueLeft, 3=continueRight, 4=start, 5=end}
  data type mapping set DM_laneConnectionType_laneConnectionType: data-type-map{application-data-type=laneConnectionType_laneConnectionType_App, implementation-data-type=laneConnectionType_laneConnectionType}
  compu method CM_laneConnectivityElementType_laneConnectivityElementType: 0=normalLane, 1=entryLane, 2=exitLane, 3=exitAndEntryLane, 4=exitOrEntryLane
  app type laneConnectivityElementType_laneConnectivityElementType_App: category=VALUE, compu-method=CM_laneConnectivityElementType_laneConnectivityElementType
  impl type laneConnectivityElementType_laneConnectivityElementType: implementation-data-type=UInt32, compu-method=CM_laneConnectivityElementType_laneConnectivityElementType
  data type mapping set DM_laneConnectivityElementType_laneConnectivityElementType: data-type-map{application-data-type=laneConnectivityElementType_laneConnectivityElementType_App, implementation-data-type=laneConnectivityElementType_laneConnectivityElementType}
  app type laneGroupAssociationType_laneGroupAssociationType_App: category=VALUE, compu {0=sameDirection, 1=oppositeDirection, 2=intersection}
  impl type laneGroupAssociationType_laneGroupAssociationType: implementation-data-type=UInt32, compu {0=sameDirection, 1=oppositeDirection, 2=intersection}
  data type mapping set DM_laneGroupAssociationType_laneGroupAssociationType: data-type-map{application-data-type=laneGroupAssociationType_laneGroupAssociationType_App, implementation-data-type=laneGroupAssociationType_laneGroupAssociationType}
  app type timezoneInformationType_timezoneInformationType_App: category=VALUE, compu {0=currentPosition}
  impl type timezoneInformationType_timezoneInformationType: implementation-data-type=UInt32, compu {0=currentPosition}
  data type mapping set DM_timezoneInformationType_timezoneInformationType: data-type-map{application-data-type=timezoneInformationType_timezoneInformationType_App, implementation-data-type=timezoneInformationType_timezoneInformationType}
  app type landmarkObjectMarkerType_landmarkObjectMarkerType_App: category=VALUE, compu {0=qr}
  impl type landmarkObjectMarkerType_landmarkObjectMarkerType: implementation-data-type=UInt32, compu {0=qr}
  data type mapping set DM_landmarkObjectMarkerType_landmarkObjectMarkerType: data-type-map{application-data-type=landmarkObjectMarkerType_landmarkObjectMarkerType_App, implementation-data-type=landmarkObjectMarkerType_landmarkObjectMarkerType}
  app type landmarkObjectType_landmarkObjectType_App: category=VALUE, compu {0=sign, 1=pole, 2=marking, 4=other}
  impl type landmarkObjectType_landmarkObjectType: implementation-data-type=UInt32, compu {0=sign, 1=pole, 2=marking, 4=other}
  data type mapping set DM_landmarkObjectType_landmarkObjectType: data-type-map{application-data-type=landmarkObjectType_landmarkObjectType_App, implementation-data-type=landmarkObjectType_landmarkObjectType}
  compu method CM_landmarkObjectMarkingType_landmarkObjectMarkingType: 0=text, 1=arrowStraight, 2=arrowLeft, 3=arrowRight, 4=arrowStraightAndLeft, 5=arrowStraightAndRight, 6=arrowLeftAndRight, 7=lineElement, 8=lineContinuous, 9=stoppingLine, 16=crosswalk, 17=sign
  app type landmarkObjectMarkingType_landmarkObjectMarkingType_App: category=VALUE, compu-method=CM_landmarkObjectMarkingType_landmarkObjectMarkingType
  impl type landmarkObjectMarkingType_landmarkObjectMarkingType: implementation-data-type=UInt32, compu-method=CM_landmarkObjectMarkingType_landmarkObjectMarkingType
  data type mapping set DM_landmarkObjectMarkingType_landmarkObjectMarkingType: data-type-map{application-data-type=landmarkObjectMarkingType_landmarkObjectMarkingType_App, implementation-data-type=landmarkObjectMarkingType_landmarkObjectMarkingType}
  compu method CM_landmarkObjectPoleType_landmarkObjectPoleType: 0=guardrailPost, 1=lightPole, 3=reflectorPost, 2=delineatorPost, 4=gantryPole, 5=signPost, 6=other, 7=unclassified
  app type landmarkObjectPoleType_landmarkObjectPoleType_App: category=VALUE, compu-method=CM_landmarkObjectPoleType_landmarkObjectPoleType
  impl type landmarkObjectPoleType_landmarkObjectPoleType: implementation-data-type=UInt32, compu-method=CM_landmarkObjectPoleType_landmarkObjectPoleType
  data type mapping set DM_landmarkObjectPoleType_landmarkObjectPoleType: data-type-map{application-data-type=landmarkObjectPoleType_landmarkObjectPoleType_App, implementation-data-type=landmarkObjectPoleType_landmarkObjectPoleType}
  compu method CM_landmarkObjectSignShape_landmarkObjectSignShape: 0=triangle, 1=rectangle, 2=round, 3=octagon, 4=diamond, 5=crossBuck, 6=yield, 9=unknown
  app type landmarkObjectSignShape_landmarkObjectSignShape_App: category=VALUE, compu-method=CM_landmarkObjectSignShape_landmarkObjectSignShape
  impl type landmarkObjectSignShape_landmarkObjectSignShape: implementation-data-type=UInt32, compu-method=CM_landmarkObjectSignShape_landmarkObjectSignShape
  data type mapping set DM_landmarkObjectSignShape_landmarkObjectSignShape: data-type-map{application-data-type=landmarkObjectSignShape_landmarkObjectSignShape_App, implementation-data-type=landmarkObjectSignShape_landmarkObjectSignShape}
  compu method CM_landmarkObjectMarkingColor_laneMarkingColor: 0=white, 1=lightGray, 2=gray, 3=darkGray, 4=black, 5=red, 6=yellow, 7=green, 8=cyan, 9=blue, 10=orange, 15=unknown
  app type landmarkObjectMarkingColor_laneMarkingColor_App: category=VALUE, compu-method=CM_landmarkObjectMarkingColor_laneMarkingColor
  impl type landmarkObjectMarkingColor_laneMarkingColor: implementation-data-type=UInt32, compu-method=CM_landmarkObjectMarkingColor_laneMarkingColor
  data type mapping set DM_landmarkObjectMarkingColor_laneMarkingColor: data-type-map{application-data-type=landmarkObjectMarkingColor_laneMarkingColor_App, implementation-data-type=landmarkObjectMarkingColor_laneMarkingColor}
  app type warningSign_warningSign_App: category=VALUE, compu {0=generalHazard, 1=toBeFilledFromNDS}
  impl type warningSign_warningSign: implementation-data-type=UInt32, compu {0=generalHazard, 1=toBeFilledFromNDS}
  data type mapping set DM_warningSign_warningSign: data-type-map{application-data-type=warningSign_warningSign_App, implementation-data-type=warningSign_warningSign}
  compu method CM_parkingSectionType_parkingSectionType: 0=parkingLevel, 1=rentalZone, 2=valetParking, 3=customerParking, 4=transitionZone, 5=dropoffZone, 6=pickupZone, 7=dropoffPickupZone
  app type parkingSectionType_parkingSectionType_App: category=VALUE, compu-method=CM_parkingSectionType_parkingSectionType
  impl type parkingSectionType_parkingSectionType: implementation-data-type=UInt32, compu-method=CM_parkingSectionType_parkingSectionType
  data type mapping set DM_parkingSectionType_parkingSectionType: data-type-map{application-data-type=parkingSectionType_parkingSectionType_App, implementation-data-type=parkingSectionType_parkingSectionType}
  compu method CM_parkingFacilityType_parkingFacilityType: 0=unknownParkingType, 1=openParkingSpace, 2=multiStoreyCarPark, 3=undergroundParking
  app type parkingFacilityType_parkingFacilityType_App: category=VALUE, compu-method=CM_parkingFacilityType_parkingFacilityType
  impl type parkingFacilityType_parkingFacilityType: implementation-data-type=UInt32, compu-method=CM_parkingFacilityType_parkingFacilityType
  data type mapping set DM_parkingFacilityType_parkingFacilityType: data-type-map{application-data-type=parkingFacilityType_parkingFacilityType_App, implementation-data-type=parkingFacilityType_parkingFacilityType}
  app type parkingAreaType_parkingAreaType_App: category=VALUE, compu {0=drivable, 1=undesireable, 2=nonDrivable}
  impl type parkingAreaType_parkingAreaType: implementation-data-type=UInt32, compu {0=drivable, 1=undesireable, 2=nonDrivable}
  data type mapping set DM_parkingAreaType_parkingAreaType: data-type-map{application-data-type=parkingAreaType_parkingAreaType_App, implementation-data-type=parkingAreaType_parkingAreaType}
