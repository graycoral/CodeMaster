AUTOSAR XML (schema 00043)
package /vwg/applications/ICAS1
  adaptive application sw component type ICAS1_Provider
    provide port Positioning_PPort: provided-interface=Positioning
