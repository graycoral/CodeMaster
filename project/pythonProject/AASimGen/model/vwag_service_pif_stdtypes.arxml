AUTOSAR XML (schema 00043)
standard types defined: Boolean, UInt8, UInt16, UInt32, UInt64, Float, Double
package /vwg/services/pif/datatypes
  app type OperationStatus_ADT: category=VALUE, compu-method=OperationStatus_CM
  impl type OperationStatus: implementation-data-type=UInt16, compu-method=OperationStatus_CM
  data type mapping set OperationStatus_DTM: data-type-map{application-data-type=OperationStatus_ADT, implementation-data-type=OperationStatus}
  compu method OperationStatus_CM: -2=operation_timeout, -1=protocol_error, 0=successful, 202=accepted, 300=multiple_choice, 304=not_modified, 401=unauthorized, 403=forbidden, 404=not_found, 408=request_time_out, 409=conflict, 414=request_too_large, 429=too_many_requests, 431=request_header_fields_too_large, 451=unavailable_for_legal_reasons, 500=internal_server_error, 503=service_unavailable, 504=gateway_time_out, 511=network_authentication_required
  app type SubscriptionStatus_ADT: category=VALUE, compu-method=SubscriptionStatus_CM
  impl type SubscriptionStatus: implementation-data-type=UInt16, compu-method=SubscriptionStatus_CM
  data type mapping set SubscriptionStatus_DTM: data-type-map{application-data-type=SubscriptionStatus_ADT, implementation-data-type=SubscriptionStatus}
  compu method SubscriptionStatus_CM: -2=subscription_timeout, -1=subscription_error, 0=accepted, 1=running, 2=cancelled, 3=target_deleted
  22 x impl type:
    Status: category=VALUE, base-type=std_int8_t
    Int8: category=VALUE, base-type=std_int8_t
    Int16: category=VALUE, base-type=std_int16_t
    Int32: category=VALUE, base-type=std_int32_t
    Int64: category=VALUE, base-type=std_int64_t
    UUID: category=ARRAY
      element UUID_byte: array-size=16, array-size-semantics=FIXED-SIZE, implementation-data-type=UInt8
    String: category=STRING, base-type=std_uint8_t
    ServiceIdentifier: category=STRING, base-type=std_uint8_t
    InstanceIdentifier: category=STRING, base-type=std_uint8_t
    ResourceIdentifier: category=STRING, base-type=std_uint8_t
    ByteArray: category=VECTOR
      element Dim1Element: implementation-data-type=UInt8
    UInt8Vector: category=VECTOR, dynamic-array-size-profile=VSA_LINEAR
      element subElement: implementation-data-type=UInt8
    UInt16Vector: category=VECTOR, dynamic-array-size-profile=VSA_LINEAR
      element subElement: implementation-data-type=UInt16
    UInt32Vector: category=VECTOR, dynamic-array-size-profile=VSA_LINEAR
      element subElement: implementation-data-type=UInt32
    UInt64Vector: category=VECTOR, dynamic-array-size-profile=VSA_LINEAR
      element subElement: implementation-data-type=UInt64
    Int8Vector: category=VECTOR, dynamic-array-size-profile=VSA_LINEAR
      element subElement: implementation-data-type=Int8
    Int16Vector: category=VECTOR, dynamic-array-size-profile=VSA_LINEAR
      element subElement: implementation-data-type=Int16
    Int32Vector: category=VECTOR, dynamic-array-size-profile=VSA_LINEAR
      element subElement: implementation-data-type=Int32
    Int64Vector: category=VECTOR, dynamic-array-size-profile=VSA_LINEAR
      element subElement: implementation-data-type=Int64
    FloatVector: category=VECTOR, dynamic-array-size-profile=VSA_LINEAR
      element subElement: implementation-data-type=Float
    DoubleVector: category=VECTOR, dynamic-array-size-profile=VSA_LINEAR
      element subElement: implementation-data-type=Double
    UUIDVector: category=VECTOR, dynamic-array-size-profile=VSA_LINEAR
      element subElement: implementation-data-type=UUID
