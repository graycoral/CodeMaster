AUTOSAR XML (schema 00043)
package /vwg/stdtypes
  impl type DT_uuid: category=ARRAY
    element DT_uuid_elementsImpl: array-size=16, array-size-semantics=FIXED-SIZE, implementation-data-type=UInt8
