AUTOSAR XML (schema 00043)
package /vwg/services/Positioning
  service interface Positioning: service-interface-sub-element=opt-impl-record-elements=[{root-autosar-data-prototype=positions, context-data-prototype=DT_positions_vector/subElement, target-data-prototype=posType}, {root-autosar-data-prototype=positions, context-data-prototype=DT_positions_vector/subElement, target-data-prototype=messageCounter}, {root-autosar-data-prototype=positions, context-data-prototype=DT_positions_vector/subElement, target-data-prototype=latitude}, {root-autosar-data-prototype=positions, context-data-prototype=DT_positions_vector/subElement, target-data-prototype=longitude}, {root-autosar-data-prototype=positions, context-data-prototype=DT_positions_vector/subElement, target-data-prototype=altitudeMeanSeaLevel}, {root-autosar-data-prototype=positions, context-data-prototype=DT_positions_vector/subElement, target-data-prototype=altitudeWGS84}, {root-autosar-data-prototype=positions, context-data-prototype=DT_positions_vector/subElement, target-data-prototype=headingVelocityDirection}, {root-autosar-data-prototype=positions, context-data-prototype=DT_positions_vector/subElement, target-data-prototype=headingYawAngle}, {root-autosar-data-prototype=positions, context-data-prototype=DT_positions_vector/subElement, target-data-prototype=accuracyHeadingVelocityDirection}, {root-autosar-data-prototype=positions, context-data-prototype=DT_positions_vector/subElement, target-data-prototype=accuracyHeadingYawAngle}, {root-autosar-data-prototype=positions, context-data-prototype=DT_positions_vector/subElement, target-data-prototype=speed3D}, {root-autosar-data-prototype=positions, context-data-prototype=DT_positions_vector/subElement, target-data-prototype=speed2D}, {root-autosar-data-prototype=positions, context-data-prototype=DT_positions_vector/subElement, target-data-prototype=velocityNorthDirection}, {root-autosar-data-prototype=positions, context-data-prototype=DT_positions_vector/subElement, target-data-prototype=velocityEastDirection}, {root-autosar-data-prototype=positions, context-data-prototype=DT_positions_vector/subElement, target-data-prototype=velocityUpwardDirection}, {root-autosar-data-prototype=positions, context-data-prototype=DT_positions_vector/subElement, target-data-prototype=accuracySpeed3D}, {root-autosar-data-prototype=positions, context-data-prototype=DT_positions_vector/subElement, target-data-prototype=accuracySpeed2D}, {root-autosar-data-prototype=positions, context-data-prototype=DT_positions_vector/subElement, target-data-prototype=accuracyHorizontal}, {root-autosar-data-prototype=positions, context-data-prototype=DT_positions_vector/subElement, target-data-prototype=accuracyEllipseSemiMajorAxis}, {root-autosar-data-prototype=positions, context-data-prototype=DT_positions_vector/subElement, target-data-prototype=accuracyEllipseSemiMajorAxisHeading}, {root-autosar-data-prototype=positions, context-data-prototype=DT_positions_vector/subElement, target-data-prototype=accuracyEllipseSemiMinorAxis}, {root-autosar-data-prototype=positions, context-data-prototype=DT_positions_vector/subElement, target-data-prototype=accuracyVertical}, {root-autosar-data-prototype=positions, context-data-prototype=DT_positions_vector/subElement, target-data-prototype=accuracyPitchAngle}, {root-autosar-data-prototype=positions, context-data-prototype=DT_positions_vector/subElement, target-data-prototype=accuracyRollAngle}, {root-autosar-data-prototype=positions, context-data-prototype=DT_positions_vector/subElement, target-data-prototype=pitchAngle}, {root-autosar-data-prototype=positions, context-data-prototype=DT_positions_vector/subElement, target-data-prototype=rollAngle}, {root-autosar-data-prototype=positions, context-data-prototype=DT_positions_vector/subElement, target-data-prototype=drivingDirection}, {root-autosar-data-prototype=positions, context-data-prototype=DT_positions_vector/subElement, target-data-prototype=statusFrontCamera}, {root-autosar-data-prototype=positions, context-data-prototype=DT_positions_vector/subElement, target-data-prototype=statusGNSS}, {root-autosar-data-prototype=positions, context-data-prototype=DT_positions_vector/subElement, target-data-prototype=statusLandmarks}, {root-autosar-data-prototype=positions, context-data-prototype=DT_positions_vector/subElement, target-data-prototype=statusTopView}, {root-autosar-data-prototype=positions, context-data-prototype=DT_positions_vector/subElement, target-data-prototype=statusLidar}, {root-autosar-data-prototype=positions, context-data-prototype=DT_positions_vector/subElement, target-data-prototype=statusSystem}, {root-autosar-data-prototype=positions, context-data-prototype=DT_positions_vector/subElement, target-data-prototype=latency}, {root-autosar-data-prototype=positions, context-data-prototype=DT_positions_vector/subElement, target-data-prototype=DT_positions_struct/preciseLocalTimeSeconds}, {root-autosar-data-prototype=positions, context-data-prototype=DT_positions_vector/subElement, target-data-prototype=DT_positions_struct/preciseLocalTimeNanoseconds}, {root-autosar-data-prototype=posMapInfo, context-data-prototype=DT_posMapInfo_vector/subElement, target-data-prototype=elementId}, {root-autosar-data-prototype=posMapInfo, context-data-prototype=DT_posMapInfo_vector/subElement, target-data-prototype=accuracyIsLaneAccurate}, {root-autosar-data-prototype=posMapInfo, context-data-prototype=DT_posMapInfo_vector/subElement, target-data-prototype=numberOfLanes}, {root-autosar-data-prototype=posMapInfo, context-data-prototype=DT_posMapInfo_vector/subElement, target-data-prototype=laneNumber}, {root-autosar-data-prototype=posMapInfo, context-data-prototype=DT_posMapInfo_vector/subElement, target-data-prototype=linkId}, {root-autosar-data-prototype=posMapInfo, context-data-prototype=DT_posMapInfo_vector/subElement, target-data-prototype=distanceOnLink}, {root-autosar-data-prototype=posMapInfo, context-data-prototype=DT_posMapInfo_vector/subElement, target-data-prototype=offsetOnLane}, {root-autosar-data-prototype=posMapInfo, context-data-prototype=DT_posMapInfo_vector/subElement, target-data-prototype=laneId}, {root-autosar-data-prototype=posMapInfo, context-data-prototype=DT_posMapInfo_vector/subElement, target-data-prototype=laneGroupId}, {root-autosar-data-prototype=posMapInfo, context-data-prototype=DT_posMapInfo_vector/subElement, target-data-prototype=tileId}, {root-autosar-data-prototype=posMapInfo, context-data-prototype=DT_posMapInfo_vector/subElement, target-data-prototype=updateRegionId}, {root-autosar-data-prototype=posMapInfo, context-data-prototype=DT_posMapInfo_vector/subElement, target-data-prototype=productId}, {root-autosar-data-prototype=posMapInfo, context-data-prototype=DT_posMapInfo_vector/subElement, target-data-prototype=distanceLeftMarking}, {root-autosar-data-prototype=posMapInfo, context-data-prototype=DT_posMapInfo_vector/subElement, target-data-prototype=distanceRightMarking}, {root-autosar-data-prototype=posMapInfo, context-data-prototype=DT_posMapInfo_vector/subElement, target-data-prototype=locationIsCarTrain}, {root-autosar-data-prototype=posMapInfo, context-data-prototype=DT_posMapInfo_vector/subElement, target-data-prototype=locationIsFerry}, {root-autosar-data-prototype=posMapInfo, context-data-prototype=DT_posMapInfo_vector/subElement, target-data-prototype=locationIsParkingStructure}, {root-autosar-data-prototype=posMapInfo, context-data-prototype=DT_posMapInfo_vector/subElement, target-data-prototype=locationIsParkingArea}, {root-autosar-data-prototype=posMapInfo, context-data-prototype=DT_posMapInfo_vector/subElement, target-data-prototype=offRoadStatus}, {root-autosar-data-prototype=posMapInfo, context-data-prototype=DT_posMapInfo_vector/subElement, target-data-prototype=gradient}, {root-autosar-data-prototype=posMapInfo, context-data-prototype=DT_posMapInfo_vector/subElement, target-data-prototype=slope}, {root-autosar-data-prototype=posMapInfo, context-data-prototype=DT_posMapInfo_vector/subElement, target-data-prototype=trafficDirection}, {root-autosar-data-prototype=posMapInfo, context-data-prototype=DT_posMapInfo_vector/subElement, target-data-prototype=laneType}, {root-autosar-data-prototype=posMapInfo, context-data-prototype=DT_posMapInfo_vector/subElement, target-data-prototype=isMotorwayRoad}, {root-autosar-data-prototype=posMapInfo, context-data-prototype=DT_posMapInfo_vector/subElement, target-data-prototype=isUrbanRoad}, {root-autosar-data-prototype=posMapInfo, context-data-prototype=DT_posMapInfo_vector/subElement, target-data-prototype=mapMatchingSource}, {root-autosar-data-prototype=posMapInfo, context-data-prototype=DT_posMapInfo_vector/subElement, target-data-prototype=DT_posMapInfo_struct/preciseLocalTimeSeconds}, {root-autosar-data-prototype=posMapInfo, context-data-prototype=DT_posMapInfo_vector/subElement, target-data-prototype=DT_posMapInfo_struct/preciseLocalTimeNanoseconds}]
    field positions: type=DT_positions_vector, has-getter=true, has-notifier=true, has-setter=false
    field posMapInfo: type=DT_posMapInfo_vector, has-getter=true, has-notifier=true, has-setter=false
package /vwg/services/Positioning/datatypes
  4 x impl type:
    DT_positions_struct: category=STRUCTURE
      36 x element, all with category=TYPE_REFERENCE:
        posType: implementation-data-type=DT_Positioning_positions_posType
        messageCounter: implementation-data-type=UInt32
        latitude: implementation-data-type=Double
        longitude: implementation-data-type=Double
        altitudeMeanSeaLevel: implementation-data-type=Float
        altitudeWGS84: implementation-data-type=Float
        headingVelocityDirection: implementation-data-type=Float
        headingYawAngle: implementation-data-type=Float
        accuracyHeadingVelocityDirection: implementation-data-type=Float
        accuracyHeadingYawAngle: implementation-data-type=Float
        speed3D: implementation-data-type=Float
        speed2D: implementation-data-type=Float
        velocityNorthDirection: implementation-data-type=Float
        velocityEastDirection: implementation-data-type=Float
        velocityUpwardDirection: implementation-data-type=Float
        accuracySpeed3D: implementation-data-type=Float
        accuracySpeed2D: implementation-data-type=Float
        accuracyHorizontal: implementation-data-type=Float
        accuracyEllipseSemiMajorAxis: implementation-data-type=Float
        accuracyEllipseSemiMajorAxisHeading: implementation-data-type=Float
        accuracyEllipseSemiMinorAxis: implementation-data-type=Float
        accuracyVertical: implementation-data-type=Float
        accuracyPitchAngle: implementation-data-type=Float
        accuracyRollAngle: implementation-data-type=Float
        pitchAngle: implementation-data-type=Float
        rollAngle: implementation-data-type=Float
        drivingDirection: implementation-data-type=UInt32
        statusFrontCamera: implementation-data-type=DT_Positioning_positions_statusFrontCamera
        statusGNSS: implementation-data-type=DT_Positioning_positions_statusGNSS
        statusLandmarks: implementation-data-type=DT_Positioning_positions_statusLandmarks
        statusTopView: implementation-data-type=DT_Positioning_positions_statusTopView
        statusLidar: implementation-data-type=DT_Positioning_positions_statusLidar
        statusSystem: implementation-data-type=Int32
        latency: implementation-data-type=UInt32
        preciseLocalTimeSeconds: implementation-data-type=UInt32
        preciseLocalTimeNanoseconds: implementation-data-type=UInt32
    DT_posMapInfo_struct: category=STRUCTURE
      28 x element, all with category=TYPE_REFERENCE:
        elementId: implementation-data-type=UInt32
        accuracyIsLaneAccurate: implementation-data-type=Boolean
        numberOfLanes: implementation-data-type=UInt32
        laneNumber: implementation-data-type=UInt32
        linkId: implementation-data-type=UInt32
        distanceOnLink: implementation-data-type=Float
        offsetOnLane: implementation-data-type=Float
        laneId: implementation-data-type=UInt32
        laneGroupId: implementation-data-type=UInt32
        tileId: implementation-data-type=UInt32
        updateRegionId: implementation-data-type=UInt32
        productId: implementation-data-type=UInt32
        distanceLeftMarking: implementation-data-type=Float
        distanceRightMarking: implementation-data-type=Float
        locationIsCarTrain: implementation-data-type=Boolean
        locationIsFerry: implementation-data-type=Boolean
        locationIsParkingStructure: implementation-data-type=Boolean
        locationIsParkingArea: implementation-data-type=Boolean
        offRoadStatus: implementation-data-type=DT_Positioning_posMapInfo_offRoadStatus
        gradient: implementation-data-type=DT_Positioning_posMapInfo_gradient
        slope: implementation-data-type=Float
        trafficDirection: implementation-data-type=DT_Positioning_posMapInfo_trafficDirection
        laneType: implementation-data-type=DT_Positioning_posMapInfo_laneType
        isMotorwayRoad: implementation-data-type=Boolean
        isUrbanRoad: implementation-data-type=Boolean
        mapMatchingSource: implementation-data-type=DT_Positioning_posMapInfo_mapMatchingSource
        preciseLocalTimeSeconds: implementation-data-type=UInt32
        preciseLocalTimeNanoseconds: implementation-data-type=UInt32
    DT_positions_vector: category=VECTOR, dynamic-array-size-profile=VSA_LINEAR
      element subElement: implementation-data-type=DT_positions_struct
    DT_posMapInfo_vector: category=VECTOR, dynamic-array-size-profile=VSA_LINEAR
      element subElement: implementation-data-type=DT_posMapInfo_struct
  app type DT_Positioning_positions_posType_App: category=VALUE, compu {1=DeadReckoning, 2=MapMatched, 3=Static}
  impl type DT_Positioning_positions_posType: implementation-data-type=UInt32, compu {1=DeadReckoning, 2=MapMatched, 3=Static}
  data type mapping set DM_DT_Positioning_positions_posType: data-type-map{application-data-type=DT_Positioning_positions_posType_App, implementation-data-type=DT_Positioning_positions_posType}
  app type DT_Positioning_positions_statusFrontCamera_App: category=VALUE, compu {0=Init, 1=InUse, 2=NotUsed, 3=Error}
  impl type DT_Positioning_positions_statusFrontCamera: implementation-data-type=UInt32, compu {0=Init, 1=InUse, 2=NotUsed, 3=Error}
  data type mapping set DM_DT_Positioning_positions_statusFrontCamera: data-type-map{application-data-type=DT_Positioning_positions_statusFrontCamera_App, implementation-data-type=DT_Positioning_positions_statusFrontCamera}
  app type DT_Positioning_positions_statusGNSS_App: category=VALUE, compu {0=Init, 1=InUse, 2=NotUsed, 3=Error}
  impl type DT_Positioning_positions_statusGNSS: implementation-data-type=UInt32, compu {0=Init, 1=InUse, 2=NotUsed, 3=Error}
  data type mapping set DM_DT_Positioning_positions_statusGNSS: data-type-map{application-data-type=DT_Positioning_positions_statusGNSS_App, implementation-data-type=DT_Positioning_positions_statusGNSS}
  app type DT_Positioning_positions_statusLandmarks_App: category=VALUE, compu {0=Init, 1=InUse, 2=NotUsed, 3=Error}
  impl type DT_Positioning_positions_statusLandmarks: implementation-data-type=UInt32, compu {0=Init, 1=InUse, 2=NotUsed, 3=Error}
  data type mapping set DM_DT_Positioning_positions_statusLandmarks: data-type-map{application-data-type=DT_Positioning_positions_statusLandmarks_App, implementation-data-type=DT_Positioning_positions_statusLandmarks}
  app type DT_Positioning_positions_statusTopView_App: category=VALUE, compu {0=Init, 1=InUse, 2=NotUsed, 3=Error}
  impl type DT_Positioning_positions_statusTopView: implementation-data-type=UInt32, compu {0=Init, 1=InUse, 2=NotUsed, 3=Error}
  data type mapping set DM_DT_Positioning_positions_statusTopView: data-type-map{application-data-type=DT_Positioning_positions_statusTopView_App, implementation-data-type=DT_Positioning_positions_statusTopView}
  app type DT_Positioning_positions_statusLidar_App: category=VALUE, compu {0=Init, 1=InUse, 2=NotUsed, 3=Error}
  impl type DT_Positioning_positions_statusLidar: implementation-data-type=UInt32, compu {0=Init, 1=InUse, 2=NotUsed, 3=Error}
  data type mapping set DM_DT_Positioning_positions_statusLidar: data-type-map{application-data-type=DT_Positioning_positions_statusLidar_App, implementation-data-type=DT_Positioning_positions_statusLidar}
  app type DT_Positioning_posMapInfo_offRoadStatus_App: category=VALUE, compu {0=Init, 1=OnRoad, 2=OffRoad, 3=Unknown, 7=Error}
  impl type DT_Positioning_posMapInfo_offRoadStatus: implementation-data-type=UInt32, compu {0=Init, 1=OnRoad, 2=OffRoad, 3=Unknown, 7=Error}
  data type mapping set DM_DT_Positioning_posMapInfo_offRoadStatus: data-type-map{application-data-type=DT_Positioning_posMapInfo_offRoadStatus_App, implementation-data-type=DT_Positioning_posMapInfo_offRoadStatus}
  app type DT_Positioning_posMapInfo_gradient_App: category=VALUE, compu {0=Init, 1=Up, 2=Level, 3=Down, 4=Unknown, 7=Error}
  impl type DT_Positioning_posMapInfo_gradient: implementation-data-type=UInt32, compu {0=Init, 1=Up, 2=Level, 3=Down, 4=Unknown, 7=Error}
  data type mapping set DM_DT_Positioning_posMapInfo_gradient: data-type-map{application-data-type=DT_Positioning_posMapInfo_gradient_App, implementation-data-type=DT_Positioning_posMapInfo_gradient}
  compu method CM_DT_Positioning_posMapInfo_trafficDirection: 0=Init, 1=LeftHandTraffic, 2=RightHandTraffic, 3=OffRoad, 4=Unknown, 7=Error
  app type DT_Positioning_posMapInfo_trafficDirection_App: category=VALUE, compu-method=CM_DT_Positioning_posMapInfo_trafficDirection
  impl type DT_Positioning_posMapInfo_trafficDirection: implementation-data-type=UInt32, compu-method=CM_DT_Positioning_posMapInfo_trafficDirection
  data type mapping set DM_DT_Positioning_posMapInfo_trafficDirection: data-type-map{application-data-type=DT_Positioning_posMapInfo_trafficDirection_App, implementation-data-type=DT_Positioning_posMapInfo_trafficDirection}
  compu method CM_DT_Positioning_posMapInfo_laneType: 0=Init, 1=Other, 2=Unknown, 3=Error, 4=EntryLane, 5=ExitLane, 6=DrivingLane, 7=EmergencyLane, 8=EntryAndExitLane, 9=EntryOrExitLane
  app type DT_Positioning_posMapInfo_laneType_App: category=VALUE, compu-method=CM_DT_Positioning_posMapInfo_laneType
  impl type DT_Positioning_posMapInfo_laneType: implementation-data-type=UInt32, compu-method=CM_DT_Positioning_posMapInfo_laneType
  data type mapping set DM_DT_Positioning_posMapInfo_laneType: data-type-map{application-data-type=DT_Positioning_posMapInfo_laneType_App, implementation-data-type=DT_Positioning_posMapInfo_laneType}
  app type DT_Positioning_posMapInfo_mapMatchingSource_App: category=VALUE, compu {0=Init, 1=Basic, 2=SDLane, 3=HDLane, 4=NotUsed, 5=Error}
  impl type DT_Positioning_posMapInfo_mapMatchingSource: implementation-data-type=UInt32, compu {0=Init, 1=Basic, 2=SDLane, 3=HDLane, 4=NotUsed, 5=Error}
  data type mapping set DM_DT_Positioning_posMapInfo_mapMatchingSource: data-type-map{application-data-type=DT_Positioning_posMapInfo_mapMatchingSource_App, implementation-data-type=DT_Positioning_posMapInfo_mapMatchingSource}
