AUTOSAR XML (schema 00043)
package /vwg
  mode declaration group MachineStates: initial-mode=Startup
    mode Startup: value=0
package /vwg/applications
  machine ICAS1Machine: service-discover-configs=someip-service-discovery={multicast-sd-ip-address=mySDNetworkEndpoint_1, someip-service-discovery-port=30490}
    ethernet communication connector myCommunicationConnector1: unicast-network-endpoint=myNetworkEndpoint_1
    ethernet communication connector myCommunicationConnector2: unicast-network-endpoint=myNetworkEndpoint_2
    machine-mode-machines:
      mode declaration group prototype ICAS1MachineMode: type=MachineStates
  mode declaration group ApplicationStates: initial-mode=Running
    mode Running: value=0
    mode Terminating: value=1
