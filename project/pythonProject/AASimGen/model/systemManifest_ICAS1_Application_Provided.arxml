AUTOSAR XML (schema 00043)
package /vwg/applications/ICAS1/mapping
  service instance to port prototype mapping PortMappingProvidedPositioning_Someip: port-prototype=Basis__ICAS3_Sys_IVI_01.Positioning_PPort, process=ICAS1_Provider_Process, service-instance=Positioning_ProvidedSomeipServiceInstance
  someip service instance to machine mapping Positioning_Provided_ServiceInstance_toMachine: communication-connector=myCommunicationConnector1, service-instance=Positioning_ProvidedSomeipServiceInstance, udp-port=42813
package /vwg/applications/ICAS1/instance
  provided someip service instance Positioning_ProvidedSomeipServiceInstance: service-interface=Positioning_Someip, sd-server-config={initial-offer-behavior={initial-delay-max-value=0, initial-delay-min-value=0, initial-repetitions-base-delay=0.1, initial-repetitions-max=3}, offer-cyclic-delay=1, request-response-delay={max-value=0, min-value=0}, service-offer-time-to-live=3}, service-instance-id=1
    someip provided event group positions__EventGroup: event-group=positions_EventGroup
    someip provided event group posMapInfo__EventGroup: event-group=posMapInfo_EventGroup
  someip data prototype transformation props Positioning_TLV
    data-prototypes:
      {data-prototype=Positioning_PPort.positions, element-in-impl-datatype={root-data-prototype=positions, target-data-prototype=posType}, tlv-data-id=0}
      {data-prototype=Positioning_PPort.positions, element-in-impl-datatype={root-data-prototype=positions, target-data-prototype=messageCounter}, tlv-data-id=1}
      {data-prototype=Positioning_PPort.positions, element-in-impl-datatype={root-data-prototype=positions, target-data-prototype=latitude}, tlv-data-id=2}
      {data-prototype=Positioning_PPort.positions, element-in-impl-datatype={root-data-prototype=positions, target-data-prototype=longitude}, tlv-data-id=3}
      {data-prototype=Positioning_PPort.positions, element-in-impl-datatype={root-data-prototype=positions, target-data-prototype=altitudeMeanSeaLevel}, tlv-data-id=4}
      {data-prototype=Positioning_PPort.positions, element-in-impl-datatype={root-data-prototype=positions, target-data-prototype=altitudeWGS84}, tlv-data-id=5}
      {data-prototype=Positioning_PPort.positions, element-in-impl-datatype={root-data-prototype=positions, target-data-prototype=headingVelocityDirection}, tlv-data-id=6}
      {data-prototype=Positioning_PPort.positions, element-in-impl-datatype={root-data-prototype=positions, target-data-prototype=headingYawAngle}, tlv-data-id=7}
      {data-prototype=Positioning_PPort.positions, element-in-impl-datatype={root-data-prototype=positions, target-data-prototype=accuracyHeadingVelocityDirection}, tlv-data-id=8}
      {data-prototype=Positioning_PPort.positions, element-in-impl-datatype={root-data-prototype=positions, target-data-prototype=accuracyHeadingYawAngle}, tlv-data-id=9}
      {data-prototype=Positioning_PPort.positions, element-in-impl-datatype={root-data-prototype=positions, target-data-prototype=speed3D}, tlv-data-id=10}
      {data-prototype=Positioning_PPort.positions, element-in-impl-datatype={root-data-prototype=positions, target-data-prototype=speed2D}, tlv-data-id=11}
      {data-prototype=Positioning_PPort.positions, element-in-impl-datatype={root-data-prototype=positions, target-data-prototype=velocityNorthDirection}, tlv-data-id=12}
      {data-prototype=Positioning_PPort.positions, element-in-impl-datatype={root-data-prototype=positions, target-data-prototype=velocityEastDirection}, tlv-data-id=13}
      {data-prototype=Positioning_PPort.positions, element-in-impl-datatype={root-data-prototype=positions, target-data-prototype=velocityUpwardDirection}, tlv-data-id=14}
      {data-prototype=Positioning_PPort.positions, element-in-impl-datatype={root-data-prototype=positions, target-data-prototype=accuracySpeed3D}, tlv-data-id=15}
      {data-prototype=Positioning_PPort.positions, element-in-impl-datatype={root-data-prototype=positions, target-data-prototype=accuracySpeed2D}, tlv-data-id=16}
      {data-prototype=Positioning_PPort.positions, element-in-impl-datatype={root-data-prototype=positions, target-data-prototype=accuracyHorizontal}, tlv-data-id=17}
      {data-prototype=Positioning_PPort.positions, element-in-impl-datatype={root-data-prototype=positions, target-data-prototype=accuracyEllipseSemiMajorAxis}, tlv-data-id=18}
      {data-prototype=Positioning_PPort.positions, element-in-impl-datatype={root-data-prototype=positions, target-data-prototype=accuracyEllipseSemiMajorAxisHeading}, tlv-data-id=19}
      {data-prototype=Positioning_PPort.positions, element-in-impl-datatype={root-data-prototype=positions, target-data-prototype=accuracyEllipseSemiMinorAxis}, tlv-data-id=20}
      {data-prototype=Positioning_PPort.positions, element-in-impl-datatype={root-data-prototype=positions, target-data-prototype=accuracyVertical}, tlv-data-id=21}
      {data-prototype=Positioning_PPort.positions, element-in-impl-datatype={root-data-prototype=positions, target-data-prototype=accuracyPitchAngle}, tlv-data-id=22}
      {data-prototype=Positioning_PPort.positions, element-in-impl-datatype={root-data-prototype=positions, target-data-prototype=accuracyRollAngle}, tlv-data-id=23}
      {data-prototype=Positioning_PPort.positions, element-in-impl-datatype={root-data-prototype=positions, target-data-prototype=pitchAngle}, tlv-data-id=24}
      {data-prototype=Positioning_PPort.positions, element-in-impl-datatype={root-data-prototype=positions, target-data-prototype=rollAngle}, tlv-data-id=25}
      {data-prototype=Positioning_PPort.positions, element-in-impl-datatype={root-data-prototype=positions, target-data-prototype=drivingDirection}, tlv-data-id=26}
      {data-prototype=Positioning_PPort.positions, element-in-impl-datatype={root-data-prototype=positions, target-data-prototype=statusFrontCamera}, tlv-data-id=27}
      {data-prototype=Positioning_PPort.positions, element-in-impl-datatype={root-data-prototype=positions, target-data-prototype=statusGNSS}, tlv-data-id=28}
      {data-prototype=Positioning_PPort.positions, element-in-impl-datatype={root-data-prototype=positions, target-data-prototype=statusLandmarks}, tlv-data-id=29}
      {data-prototype=Positioning_PPort.positions, element-in-impl-datatype={root-data-prototype=positions, target-data-prototype=statusTopView}, tlv-data-id=30}
      {data-prototype=Positioning_PPort.positions, element-in-impl-datatype={root-data-prototype=positions, target-data-prototype=statusLidar}, tlv-data-id=31}
      {data-prototype=Positioning_PPort.positions, element-in-impl-datatype={root-data-prototype=positions, target-data-prototype=statusSystem}, tlv-data-id=32}
      {data-prototype=Positioning_PPort.positions, element-in-impl-datatype={root-data-prototype=positions, target-data-prototype=latency}, tlv-data-id=33}
      {data-prototype=Positioning_PPort.positions, element-in-impl-datatype={root-data-prototype=positions, target-data-prototype=preciseLocalTimeSeconds}, tlv-data-id=34}
      {data-prototype=Positioning_PPort.positions, element-in-impl-datatype={root-data-prototype=positions, target-data-prototype=preciseLocalTimeNanoseconds}, tlv-data-id=35}
      {data-prototype=Positioning_PPort.posMapInfo, element-in-impl-datatype={root-data-prototype=posMapInfo, target-data-prototype=elementId}, tlv-data-id=0}
      {data-prototype=Positioning_PPort.posMapInfo, element-in-impl-datatype={root-data-prototype=posMapInfo, target-data-prototype=accuracyIsLaneAccurate}, tlv-data-id=1}
      {data-prototype=Positioning_PPort.posMapInfo, element-in-impl-datatype={root-data-prototype=posMapInfo, target-data-prototype=numberOfLanes}, tlv-data-id=2}
      {data-prototype=Positioning_PPort.posMapInfo, element-in-impl-datatype={root-data-prototype=posMapInfo, target-data-prototype=laneNumber}, tlv-data-id=3}
      {data-prototype=Positioning_PPort.posMapInfo, element-in-impl-datatype={root-data-prototype=posMapInfo, target-data-prototype=linkId}, tlv-data-id=4}
      {data-prototype=Positioning_PPort.posMapInfo, element-in-impl-datatype={root-data-prototype=posMapInfo, target-data-prototype=distanceOnLink}, tlv-data-id=5}
      {data-prototype=Positioning_PPort.posMapInfo, element-in-impl-datatype={root-data-prototype=posMapInfo, target-data-prototype=offsetOnLane}, tlv-data-id=6}
      {data-prototype=Positioning_PPort.posMapInfo, element-in-impl-datatype={root-data-prototype=posMapInfo, target-data-prototype=laneId}, tlv-data-id=7}
      {data-prototype=Positioning_PPort.posMapInfo, element-in-impl-datatype={root-data-prototype=posMapInfo, target-data-prototype=laneGroupId}, tlv-data-id=8}
      {data-prototype=Positioning_PPort.posMapInfo, element-in-impl-datatype={root-data-prototype=posMapInfo, target-data-prototype=tileId}, tlv-data-id=9}
      {data-prototype=Positioning_PPort.posMapInfo, element-in-impl-datatype={root-data-prototype=posMapInfo, target-data-prototype=updateRegionId}, tlv-data-id=10}
      {data-prototype=Positioning_PPort.posMapInfo, element-in-impl-datatype={root-data-prototype=posMapInfo, target-data-prototype=productId}, tlv-data-id=11}
      {data-prototype=Positioning_PPort.posMapInfo, element-in-impl-datatype={root-data-prototype=posMapInfo, target-data-prototype=distanceLeftMarking}, tlv-data-id=12}
      {data-prototype=Positioning_PPort.posMapInfo, element-in-impl-datatype={root-data-prototype=posMapInfo, target-data-prototype=distanceRightMarking}, tlv-data-id=13}
      {data-prototype=Positioning_PPort.posMapInfo, element-in-impl-datatype={root-data-prototype=posMapInfo, target-data-prototype=locationIsCarTrain}, tlv-data-id=14}
      {data-prototype=Positioning_PPort.posMapInfo, element-in-impl-datatype={root-data-prototype=posMapInfo, target-data-prototype=locationIsFerry}, tlv-data-id=15}
      {data-prototype=Positioning_PPort.posMapInfo, element-in-impl-datatype={root-data-prototype=posMapInfo, target-data-prototype=locationIsParkingStructure}, tlv-data-id=16}
      {data-prototype=Positioning_PPort.posMapInfo, element-in-impl-datatype={root-data-prototype=posMapInfo, target-data-prototype=locationIsParkingArea}, tlv-data-id=17}
      {data-prototype=Positioning_PPort.posMapInfo, element-in-impl-datatype={root-data-prototype=posMapInfo, target-data-prototype=offRoadStatus}, tlv-data-id=18}
      {data-prototype=Positioning_PPort.posMapInfo, element-in-impl-datatype={root-data-prototype=posMapInfo, target-data-prototype=gradient}, tlv-data-id=19}
      {data-prototype=Positioning_PPort.posMapInfo, element-in-impl-datatype={root-data-prototype=posMapInfo, target-data-prototype=slope}, tlv-data-id=20}
      {data-prototype=Positioning_PPort.posMapInfo, element-in-impl-datatype={root-data-prototype=posMapInfo, target-data-prototype=trafficDirection}, tlv-data-id=21}
      {data-prototype=Positioning_PPort.posMapInfo, element-in-impl-datatype={root-data-prototype=posMapInfo, target-data-prototype=laneType}, tlv-data-id=22}
      {data-prototype=Positioning_PPort.posMapInfo, element-in-impl-datatype={root-data-prototype=posMapInfo, target-data-prototype=isMotorwayRoad}, tlv-data-id=23}
      {data-prototype=Positioning_PPort.posMapInfo, element-in-impl-datatype={root-data-prototype=posMapInfo, target-data-prototype=isUrbanRoad}, tlv-data-id=24}
      {data-prototype=Positioning_PPort.posMapInfo, element-in-impl-datatype={root-data-prototype=posMapInfo, target-data-prototype=mapMatchingSource}, tlv-data-id=25}
      {data-prototype=Positioning_PPort.posMapInfo, element-in-impl-datatype={root-data-prototype=posMapInfo, target-data-prototype=preciseLocalTimeSeconds}, tlv-data-id=26}
      {data-prototype=Positioning_PPort.posMapInfo, element-in-impl-datatype={root-data-prototype=posMapInfo, target-data-prototype=preciseLocalTimeNanoseconds}, tlv-data-id=27}
