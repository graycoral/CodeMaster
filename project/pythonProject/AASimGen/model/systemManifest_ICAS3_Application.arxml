AUTOSAR XML (schema 00043)
package /vwg
  mode declaration group MachineStates: initial-mode=Startup
    mode Startup: value=0
package /vwg/applications
  mode declaration group ApplicationStates: initial-mode=Running
    mode Running: value=0
    mode Terminating: value=1
  machine ICAS3Machine: service-discover-configs=someip-service-discovery={multicast-sd-ip-address=mySDNetworkEndpoint, someip-service-discovery-port=30490}
    ethernet communication connector myCommunicationConnector: unicast-network-endpoint=myNetworkEndpoint
    machine-mode-machines:
      mode declaration group prototype ICAS3MachineMode: type=MachineStates
package /vwg/applications/ICAS3/deployment
  23 x someip service interface deployment:
    Chassis_Someip: service-interface=Chassis, service-interface-id=24580, service-interface-version={major-version=3, minor-version=0}
      5 x someip field deployment:
        axes: field=axes
          get _getter: method-id=16400, transport-protocol=UDP
          notifier _notifier: event-id=49168, transport-protocol=UDP
        velocityInfo: field=velocityInfo
          get _getter: method-id=16416, transport-protocol=UDP
          notifier _notifier: event-id=49184, transport-protocol=UDP
        notifications: field=notifications
          get _getter: method-id=16432, transport-protocol=UDP
          notifier _notifier: event-id=49200, transport-protocol=UDP
        wheels: field=wheels
          get _getter: method-id=16448, transport-protocol=UDP
          notifier _notifier: event-id=49216, transport-protocol=UDP
        espSystemInfo: field=espSystemInfo
          get _getter: method-id=16464, transport-protocol=UDP
          notifier _notifier: event-id=49232, transport-protocol=UDP
      5 x someip event group:
        axes_EventGroup: event-group-id=49168, event=axes/_notifier
        velocityInfo_EventGroup: event-group-id=49184, event=velocityInfo/_notifier
        notifications_EventGroup: event-group-id=49200, event=notifications/_notifier
        wheels_EventGroup: event-group-id=49216, event=wheels/_notifier
        espSystemInfo_EventGroup: event-group-id=49232, event=espSystemInfo/_notifier
    ClampControl_Someip: service-interface=ClampControl, service-interface-id=24596, service-interface-version={major-version=3, minor-version=0}
      someip field deployment clamps: field=clamps
        get _getter: method-id=16400, transport-protocol=UDP
        notifier _notifier: event-id=49168, transport-protocol=UDP
      someip field deployment notifications: field=notifications
        get _getter: method-id=16416, transport-protocol=UDP
        notifier _notifier: event-id=49184, transport-protocol=UDP
      someip event group clamps_EventGroup: event-group-id=49168, event=clamps/_notifier
      someip event group notifications_EventGroup: event-group-id=49184, event=notifications/_notifier
    ClimateControl_Someip: service-interface=ClimateControl, service-interface-id=24601, service-interface-version={major-version=2, minor-version=0}
      someip field deployment notifications: field=notifications
        get _getter: method-id=16400, transport-protocol=UDP
        notifier _notifier: event-id=49168, transport-protocol=UDP
      someip field deployment status: field=status
        get _getter: method-id=16416, transport-protocol=UDP
        notifier _notifier: event-id=49184, transport-protocol=UDP
      someip field deployment consumptions: field=consumptions
        get _getter: method-id=16432, transport-protocol=UDP
        notifier _notifier: event-id=49200, transport-protocol=UDP
      someip event group notifications_EventGroup: event-group-id=49168, event=notifications/_notifier
      someip event group status_EventGroup: event-group-id=49184, event=status/_notifier
      someip event group consumptions_EventGroup: event-group-id=49200, event=consumptions/_notifier
    Distance_Someip: service-interface=Distance, service-interface-id=24586, service-interface-version={major-version=3, minor-version=1}
      someip field deployment distances: field=distances
        get _getter: method-id=16400, transport-protocol=UDP
        notifier _notifier: event-id=49168, transport-protocol=UDP
      someip event group distances_EventGroup: event-group-id=49168, event=distances/_notifier
    DisplaySpeed_Someip: service-interface=DisplaySpeed, service-interface-id=24609, service-interface-version={major-version=2, minor-version=1}
      someip field deployment velocities: field=velocities
        get _getter: method-id=16400, transport-protocol=UDP
        notifier _notifier: event-id=49168, transport-protocol=UDP
        set _setter: method-id=16401, transport-protocol=UDP
      someip field deployment notifications: field=notifications
        get _getter: method-id=16416, transport-protocol=UDP
        notifier _notifier: event-id=49184, transport-protocol=UDP
        set _setter: method-id=16417, transport-protocol=UDP
      someip event group velocities_EventGroup: event-group-id=49168, event=velocities/_notifier
      someip event group notifications_EventGroup: event-group-id=49184, event=notifications/_notifier
    DrivingStatistics_Someip: service-interface=DrivingStatistics, service-interface-id=24629, service-interface-version={major-version=2, minor-version=0}
      someip field deployment velocities: field=velocities
        get _getter: method-id=16400, transport-protocol=UDP
        notifier _notifier: event-id=49168, transport-protocol=UDP
        set _setter: method-id=16401, transport-protocol=UDP
      someip field deployment distances: field=distances
        get _getter: method-id=16416, transport-protocol=UDP
        notifier _notifier: event-id=49184, transport-protocol=UDP
        set _setter: method-id=16417, transport-protocol=UDP
      someip field deployment durations: field=durations
        get _getter: method-id=16432, transport-protocol=UDP
        notifier _notifier: event-id=49200, transport-protocol=UDP
        set _setter: method-id=16433, transport-protocol=UDP
      someip event group velocities_EventGroup: event-group-id=49168, event=velocities/_notifier
      someip event group distances_EventGroup: event-group-id=49184, event=distances/_notifier
      someip event group durations_EventGroup: event-group-id=49200, event=durations/_notifier
    DiagnosticDataDistribution_Someip: service-interface=DiagnosticDataDistribution, service-interface-id=32769, service-interface-version={major-version=1, minor-version=0}
      someip field deployment dataValuesHash: field=dataValuesHash
        get _getter: method-id=16400, transport-protocol=UDP
        notifier _notifier: event-id=49168, transport-protocol=UDP
      someip method deployment DiagnosticDataDistribution_getDiagnosticData: method=DiagnosticDataDistribution_getDiagnosticData, method-id=0, transport-protocol=UDP
      someip method deployment DiagnosticDataDistribution_getDiagnosticDataValues: method=DiagnosticDataDistribution_getDiagnosticDataValues, method-id=1, transport-protocol=UDP
      someip event group dataValuesHash_EventGroup: event-group-id=49168, event=dataValuesHash/_notifier
    ElectricalConsumptions_Someip: service-interface=ElectricalConsumptions, service-interface-id=24630, service-interface-version={major-version=2, minor-version=0}
      someip field deployment averageConsumptions: field=averageConsumptions
        get _getter: method-id=16400, transport-protocol=UDP
        notifier _notifier: event-id=49168, transport-protocol=UDP
        set _setter: method-id=16401, transport-protocol=UDP
      someip field deployment currentConsumptions: field=currentConsumptions
        get _getter: method-id=16416, transport-protocol=UDP
        notifier _notifier: event-id=49184, transport-protocol=UDP
      someip event group averageConsumptions_EventGroup: event-group-id=49168, event=averageConsumptions/_notifier
      someip event group currentConsumptions_EventGroup: event-group-id=49184, event=currentConsumptions/_notifier
    Engine_Someip: service-interface=Engine, service-interface-id=24602, service-interface-version={major-version=1, minor-version=0}
      4 x someip field deployment:
        powerMeterParameters: field=powerMeterParameters
          get _getter: method-id=16400, transport-protocol=UDP
          notifier _notifier: event-id=49168, transport-protocol=UDP
        electricPerformanceCharacteristics: field=electricPerformanceCharacteristics
          get _getter: method-id=16416, transport-protocol=UDP
          notifier _notifier: event-id=49184, transport-protocol=UDP
        engineInformation: field=engineInformation
          get _getter: method-id=16432, transport-protocol=UDP
          notifier _notifier: event-id=49200, transport-protocol=UDP
        notifications: field=notifications
          get _getter: method-id=16448, transport-protocol=UDP
          notifier _notifier: event-id=49216, transport-protocol=UDP
      4 x someip event group:
        powerMeterParameters_EventGroup: event-group-id=49168, event=powerMeterParameters/_notifier
        electricPerformanceCharacteristics_EventGroup: event-group-id=49184, event=electricPerformanceCharacteristics/_notifier
        engineInformation_EventGroup: event-group-id=49200, event=engineInformation/_notifier
        notifications_EventGroup: event-group-id=49216, event=notifications/_notifier
    EnvironmentalSensorData_Someip: service-interface=EnvironmentalSensorData, service-interface-id=24652, service-interface-version={major-version=1, minor-version=0}
      someip field deployment sensorData: field=sensorData
        get _getter: method-id=16400, transport-protocol=UDP
        notifier _notifier: event-id=49168, transport-protocol=UDP
      someip event group sensorData_EventGroup: event-group-id=49168, event=sensorData/_notifier
    ExteriorLight_Someip: service-interface=ExteriorLight, service-interface-id=24577, service-interface-version={major-version=3, minor-version=0}
      6 x someip field deployment:
        lightFunctions: field=lightFunctions
          get _getter: method-id=16400, transport-protocol=UDP
          notifier _notifier: event-id=49168, transport-protocol=UDP
        lightFunctionControls: field=lightFunctionControls
          get _getter: method-id=16416, transport-protocol=UDP
          notifier _notifier: event-id=49184, transport-protocol=UDP
          set _setter: method-id=16417, transport-protocol=UDP
        lamps: field=lamps
          get _getter: method-id=16432, transport-protocol=UDP
          notifier _notifier: event-id=49200, transport-protocol=UDP
        notifications: field=notifications
          get _getter: method-id=16448, transport-protocol=UDP
          notifier _notifier: event-id=49216, transport-protocol=UDP
        info: field=info
          get _getter: method-id=16464, transport-protocol=UDP
          notifier _notifier: event-id=49232, transport-protocol=UDP
        lightButtonModules: field=lightButtonModules
          get _getter: method-id=16480, transport-protocol=UDP
          notifier _notifier: event-id=49248, transport-protocol=UDP
      6 x someip event group:
        lightFunctions_EventGroup: event-group-id=49168, event=lightFunctions/_notifier
        lightFunctionControls_EventGroup: event-group-id=49184, event=lightFunctionControls/_notifier
        lamps_EventGroup: event-group-id=49200, event=lamps/_notifier
        notifications_EventGroup: event-group-id=49216, event=notifications/_notifier
        info_EventGroup: event-group-id=49232, event=info/_notifier
        lightButtonModules_EventGroup: event-group-id=49248, event=lightButtonModules/_notifier
    ExteriorSound_Someip: service-interface=ExteriorSound, service-interface-id=24607, service-interface-version={major-version=2, minor-version=0}
      someip field deployment notifications: field=notifications
        get _getter: method-id=16400, transport-protocol=UDP
        notifier _notifier: event-id=49168, transport-protocol=UDP
      someip event group notifications_EventGroup: event-group-id=49168, event=notifications/_notifier
    EnergySystem_Someip: service-interface=EnergySystem, service-interface-id=24581, service-interface-version={major-version=4, minor-version=1}
      4 x someip field deployment:
        notifications: field=notifications
          get _getter: method-id=16400, transport-protocol=UDP
          notifier _notifier: event-id=49168, transport-protocol=UDP
        highVoltageBatteries: field=highVoltageBatteries
          get _getter: method-id=16416, transport-protocol=UDP
          notifier _notifier: event-id=49184, transport-protocol=UDP
        lowVoltageBatteries: field=lowVoltageBatteries
          get _getter: method-id=16432, transport-protocol=UDP
          notifier _notifier: event-id=49200, transport-protocol=UDP
        lowVoltageSystemInfo: field=lowVoltageSystemInfo
          get _getter: method-id=16448, transport-protocol=UDP
          notifier _notifier: event-id=49216, transport-protocol=UDP
      4 x someip event group:
        notifications_EventGroup: event-group-id=49168, event=notifications/_notifier
        highVoltageBatteries_EventGroup: event-group-id=49184, event=highVoltageBatteries/_notifier
        lowVoltageBatteries_EventGroup: event-group-id=49200, event=lowVoltageBatteries/_notifier
        lowVoltageSystemInfo_EventGroup: event-group-id=49216, event=lowVoltageSystemInfo/_notifier
    Immobilizer_Someip: service-interface=Immobilizer, service-interface-id=24578, service-interface-version={major-version=3, minor-version=0}
      someip field deployment info: field=info
        get _getter: method-id=16400, transport-protocol=UDP
        notifier _notifier: event-id=49168, transport-protocol=UDP
      someip field deployment notifications: field=notifications
        get _getter: method-id=16416, transport-protocol=UDP
        notifier _notifier: event-id=49184, transport-protocol=UDP
      someip event group info_EventGroup: event-group-id=49168, event=info/_notifier
      someip event group notifications_EventGroup: event-group-id=49184, event=notifications/_notifier
    Odometry_Someip: service-interface=Odometry, service-interface-id=24599, service-interface-version={major-version=2, minor-version=2}
      someip field deployment velocities: field=velocities
        get _getter: method-id=16400, transport-protocol=UDP
        notifier _notifier: event-id=49168, transport-protocol=UDP
      someip field deployment motion: field=motion
        get _getter: method-id=16416, transport-protocol=UDP
        notifier _notifier: event-id=49184, transport-protocol=UDP
      someip event group velocities_EventGroup: event-group-id=49168, event=velocities/_notifier
      someip event group motion_EventGroup: event-group-id=49184, event=motion/_notifier
    Powertrain_Someip: service-interface=Powertrain, service-interface-id=24656, service-interface-version={major-version=1, minor-version=0}
      someip field deployment notifications: field=notifications
        get _getter: method-id=16400, transport-protocol=UDP
        notifier _notifier: event-id=49168, transport-protocol=UDP
      someip field deployment settings: field=settings
        get _getter: method-id=16416, transport-protocol=UDP
        notifier _notifier: event-id=49184, transport-protocol=UDP
      someip field deployment status: field=status
        get _getter: method-id=16432, transport-protocol=UDP
        notifier _notifier: event-id=49200, transport-protocol=UDP
      someip event group notifications_EventGroup: event-group-id=49168, event=notifications/_notifier
      someip event group settings_EventGroup: event-group-id=49184, event=settings/_notifier
      someip event group status_EventGroup: event-group-id=49200, event=status/_notifier
    PowertrainConsumption_Someip: service-interface=PowertrainConsumption, service-interface-id=24657, service-interface-version={major-version=1, minor-version=0}
      someip field deployment electricDriveMotors: field=electricDriveMotors
        get _getter: method-id=16400, transport-protocol=UDP
        notifier _notifier: event-id=49168, transport-protocol=UDP
      someip event group electricDriveMotors_EventGroup: event-group-id=49168, event=electricDriveMotors/_notifier
    SafetyBeltState_Someip: service-interface=SafetyBeltState, service-interface-id=24612, service-interface-version={major-version=2, minor-version=1}
      someip field deployment notifications: field=notifications
        get _getter: method-id=16400, transport-protocol=UDP
        notifier _notifier: event-id=49168, transport-protocol=UDP
      someip field deployment belts: field=belts
        get _getter: method-id=16416, transport-protocol=UDP
        notifier _notifier: event-id=49184, transport-protocol=UDP
      someip event group notifications_EventGroup: event-group-id=49168, event=notifications/_notifier
      someip event group belts_EventGroup: event-group-id=49184, event=belts/_notifier
    Time_Someip: service-interface=Time, service-interface-id=24585, service-interface-version={major-version=3, minor-version=1}
      someip field deployment timeSettings: field=timeSettings
        get _getter: method-id=16400, transport-protocol=UDP
        notifier _notifier: event-id=49168, transport-protocol=UDP
        set _setter: method-id=16401, transport-protocol=UDP
      someip field deployment times: field=times
        get _getter: method-id=16416, transport-protocol=UDP
        notifier _notifier: event-id=49184, transport-protocol=UDP
        set _setter: method-id=16417, transport-protocol=UDP
      someip event group timeSettings_EventGroup: event-group-id=49168, event=timeSettings/_notifier
      someip event group times_EventGroup: event-group-id=49184, event=times/_notifier
    Temperature_Someip: service-interface=Temperature, service-interface-id=24628, service-interface-version={major-version=1, minor-version=1}
      someip field deployment temperatures: field=temperatures
        get _getter: method-id=16400, transport-protocol=UDP
        notifier _notifier: event-id=49168, transport-protocol=UDP
      someip field deployment notifications: field=notifications
        get _getter: method-id=16416, transport-protocol=UDP
        notifier _notifier: event-id=49184, transport-protocol=UDP
        set _setter: method-id=16417, transport-protocol=UDP
      someip event group temperatures_EventGroup: event-group-id=49168, event=temperatures/_notifier
      someip event group notifications_EventGroup: event-group-id=49184, event=notifications/_notifier
    UnitMaster_Someip: service-interface=UnitMaster, service-interface-id=24590, service-interface-version={major-version=2, minor-version=0}
      someip field deployment units: field=units
        get _getter: method-id=16400, transport-protocol=UDP
        notifier _notifier: event-id=49168, transport-protocol=UDP
        set _setter: method-id=16401, transport-protocol=UDP
      someip event group units_EventGroup: event-group-id=49168, event=units/_notifier
    VehicleBasicData_Someip: service-interface=VehicleBasicData, service-interface-id=24653, service-interface-version={major-version=1, minor-version=0}
      someip field deployment installations: field=installations
        get _getter: method-id=16400, transport-protocol=UDP
        notifier _notifier: event-id=49168, transport-protocol=UDP
      someip field deployment variants: field=variants
        get _getter: method-id=16416, transport-protocol=UDP
        notifier _notifier: event-id=49184, transport-protocol=UDP
      someip field deployment parameters: field=parameters
        get _getter: method-id=16432, transport-protocol=UDP
        notifier _notifier: event-id=49200, transport-protocol=UDP
      someip event group installations_EventGroup: event-group-id=49168, event=installations/_notifier
      someip event group variants_EventGroup: event-group-id=49184, event=variants/_notifier
      someip event group parameters_EventGroup: event-group-id=49200, event=parameters/_notifier
    HighVoltageCoordinator_Someip: service-interface=HighVoltageCoordinator, service-interface-id=24658, service-interface-version={major-version=1, minor-version=0}
      someip field deployment notifications: field=notifications
        get _getter: method-id=16400, transport-protocol=UDP
        notifier _notifier: event-id=49168, transport-protocol=UDP
      someip event group notifications_EventGroup: event-group-id=49168, event=notifications/_notifier
  23 x someip data prototype transformation props:
    Chassis_TLV
      data-prototypes:
        {data-prototype=Chassis_RPort_Distance.axes, element-in-impl-datatype={root-data-prototype=axes, target-data-prototype=position}, tlv-data-id=0}
        {data-prototype=Chassis_RPort_Distance.axes, element-in-impl-datatype={root-data-prototype=axes, target-data-prototype=distancePulses}, tlv-data-id=1}
        {data-prototype=Chassis_RPort_Distance.axes, element-in-impl-datatype={root-data-prototype=axes, target-data-prototype=distancePulseOverflow}, tlv-data-id=2}
        {data-prototype=Chassis_RPort_Distance.axes, element-in-impl-datatype={root-data-prototype=axes, target-data-prototype=wheelRotationsPerSecondPhysicalValue}, tlv-data-id=3}
        {data-prototype=Chassis_RPort_Distance.axes, element-in-impl-datatype={root-data-prototype=axes, target-data-prototype=wheelRotationsPerSecondLogicalValue}, tlv-data-id=4}
        {data-prototype=Chassis_RPort_Distance.axes, element-in-impl-datatype={root-data-prototype=axes, target-data-prototype=wheelRotationsPerSecondValueType}, tlv-data-id=5}
        {data-prototype=Chassis_RPort_Distance.velocityInfo, element-in-impl-datatype={root-data-prototype=velocityInfo, target-data-prototype=elementId}, tlv-data-id=0}
        {data-prototype=Chassis_RPort_Distance.velocityInfo, element-in-impl-datatype={root-data-prototype=velocityInfo, target-data-prototype=noOfTeethImpulseWheel}, tlv-data-id=1}
        {data-prototype=Chassis_RPort_Distance.velocityInfo, element-in-impl-datatype={root-data-prototype=velocityInfo, target-data-prototype=meanVelocityPhysicalValue}, tlv-data-id=2}
        {data-prototype=Chassis_RPort_Distance.velocityInfo, element-in-impl-datatype={root-data-prototype=velocityInfo, target-data-prototype=meanVelocityLogicalValue}, tlv-data-id=3}
        {data-prototype=Chassis_RPort_Distance.velocityInfo, element-in-impl-datatype={root-data-prototype=velocityInfo, target-data-prototype=meanVelocityValueType}, tlv-data-id=4}
        {data-prototype=Chassis_RPort_Distance.notifications, element-in-impl-datatype={root-data-prototype=notifications, target-data-prototype=type}, tlv-data-id=0}
        {data-prototype=Chassis_RPort_Distance.notifications, element-in-impl-datatype={root-data-prototype=notifications, target-data-prototype=value}, tlv-data-id=1}
        {data-prototype=Chassis_RPort_Distance.wheels, element-in-impl-datatype={root-data-prototype=wheels, target-data-prototype=position}, tlv-data-id=0}
        {data-prototype=Chassis_RPort_Distance.wheels, element-in-impl-datatype={root-data-prototype=wheels, target-data-prototype=distancePulsesPhysicalValue}, tlv-data-id=1}
        {data-prototype=Chassis_RPort_Distance.wheels, element-in-impl-datatype={root-data-prototype=wheels, target-data-prototype=distancePulsesLogicalValue}, tlv-data-id=2}
        {data-prototype=Chassis_RPort_Distance.wheels, element-in-impl-datatype={root-data-prototype=wheels, target-data-prototype=distancePulsesValueType}, tlv-data-id=3}
        {data-prototype=Chassis_RPort_Distance.espSystemInfo, element-in-impl-datatype={root-data-prototype=espSystemInfo, target-data-prototype=elementId}, tlv-data-id=0}
        {data-prototype=Chassis_RPort_Distance.espSystemInfo, element-in-impl-datatype={root-data-prototype=espSystemInfo, target-data-prototype=espDiagnosticIsActive}, tlv-data-id=1}
    ClampControl_TLV
      data-prototypes:
        {data-prototype=ClampControl_RPort_Distance.clamps, element-in-impl-datatype={root-data-prototype=clamps, target-data-prototype=type}, tlv-data-id=0}
        {data-prototype=ClampControl_RPort_Distance.clamps, element-in-impl-datatype={root-data-prototype=clamps, target-data-prototype=isSwitchedOn}, tlv-data-id=1}
        {data-prototype=ClampControl_RPort_Distance.notifications, element-in-impl-datatype={root-data-prototype=notifications, target-data-prototype=type}, tlv-data-id=0}
        {data-prototype=ClampControl_RPort_Distance.notifications, element-in-impl-datatype={root-data-prototype=notifications, target-data-prototype=value}, tlv-data-id=1}
        {data-prototype=ClampControl_RPort_ElectricalConsumptions.clamps, element-in-impl-datatype={root-data-prototype=clamps, target-data-prototype=type}, tlv-data-id=0}
        {data-prototype=ClampControl_RPort_ElectricalConsumptions.clamps, element-in-impl-datatype={root-data-prototype=clamps, target-data-prototype=isSwitchedOn}, tlv-data-id=1}
        {data-prototype=ClampControl_RPort_ElectricalConsumptions.notifications, element-in-impl-datatype={root-data-prototype=notifications, target-data-prototype=type}, tlv-data-id=0}
        {data-prototype=ClampControl_RPort_ElectricalConsumptions.notifications, element-in-impl-datatype={root-data-prototype=notifications, target-data-prototype=value}, tlv-data-id=1}
        {data-prototype=ClampControl_RPort_DrivingStatistics.clamps, element-in-impl-datatype={root-data-prototype=clamps, target-data-prototype=type}, tlv-data-id=0}
        {data-prototype=ClampControl_RPort_DrivingStatistics.clamps, element-in-impl-datatype={root-data-prototype=clamps, target-data-prototype=isSwitchedOn}, tlv-data-id=1}
        {data-prototype=ClampControl_RPort_DrivingStatistics.notifications, element-in-impl-datatype={root-data-prototype=notifications, target-data-prototype=type}, tlv-data-id=0}
        {data-prototype=ClampControl_RPort_DrivingStatistics.notifications, element-in-impl-datatype={root-data-prototype=notifications, target-data-prototype=value}, tlv-data-id=1}
        {data-prototype=ClampControl_RPort_Telltale.clamps, element-in-impl-datatype={root-data-prototype=clamps, target-data-prototype=type}, tlv-data-id=0}
        {data-prototype=ClampControl_RPort_Telltale.clamps, element-in-impl-datatype={root-data-prototype=clamps, target-data-prototype=isSwitchedOn}, tlv-data-id=1}
        {data-prototype=ClampControl_RPort_Telltale.notifications, element-in-impl-datatype={root-data-prototype=notifications, target-data-prototype=type}, tlv-data-id=0}
        {data-prototype=ClampControl_RPort_Telltale.notifications, element-in-impl-datatype={root-data-prototype=notifications, target-data-prototype=value}, tlv-data-id=1}
        {data-prototype=ClampControl_RPort_Speed.clamps, element-in-impl-datatype={root-data-prototype=clamps, target-data-prototype=type}, tlv-data-id=0}
        {data-prototype=ClampControl_RPort_Speed.clamps, element-in-impl-datatype={root-data-prototype=clamps, target-data-prototype=isSwitchedOn}, tlv-data-id=1}
        {data-prototype=ClampControl_RPort_Speed.notifications, element-in-impl-datatype={root-data-prototype=notifications, target-data-prototype=type}, tlv-data-id=0}
        {data-prototype=ClampControl_RPort_Speed.notifications, element-in-impl-datatype={root-data-prototype=notifications, target-data-prototype=value}, tlv-data-id=1}
        {data-prototype=ClampControl_RPort_UnitMaster.clamps, element-in-impl-datatype={root-data-prototype=clamps, target-data-prototype=type}, tlv-data-id=0}
        {data-prototype=ClampControl_RPort_UnitMaster.clamps, element-in-impl-datatype={root-data-prototype=clamps, target-data-prototype=isSwitchedOn}, tlv-data-id=1}
        {data-prototype=ClampControl_RPort_UnitMaster.notifications, element-in-impl-datatype={root-data-prototype=notifications, target-data-prototype=type}, tlv-data-id=0}
        {data-prototype=ClampControl_RPort_UnitMaster.notifications, element-in-impl-datatype={root-data-prototype=notifications, target-data-prototype=value}, tlv-data-id=1}
        {data-prototype=ClampControl_RPort_Temperature.clamps, element-in-impl-datatype={root-data-prototype=clamps, target-data-prototype=type}, tlv-data-id=0}
        {data-prototype=ClampControl_RPort_Temperature.clamps, element-in-impl-datatype={root-data-prototype=clamps, target-data-prototype=isSwitchedOn}, tlv-data-id=1}
        {data-prototype=ClampControl_RPort_Temperature.notifications, element-in-impl-datatype={root-data-prototype=notifications, target-data-prototype=type}, tlv-data-id=0}
        {data-prototype=ClampControl_RPort_Temperature.notifications, element-in-impl-datatype={root-data-prototype=notifications, target-data-prototype=value}, tlv-data-id=1}
        {data-prototype=ClampControl_RPort_TripComputer.clamps, element-in-impl-datatype={root-data-prototype=clamps, target-data-prototype=type}, tlv-data-id=0}
        {data-prototype=ClampControl_RPort_TripComputer.clamps, element-in-impl-datatype={root-data-prototype=clamps, target-data-prototype=isSwitchedOn}, tlv-data-id=1}
        {data-prototype=ClampControl_RPort_TripComputer.notifications, element-in-impl-datatype={root-data-prototype=notifications, target-data-prototype=type}, tlv-data-id=0}
        {data-prototype=ClampControl_RPort_TripComputer.notifications, element-in-impl-datatype={root-data-prototype=notifications, target-data-prototype=value}, tlv-data-id=1}
    ClimateControl_TLV
      data-prototypes:
        {data-prototype=ClimateControl_RPort_ElectricalConsumptions.notifications, element-in-impl-datatype={root-data-prototype=notifications, target-data-prototype=type}, tlv-data-id=0}
        {data-prototype=ClimateControl_RPort_ElectricalConsumptions.notifications, element-in-impl-datatype={root-data-prototype=notifications, target-data-prototype=value}, tlv-data-id=1}
        {data-prototype=ClimateControl_RPort_ElectricalConsumptions.status, element-in-impl-datatype={root-data-prototype=status, target-data-prototype=elementId}, tlv-data-id=0}
        {data-prototype=ClimateControl_RPort_ElectricalConsumptions.status, element-in-impl-datatype={root-data-prototype=status, target-data-prototype=isControlElementActivated}, tlv-data-id=1}
        {data-prototype=ClimateControl_RPort_ElectricalConsumptions.status, element-in-impl-datatype={root-data-prototype=status, target-data-prototype=stationaryOutput}, tlv-data-id=2}
        {data-prototype=ClimateControl_RPort_ElectricalConsumptions.status, element-in-impl-datatype={root-data-prototype=status, target-data-prototype=stationaryOutputValueType}, tlv-data-id=3}
        {data-prototype=ClimateControl_RPort_ElectricalConsumptions.consumptions, element-in-impl-datatype={root-data-prototype=consumptions, target-data-prototype=type}, tlv-data-id=0}
        {data-prototype=ClimateControl_RPort_ElectricalConsumptions.consumptions, element-in-impl-datatype={root-data-prototype=consumptions, target-data-prototype=physicalValue}, tlv-data-id=1}
        {data-prototype=ClimateControl_RPort_ElectricalConsumptions.consumptions, element-in-impl-datatype={root-data-prototype=consumptions, target-data-prototype=hasOverflowed}, tlv-data-id=2}
    Distance_TLV
      data-prototypes:
        {data-prototype=Distance_PPort_Distance.distances, element-in-impl-datatype={root-data-prototype=distances, target-data-prototype=distanceName}, tlv-data-id=0}
        {data-prototype=Distance_PPort_Distance.distances, element-in-impl-datatype={root-data-prototype=distances, target-data-prototype=currentValue}, tlv-data-id=1}
        {data-prototype=Distance_PPort_Distance.distances, element-in-impl-datatype={root-data-prototype=distances, target-data-prototype=valueType}, tlv-data-id=2}
        {data-prototype=Distance_PPort_Distance.distances, element-in-impl-datatype={root-data-prototype=distances, target-data-prototype=unit}, tlv-data-id=3}
        {data-prototype=Distance_PPort_Distance.distances, element-in-impl-datatype={root-data-prototype=distances, target-data-prototype=maxValue}, tlv-data-id=4}
        {data-prototype=Distance_PPort_Distance.distances, element-in-impl-datatype={root-data-prototype=distances, target-data-prototype=minValue}, tlv-data-id=5}
        {data-prototype=Distance_PPort_Distance.distances, element-in-impl-datatype={root-data-prototype=distances, target-data-prototype=resolution}, tlv-data-id=6}
        {data-prototype=Distance_RPort_ElectricalConsumptions.distances, element-in-impl-datatype={root-data-prototype=distances, target-data-prototype=distanceName}, tlv-data-id=0}
        {data-prototype=Distance_RPort_ElectricalConsumptions.distances, element-in-impl-datatype={root-data-prototype=distances, target-data-prototype=currentValue}, tlv-data-id=1}
        {data-prototype=Distance_RPort_ElectricalConsumptions.distances, element-in-impl-datatype={root-data-prototype=distances, target-data-prototype=valueType}, tlv-data-id=2}
        {data-prototype=Distance_RPort_ElectricalConsumptions.distances, element-in-impl-datatype={root-data-prototype=distances, target-data-prototype=unit}, tlv-data-id=3}
        {data-prototype=Distance_RPort_ElectricalConsumptions.distances, element-in-impl-datatype={root-data-prototype=distances, target-data-prototype=maxValue}, tlv-data-id=4}
        {data-prototype=Distance_RPort_ElectricalConsumptions.distances, element-in-impl-datatype={root-data-prototype=distances, target-data-prototype=minValue}, tlv-data-id=5}
        {data-prototype=Distance_RPort_ElectricalConsumptions.distances, element-in-impl-datatype={root-data-prototype=distances, target-data-prototype=resolution}, tlv-data-id=6}
        {data-prototype=Distance_Rport_DrivingStatistics.distances, element-in-impl-datatype={root-data-prototype=distances, target-data-prototype=distanceName}, tlv-data-id=0}
        {data-prototype=Distance_Rport_DrivingStatistics.distances, element-in-impl-datatype={root-data-prototype=distances, target-data-prototype=currentValue}, tlv-data-id=1}
        {data-prototype=Distance_Rport_DrivingStatistics.distances, element-in-impl-datatype={root-data-prototype=distances, target-data-prototype=valueType}, tlv-data-id=2}
        {data-prototype=Distance_Rport_DrivingStatistics.distances, element-in-impl-datatype={root-data-prototype=distances, target-data-prototype=unit}, tlv-data-id=3}
        {data-prototype=Distance_Rport_DrivingStatistics.distances, element-in-impl-datatype={root-data-prototype=distances, target-data-prototype=maxValue}, tlv-data-id=4}
        {data-prototype=Distance_Rport_DrivingStatistics.distances, element-in-impl-datatype={root-data-prototype=distances, target-data-prototype=minValue}, tlv-data-id=5}
        {data-prototype=Distance_Rport_DrivingStatistics.distances, element-in-impl-datatype={root-data-prototype=distances, target-data-prototype=resolution}, tlv-data-id=6}
        {data-prototype=Distance_RPort_Temperature.distances, element-in-impl-datatype={root-data-prototype=distances, target-data-prototype=distanceName}, tlv-data-id=0}
        {data-prototype=Distance_RPort_Temperature.distances, element-in-impl-datatype={root-data-prototype=distances, target-data-prototype=currentValue}, tlv-data-id=1}
        {data-prototype=Distance_RPort_Temperature.distances, element-in-impl-datatype={root-data-prototype=distances, target-data-prototype=valueType}, tlv-data-id=2}
        {data-prototype=Distance_RPort_Temperature.distances, element-in-impl-datatype={root-data-prototype=distances, target-data-prototype=unit}, tlv-data-id=3}
        {data-prototype=Distance_RPort_Temperature.distances, element-in-impl-datatype={root-data-prototype=distances, target-data-prototype=maxValue}, tlv-data-id=4}
        {data-prototype=Distance_RPort_Temperature.distances, element-in-impl-datatype={root-data-prototype=distances, target-data-prototype=minValue}, tlv-data-id=5}
        {data-prototype=Distance_RPort_Temperature.distances, element-in-impl-datatype={root-data-prototype=distances, target-data-prototype=resolution}, tlv-data-id=6}
        {data-prototype=Distance_RPort_TripComputer.distances, element-in-impl-datatype={root-data-prototype=distances, target-data-prototype=distanceName}, tlv-data-id=0}
        {data-prototype=Distance_RPort_TripComputer.distances, element-in-impl-datatype={root-data-prototype=distances, target-data-prototype=currentValue}, tlv-data-id=1}
        {data-prototype=Distance_RPort_TripComputer.distances, element-in-impl-datatype={root-data-prototype=distances, target-data-prototype=valueType}, tlv-data-id=2}
        {data-prototype=Distance_RPort_TripComputer.distances, element-in-impl-datatype={root-data-prototype=distances, target-data-prototype=unit}, tlv-data-id=3}
        {data-prototype=Distance_RPort_TripComputer.distances, element-in-impl-datatype={root-data-prototype=distances, target-data-prototype=maxValue}, tlv-data-id=4}
        {data-prototype=Distance_RPort_TripComputer.distances, element-in-impl-datatype={root-data-prototype=distances, target-data-prototype=minValue}, tlv-data-id=5}
        {data-prototype=Distance_RPort_TripComputer.distances, element-in-impl-datatype={root-data-prototype=distances, target-data-prototype=resolution}, tlv-data-id=6}
    DisplaySpeed_TLV
      data-prototypes:
        {data-prototype=DisplaySpeed_RPort_ElectricalConsumptions.velocities, element-in-impl-datatype={root-data-prototype=velocities, target-data-prototype=type}, tlv-data-id=0}
        {data-prototype=DisplaySpeed_RPort_ElectricalConsumptions.velocities, element-in-impl-datatype={root-data-prototype=velocities, target-data-prototype=currentValue}, tlv-data-id=1}
        {data-prototype=DisplaySpeed_RPort_ElectricalConsumptions.velocities, element-in-impl-datatype={root-data-prototype=velocities, target-data-prototype=valueType}, tlv-data-id=2}
        {data-prototype=DisplaySpeed_RPort_ElectricalConsumptions.velocities, element-in-impl-datatype={root-data-prototype=velocities, target-data-prototype=unit}, tlv-data-id=3}
        {data-prototype=DisplaySpeed_RPort_ElectricalConsumptions.velocities, element-in-impl-datatype={root-data-prototype=velocities, target-data-prototype=isDisplayActive}, tlv-data-id=4}
        {data-prototype=DisplaySpeed_RPort_ElectricalConsumptions.velocities, element-in-impl-datatype={root-data-prototype=velocities, target-data-prototype=maxValue}, tlv-data-id=5}
        {data-prototype=DisplaySpeed_RPort_ElectricalConsumptions.velocities, element-in-impl-datatype={root-data-prototype=velocities, target-data-prototype=minValue}, tlv-data-id=6}
        {data-prototype=DisplaySpeed_RPort_ElectricalConsumptions.velocities, element-in-impl-datatype={root-data-prototype=velocities, target-data-prototype=resolution}, tlv-data-id=7}
        {data-prototype=DisplaySpeed_RPort_ElectricalConsumptions.notifications, element-in-impl-datatype={root-data-prototype=notifications, target-data-prototype=type}, tlv-data-id=0}
        {data-prototype=DisplaySpeed_RPort_ElectricalConsumptions.notifications, element-in-impl-datatype={root-data-prototype=notifications, target-data-prototype=isActive}, tlv-data-id=1}
        {data-prototype=DisplaySpeed_RPort_ElectricalConsumptions.notifications, element-in-impl-datatype={root-data-prototype=notifications, target-data-prototype=threshold}, tlv-data-id=2}
        {data-prototype=DisplaySpeed_RPort_ElectricalConsumptions.notifications, element-in-impl-datatype={root-data-prototype=notifications, target-data-prototype=isNotifiable}, tlv-data-id=3}
        {data-prototype=DisplaySpeed_RPort_ElectricalConsumptions.notifications, element-in-impl-datatype={root-data-prototype=notifications, target-data-prototype=unit}, tlv-data-id=4}
        {data-prototype=DisplaySpeed_RPort_ElectricalConsumptions.notifications, element-in-impl-datatype={root-data-prototype=notifications, target-data-prototype=restrictionReason}, tlv-data-id=5}
        {data-prototype=DisplaySpeed_RPort_ElectricalConsumptions.notifications, element-in-impl-datatype={root-data-prototype=notifications, target-data-prototype=maxThresholdValue}, tlv-data-id=6}
        {data-prototype=DisplaySpeed_RPort_ElectricalConsumptions.notifications, element-in-impl-datatype={root-data-prototype=notifications, target-data-prototype=minThresholdValue}, tlv-data-id=7}
        {data-prototype=DisplaySpeed_RPort_ElectricalConsumptions.notifications, element-in-impl-datatype={root-data-prototype=notifications, target-data-prototype=resolution}, tlv-data-id=8}
        {data-prototype=DisplaySpeed_PPort_Speed.velocities, element-in-impl-datatype={root-data-prototype=velocities, target-data-prototype=type}, tlv-data-id=0}
        {data-prototype=DisplaySpeed_PPort_Speed.velocities, element-in-impl-datatype={root-data-prototype=velocities, target-data-prototype=currentValue}, tlv-data-id=1}
        {data-prototype=DisplaySpeed_PPort_Speed.velocities, element-in-impl-datatype={root-data-prototype=velocities, target-data-prototype=valueType}, tlv-data-id=2}
        {data-prototype=DisplaySpeed_PPort_Speed.velocities, element-in-impl-datatype={root-data-prototype=velocities, target-data-prototype=unit}, tlv-data-id=3}
        {data-prototype=DisplaySpeed_PPort_Speed.velocities, element-in-impl-datatype={root-data-prototype=velocities, target-data-prototype=isDisplayActive}, tlv-data-id=4}
        {data-prototype=DisplaySpeed_PPort_Speed.velocities, element-in-impl-datatype={root-data-prototype=velocities, target-data-prototype=maxValue}, tlv-data-id=5}
        {data-prototype=DisplaySpeed_PPort_Speed.velocities, element-in-impl-datatype={root-data-prototype=velocities, target-data-prototype=minValue}, tlv-data-id=6}
        {data-prototype=DisplaySpeed_PPort_Speed.velocities, element-in-impl-datatype={root-data-prototype=velocities, target-data-prototype=resolution}, tlv-data-id=7}
        {data-prototype=DisplaySpeed_PPort_Speed.notifications, element-in-impl-datatype={root-data-prototype=notifications, target-data-prototype=type}, tlv-data-id=0}
        {data-prototype=DisplaySpeed_PPort_Speed.notifications, element-in-impl-datatype={root-data-prototype=notifications, target-data-prototype=isActive}, tlv-data-id=1}
        {data-prototype=DisplaySpeed_PPort_Speed.notifications, element-in-impl-datatype={root-data-prototype=notifications, target-data-prototype=threshold}, tlv-data-id=2}
        {data-prototype=DisplaySpeed_PPort_Speed.notifications, element-in-impl-datatype={root-data-prototype=notifications, target-data-prototype=isNotifiable}, tlv-data-id=3}
        {data-prototype=DisplaySpeed_PPort_Speed.notifications, element-in-impl-datatype={root-data-prototype=notifications, target-data-prototype=unit}, tlv-data-id=4}
        {data-prototype=DisplaySpeed_PPort_Speed.notifications, element-in-impl-datatype={root-data-prototype=notifications, target-data-prototype=restrictionReason}, tlv-data-id=5}
        {data-prototype=DisplaySpeed_PPort_Speed.notifications, element-in-impl-datatype={root-data-prototype=notifications, target-data-prototype=maxThresholdValue}, tlv-data-id=6}
        {data-prototype=DisplaySpeed_PPort_Speed.notifications, element-in-impl-datatype={root-data-prototype=notifications, target-data-prototype=minThresholdValue}, tlv-data-id=7}
        {data-prototype=DisplaySpeed_PPort_Speed.notifications, element-in-impl-datatype={root-data-prototype=notifications, target-data-prototype=resolution}, tlv-data-id=8}
        {data-prototype=DisplaySpeed_RPort_TripComputer.velocities, element-in-impl-datatype={root-data-prototype=velocities, target-data-prototype=type}, tlv-data-id=0}
        {data-prototype=DisplaySpeed_RPort_TripComputer.velocities, element-in-impl-datatype={root-data-prototype=velocities, target-data-prototype=currentValue}, tlv-data-id=1}
        {data-prototype=DisplaySpeed_RPort_TripComputer.velocities, element-in-impl-datatype={root-data-prototype=velocities, target-data-prototype=valueType}, tlv-data-id=2}
        {data-prototype=DisplaySpeed_RPort_TripComputer.velocities, element-in-impl-datatype={root-data-prototype=velocities, target-data-prototype=unit}, tlv-data-id=3}
        {data-prototype=DisplaySpeed_RPort_TripComputer.velocities, element-in-impl-datatype={root-data-prototype=velocities, target-data-prototype=isDisplayActive}, tlv-data-id=4}
        {data-prototype=DisplaySpeed_RPort_TripComputer.velocities, element-in-impl-datatype={root-data-prototype=velocities, target-data-prototype=maxValue}, tlv-data-id=5}
        {data-prototype=DisplaySpeed_RPort_TripComputer.velocities, element-in-impl-datatype={root-data-prototype=velocities, target-data-prototype=minValue}, tlv-data-id=6}
        {data-prototype=DisplaySpeed_RPort_TripComputer.velocities, element-in-impl-datatype={root-data-prototype=velocities, target-data-prototype=resolution}, tlv-data-id=7}
        {data-prototype=DisplaySpeed_RPort_TripComputer.notifications, element-in-impl-datatype={root-data-prototype=notifications, target-data-prototype=type}, tlv-data-id=0}
        {data-prototype=DisplaySpeed_RPort_TripComputer.notifications, element-in-impl-datatype={root-data-prototype=notifications, target-data-prototype=isActive}, tlv-data-id=1}
        {data-prototype=DisplaySpeed_RPort_TripComputer.notifications, element-in-impl-datatype={root-data-prototype=notifications, target-data-prototype=threshold}, tlv-data-id=2}
        {data-prototype=DisplaySpeed_RPort_TripComputer.notifications, element-in-impl-datatype={root-data-prototype=notifications, target-data-prototype=isNotifiable}, tlv-data-id=3}
        {data-prototype=DisplaySpeed_RPort_TripComputer.notifications, element-in-impl-datatype={root-data-prototype=notifications, target-data-prototype=unit}, tlv-data-id=4}
        {data-prototype=DisplaySpeed_RPort_TripComputer.notifications, element-in-impl-datatype={root-data-prototype=notifications, target-data-prototype=restrictionReason}, tlv-data-id=5}
        {data-prototype=DisplaySpeed_RPort_TripComputer.notifications, element-in-impl-datatype={root-data-prototype=notifications, target-data-prototype=maxThresholdValue}, tlv-data-id=6}
        {data-prototype=DisplaySpeed_RPort_TripComputer.notifications, element-in-impl-datatype={root-data-prototype=notifications, target-data-prototype=minThresholdValue}, tlv-data-id=7}
        {data-prototype=DisplaySpeed_RPort_TripComputer.notifications, element-in-impl-datatype={root-data-prototype=notifications, target-data-prototype=resolution}, tlv-data-id=8}
    DrivingStatistics_TLV
      data-prototypes:
        {data-prototype=DrivingStatistics_PPort_DrivingStatistics.velocities, element-in-impl-datatype={root-data-prototype=velocities, target-data-prototype=memoryLevel}, tlv-data-id=0}
        {data-prototype=DrivingStatistics_PPort_DrivingStatistics.velocities, element-in-impl-datatype={root-data-prototype=velocities, target-data-prototype=currentValue}, tlv-data-id=1}
        {data-prototype=DrivingStatistics_PPort_DrivingStatistics.velocities, element-in-impl-datatype={root-data-prototype=velocities, target-data-prototype=state}, tlv-data-id=2}
        {data-prototype=DrivingStatistics_PPort_DrivingStatistics.distances, element-in-impl-datatype={root-data-prototype=distances, target-data-prototype=memoryLevel}, tlv-data-id=0}
        {data-prototype=DrivingStatistics_PPort_DrivingStatistics.distances, element-in-impl-datatype={root-data-prototype=distances, target-data-prototype=currentValue}, tlv-data-id=1}
        {data-prototype=DrivingStatistics_PPort_DrivingStatistics.distances, element-in-impl-datatype={root-data-prototype=distances, target-data-prototype=state}, tlv-data-id=2}
        {data-prototype=DrivingStatistics_PPort_DrivingStatistics.durations, element-in-impl-datatype={root-data-prototype=durations, target-data-prototype=memoryLevel}, tlv-data-id=0}
        {data-prototype=DrivingStatistics_PPort_DrivingStatistics.durations, element-in-impl-datatype={root-data-prototype=durations, target-data-prototype=currentValue}, tlv-data-id=1}
        {data-prototype=DrivingStatistics_PPort_DrivingStatistics.durations, element-in-impl-datatype={root-data-prototype=durations, target-data-prototype=state}, tlv-data-id=2}
        {data-prototype=DrivingStatistics_RPort_TripComputer.velocities, element-in-impl-datatype={root-data-prototype=velocities, target-data-prototype=memoryLevel}, tlv-data-id=0}
        {data-prototype=DrivingStatistics_RPort_TripComputer.velocities, element-in-impl-datatype={root-data-prototype=velocities, target-data-prototype=currentValue}, tlv-data-id=1}
        {data-prototype=DrivingStatistics_RPort_TripComputer.velocities, element-in-impl-datatype={root-data-prototype=velocities, target-data-prototype=state}, tlv-data-id=2}
        {data-prototype=DrivingStatistics_RPort_TripComputer.distances, element-in-impl-datatype={root-data-prototype=distances, target-data-prototype=memoryLevel}, tlv-data-id=0}
        {data-prototype=DrivingStatistics_RPort_TripComputer.distances, element-in-impl-datatype={root-data-prototype=distances, target-data-prototype=currentValue}, tlv-data-id=1}
        {data-prototype=DrivingStatistics_RPort_TripComputer.distances, element-in-impl-datatype={root-data-prototype=distances, target-data-prototype=state}, tlv-data-id=2}
        {data-prototype=DrivingStatistics_RPort_TripComputer.durations, element-in-impl-datatype={root-data-prototype=durations, target-data-prototype=memoryLevel}, tlv-data-id=0}
        {data-prototype=DrivingStatistics_RPort_TripComputer.durations, element-in-impl-datatype={root-data-prototype=durations, target-data-prototype=currentValue}, tlv-data-id=1}
        {data-prototype=DrivingStatistics_RPort_TripComputer.durations, element-in-impl-datatype={root-data-prototype=durations, target-data-prototype=state}, tlv-data-id=2}
    DiagnosticDataDistribution_TLV
      data-prototypes:
        {data-prototype=DiagnosticDataDistribution_RPort_Distance.dataValuesHash, element-in-impl-datatype={root-data-prototype=dataValuesHash, target-data-prototype=name_space}, tlv-data-id=1}
        {data-prototype=DiagnosticDataDistribution_RPort_Distance.dataValuesHash, element-in-impl-datatype={root-data-prototype=dataValuesHash, target-data-prototype=category}, tlv-data-id=2}
        {data-prototype=DiagnosticDataDistribution_RPort_Distance.dataValuesHash, element-in-impl-datatype={root-data-prototype=dataValuesHash, target-data-prototype=hashValue}, tlv-data-id=3}
        {data-prototype=DiagnosticDataDistribution_RPort_ElectricalConsumptions.dataValuesHash, element-in-impl-datatype={root-data-prototype=dataValuesHash, target-data-prototype=name_space}, tlv-data-id=1}
        {data-prototype=DiagnosticDataDistribution_RPort_ElectricalConsumptions.dataValuesHash, element-in-impl-datatype={root-data-prototype=dataValuesHash, target-data-prototype=category}, tlv-data-id=2}
        {data-prototype=DiagnosticDataDistribution_RPort_ElectricalConsumptions.dataValuesHash, element-in-impl-datatype={root-data-prototype=dataValuesHash, target-data-prototype=hashValue}, tlv-data-id=3}
        {data-prototype=DiagnosticDataDistribution_RPort_DrivingStatistics.dataValuesHash, element-in-impl-datatype={root-data-prototype=dataValuesHash, target-data-prototype=name_space}, tlv-data-id=1}
        {data-prototype=DiagnosticDataDistribution_RPort_DrivingStatistics.dataValuesHash, element-in-impl-datatype={root-data-prototype=dataValuesHash, target-data-prototype=category}, tlv-data-id=2}
        {data-prototype=DiagnosticDataDistribution_RPort_DrivingStatistics.dataValuesHash, element-in-impl-datatype={root-data-prototype=dataValuesHash, target-data-prototype=hashValue}, tlv-data-id=3}
        {data-prototype=DiagnosticDataDistribution_RPort_Speed.dataValuesHash, element-in-impl-datatype={root-data-prototype=dataValuesHash, target-data-prototype=name_space}, tlv-data-id=1}
        {data-prototype=DiagnosticDataDistribution_RPort_Speed.dataValuesHash, element-in-impl-datatype={root-data-prototype=dataValuesHash, target-data-prototype=category}, tlv-data-id=2}
        {data-prototype=DiagnosticDataDistribution_RPort_Speed.dataValuesHash, element-in-impl-datatype={root-data-prototype=dataValuesHash, target-data-prototype=hashValue}, tlv-data-id=3}
        {data-prototype=DiagnosticDataDistribution_RPort_UnitMaster.dataValuesHash, element-in-impl-datatype={root-data-prototype=dataValuesHash, target-data-prototype=name_space}, tlv-data-id=1}
        {data-prototype=DiagnosticDataDistribution_RPort_UnitMaster.dataValuesHash, element-in-impl-datatype={root-data-prototype=dataValuesHash, target-data-prototype=category}, tlv-data-id=2}
        {data-prototype=DiagnosticDataDistribution_RPort_UnitMaster.dataValuesHash, element-in-impl-datatype={root-data-prototype=dataValuesHash, target-data-prototype=hashValue}, tlv-data-id=3}
        {data-prototype=DiagnosticDataDistribution_RPort_Temperature.dataValuesHash, element-in-impl-datatype={root-data-prototype=dataValuesHash, target-data-prototype=name_space}, tlv-data-id=1}
        {data-prototype=DiagnosticDataDistribution_RPort_Temperature.dataValuesHash, element-in-impl-datatype={root-data-prototype=dataValuesHash, target-data-prototype=category}, tlv-data-id=2}
        {data-prototype=DiagnosticDataDistribution_RPort_Temperature.dataValuesHash, element-in-impl-datatype={root-data-prototype=dataValuesHash, target-data-prototype=hashValue}, tlv-data-id=3}
        {data-prototype=DiagnosticDataDistribution_RPort_TripComputer.dataValuesHash, element-in-impl-datatype={root-data-prototype=dataValuesHash, target-data-prototype=name_space}, tlv-data-id=1}
        {data-prototype=DiagnosticDataDistribution_RPort_TripComputer.dataValuesHash, element-in-impl-datatype={root-data-prototype=dataValuesHash, target-data-prototype=category}, tlv-data-id=2}
        {data-prototype=DiagnosticDataDistribution_RPort_TripComputer.dataValuesHash, element-in-impl-datatype={root-data-prototype=dataValuesHash, target-data-prototype=hashValue}, tlv-data-id=3}
    ElectricalConsumptions_TLV
      data-prototypes:
        {data-prototype=ElectricalConsumptions_PPort_ElectricalConsumptions.averageConsumptions, element-in-impl-datatype={root-data-prototype=averageConsumptions, target-data-prototype=memoryLevel}, tlv-data-id=0}
        {data-prototype=ElectricalConsumptions_PPort_ElectricalConsumptions.averageConsumptions, element-in-impl-datatype={root-data-prototype=averageConsumptions, target-data-prototype=physicalValue}, tlv-data-id=1}
        {data-prototype=ElectricalConsumptions_PPort_ElectricalConsumptions.averageConsumptions, element-in-impl-datatype={root-data-prototype=averageConsumptions, target-data-prototype=state}, tlv-data-id=2}
        {data-prototype=ElectricalConsumptions_PPort_ElectricalConsumptions.currentConsumptions, element-in-impl-datatype={root-data-prototype=currentConsumptions, target-data-prototype=type}, tlv-data-id=0}
        {data-prototype=ElectricalConsumptions_PPort_ElectricalConsumptions.currentConsumptions, element-in-impl-datatype={root-data-prototype=currentConsumptions, target-data-prototype=physicalValue}, tlv-data-id=1}
        {data-prototype=ElectricalConsumptions_PPort_ElectricalConsumptions.currentConsumptions, element-in-impl-datatype={root-data-prototype=currentConsumptions, target-data-prototype=state}, tlv-data-id=2}
        {data-prototype=ElectricalConsumptions_RPort_TripComputer.averageConsumptions, element-in-impl-datatype={root-data-prototype=averageConsumptions, target-data-prototype=memoryLevel}, tlv-data-id=0}
        {data-prototype=ElectricalConsumptions_RPort_TripComputer.averageConsumptions, element-in-impl-datatype={root-data-prototype=averageConsumptions, target-data-prototype=physicalValue}, tlv-data-id=1}
        {data-prototype=ElectricalConsumptions_RPort_TripComputer.averageConsumptions, element-in-impl-datatype={root-data-prototype=averageConsumptions, target-data-prototype=state}, tlv-data-id=2}
        {data-prototype=ElectricalConsumptions_RPort_TripComputer.currentConsumptions, element-in-impl-datatype={root-data-prototype=currentConsumptions, target-data-prototype=type}, tlv-data-id=0}
        {data-prototype=ElectricalConsumptions_RPort_TripComputer.currentConsumptions, element-in-impl-datatype={root-data-prototype=currentConsumptions, target-data-prototype=physicalValue}, tlv-data-id=1}
        {data-prototype=ElectricalConsumptions_RPort_TripComputer.currentConsumptions, element-in-impl-datatype={root-data-prototype=currentConsumptions, target-data-prototype=state}, tlv-data-id=2}
    Engine_TLV
      data-prototypes:
        {data-prototype=Engine_RPort_Telltale.powerMeterParameters, element-in-impl-datatype={root-data-prototype=powerMeterParameters, target-data-prototype=type}, tlv-data-id=0}
        {data-prototype=Engine_RPort_Telltale.powerMeterParameters, element-in-impl-datatype={root-data-prototype=powerMeterParameters, target-data-prototype=physicalValue}, tlv-data-id=1}
        {data-prototype=Engine_RPort_Telltale.powerMeterParameters, element-in-impl-datatype={root-data-prototype=powerMeterParameters, target-data-prototype=valueType}, tlv-data-id=2}
        {data-prototype=Engine_RPort_Telltale.electricPerformanceCharacteristics, element-in-impl-datatype={root-data-prototype=electricPerformanceCharacteristics, target-data-prototype=electricPerformancePhysicalValue}, tlv-data-id=0}
        {data-prototype=Engine_RPort_Telltale.electricPerformanceCharacteristics, element-in-impl-datatype={root-data-prototype=electricPerformanceCharacteristics, target-data-prototype=electricPerformanceLogicalValue}, tlv-data-id=1}
        {data-prototype=Engine_RPort_Telltale.electricPerformanceCharacteristics, element-in-impl-datatype={root-data-prototype=electricPerformanceCharacteristics, target-data-prototype=electricPerformanceValueType}, tlv-data-id=2}
        {data-prototype=Engine_RPort_Telltale.electricPerformanceCharacteristics, element-in-impl-datatype={root-data-prototype=electricPerformanceCharacteristics, target-data-prototype=isTurtleModeLampActivated}, tlv-data-id=3}
        {data-prototype=Engine_RPort_Telltale.engineInformation, element-in-impl-datatype={root-data-prototype=engineInformation, target-data-prototype=engineType}, tlv-data-id=0}
        {data-prototype=Engine_RPort_Telltale.notifications, element-in-impl-datatype={root-data-prototype=notifications, target-data-prototype=type}, tlv-data-id=0}
        {data-prototype=Engine_RPort_Telltale.notifications, element-in-impl-datatype={root-data-prototype=notifications, target-data-prototype=value}, tlv-data-id=1}
    EnvironmentalSensorData_TLV
      data-prototypes:
        {data-prototype=EnvironmentalSensorData_RPort_Temperature.sensorData, element-in-impl-datatype={root-data-prototype=sensorData, target-data-prototype=elementId}, tlv-data-id=0}
        {data-prototype=EnvironmentalSensorData_RPort_Temperature.sensorData, element-in-impl-datatype={root-data-prototype=sensorData, target-data-prototype=outdoorRawTemperature}, tlv-data-id=1}
        {data-prototype=EnvironmentalSensorData_RPort_Temperature.sensorData, element-in-impl-datatype={root-data-prototype=sensorData, target-data-prototype=outdoorRawTemperatureLogicalValue}, tlv-data-id=2}
        {data-prototype=EnvironmentalSensorData_RPort_Temperature.sensorData, element-in-impl-datatype={root-data-prototype=sensorData, target-data-prototype=outdoorRawTemperatureValueType}, tlv-data-id=3}
        {data-prototype=EnvironmentalSensorData_RPort_Temperature.sensorData, element-in-impl-datatype={root-data-prototype=sensorData, target-data-prototype=status}, tlv-data-id=4}
    ExteriorLight_TLV
      data-prototypes:
        {data-prototype=ExteriorLight_RPort_Telltale.lightFunctions, element-in-impl-datatype={root-data-prototype=lightFunctions, target-data-prototype=functionIdentifier}, tlv-data-id=0}
        {data-prototype=ExteriorLight_RPort_Telltale.lightFunctions, element-in-impl-datatype={root-data-prototype=lightFunctions, target-data-prototype=isActivated}, tlv-data-id=1}
        {data-prototype=ExteriorLight_RPort_Telltale.lightFunctionControls, element-in-impl-datatype={root-data-prototype=lightFunctionControls, target-data-prototype=id}, tlv-data-id=0}
        {data-prototype=ExteriorLight_RPort_Telltale.lightFunctionControls, element-in-impl-datatype={root-data-prototype=lightFunctionControls, target-data-prototype=functionIdentifier}, tlv-data-id=1}
        {data-prototype=ExteriorLight_RPort_Telltale.lightFunctionControls, element-in-impl-datatype={root-data-prototype=lightFunctionControls, target-data-prototype=requestedLightState}, tlv-data-id=2}
        {data-prototype=ExteriorLight_RPort_Telltale.lightFunctionControls, element-in-impl-datatype={root-data-prototype=lightFunctionControls, target-data-prototype=requester}, tlv-data-id=3}
        {data-prototype=ExteriorLight_RPort_Telltale.lamps, element-in-impl-datatype={root-data-prototype=lamps, target-data-prototype=lampIdentifier}, tlv-data-id=0}
        {data-prototype=ExteriorLight_RPort_Telltale.lamps, element-in-impl-datatype={root-data-prototype=lamps, target-data-prototype=isBroken}, tlv-data-id=1}
        {data-prototype=ExteriorLight_RPort_Telltale.notifications, element-in-impl-datatype={root-data-prototype=notifications, target-data-prototype=type}, tlv-data-id=0}
        {data-prototype=ExteriorLight_RPort_Telltale.notifications, element-in-impl-datatype={root-data-prototype=notifications, target-data-prototype=value}, tlv-data-id=1}
        {data-prototype=ExteriorLight_RPort_Telltale.info, element-in-impl-datatype={root-data-prototype=info, target-data-prototype=elementId}, tlv-data-id=0}
        {data-prototype=ExteriorLight_RPort_Telltale.info, element-in-impl-datatype={root-data-prototype=info, target-data-prototype=darknessIndication}, tlv-data-id=1}
        {data-prototype=ExteriorLight_RPort_Telltale.lightButtonModules, element-in-impl-datatype={root-data-prototype=lightButtonModules, target-data-prototype=elementId}, tlv-data-id=0}
        {data-prototype=ExteriorLight_RPort_Telltale.lightButtonModules, element-in-impl-datatype={root-data-prototype=lightButtonModules, target-data-prototype=popUpRequest}, tlv-data-id=1}
        {data-prototype=ExteriorLight_RPort_Telltale.lightButtonModules, element-in-impl-datatype={root-data-prototype=lightButtonModules, target-data-prototype=popUpContent}, tlv-data-id=2}
        {data-prototype=ExteriorLight_RPort_Telltale.lightButtonModules, element-in-impl-datatype={root-data-prototype=lightButtonModules, target-data-prototype=activeFunction}, tlv-data-id=3}
    ExteriorSound_TLV
      data-prototypes:
        {data-prototype=ExteriorSound_RPort_Telltale.notifications, element-in-impl-datatype={root-data-prototype=notifications, target-data-prototype=type}, tlv-data-id=0}
        {data-prototype=ExteriorSound_RPort_Telltale.notifications, element-in-impl-datatype={root-data-prototype=notifications, target-data-prototype=value}, tlv-data-id=1}
    EnergySystem_TLV
      data-prototypes:
        {data-prototype=EnergySystem_RPort_ElectricalConsumptions.notifications, element-in-impl-datatype={root-data-prototype=notifications, target-data-prototype=type}, tlv-data-id=0}
        {data-prototype=EnergySystem_RPort_ElectricalConsumptions.notifications, element-in-impl-datatype={root-data-prototype=notifications, target-data-prototype=value}, tlv-data-id=1}
        {data-prototype=EnergySystem_RPort_ElectricalConsumptions.highVoltageBatteries, element-in-impl-datatype={root-data-prototype=highVoltageBatteries, target-data-prototype=elementId}, tlv-data-id=0}
        {data-prototype=EnergySystem_RPort_ElectricalConsumptions.highVoltageBatteries, element-in-impl-datatype={root-data-prototype=highVoltageBatteries, target-data-prototype=relativeChargingStatePhysicalValue}, tlv-data-id=1}
        {data-prototype=EnergySystem_RPort_ElectricalConsumptions.highVoltageBatteries, element-in-impl-datatype={root-data-prototype=highVoltageBatteries, target-data-prototype=relativeChargingStateValueType}, tlv-data-id=2}
        {data-prototype=EnergySystem_RPort_ElectricalConsumptions.highVoltageBatteries, element-in-impl-datatype={root-data-prototype=highVoltageBatteries, target-data-prototype=isLoadingActive}, tlv-data-id=3}
        {data-prototype=EnergySystem_RPort_ElectricalConsumptions.lowVoltageBatteries, element-in-impl-datatype={root-data-prototype=lowVoltageBatteries, target-data-prototype=elementId}, tlv-data-id=0}
        {data-prototype=EnergySystem_RPort_ElectricalConsumptions.lowVoltageBatteries, element-in-impl-datatype={root-data-prototype=lowVoltageBatteries, target-data-prototype=relativeChargingStatePhysicalValue}, tlv-data-id=1}
        {data-prototype=EnergySystem_RPort_ElectricalConsumptions.lowVoltageBatteries, element-in-impl-datatype={root-data-prototype=lowVoltageBatteries, target-data-prototype=relativeChargingStateValueType}, tlv-data-id=2}
        {data-prototype=EnergySystem_RPort_ElectricalConsumptions.lowVoltageSystemInfo, element-in-impl-datatype={root-data-prototype=lowVoltageSystemInfo, target-data-prototype=elementId}, tlv-data-id=0}
        {data-prototype=EnergySystem_RPort_ElectricalConsumptions.lowVoltageSystemInfo, element-in-impl-datatype={root-data-prototype=lowVoltageSystemInfo, target-data-prototype=consumption}, tlv-data-id=1}
        {data-prototype=EnergySystem_RPort_ElectricalConsumptions.lowVoltageSystemInfo, element-in-impl-datatype={root-data-prototype=lowVoltageSystemInfo, target-data-prototype=consumptionHasOverflowed}, tlv-data-id=2}
        {data-prototype=EnergySystem_RPort_TripComputer.notifications, element-in-impl-datatype={root-data-prototype=notifications, target-data-prototype=type}, tlv-data-id=0}
        {data-prototype=EnergySystem_RPort_TripComputer.notifications, element-in-impl-datatype={root-data-prototype=notifications, target-data-prototype=value}, tlv-data-id=1}
        {data-prototype=EnergySystem_RPort_TripComputer.highVoltageBatteries, element-in-impl-datatype={root-data-prototype=highVoltageBatteries, target-data-prototype=elementId}, tlv-data-id=0}
        {data-prototype=EnergySystem_RPort_TripComputer.highVoltageBatteries, element-in-impl-datatype={root-data-prototype=highVoltageBatteries, target-data-prototype=relativeChargingStatePhysicalValue}, tlv-data-id=1}
        {data-prototype=EnergySystem_RPort_TripComputer.highVoltageBatteries, element-in-impl-datatype={root-data-prototype=highVoltageBatteries, target-data-prototype=relativeChargingStateValueType}, tlv-data-id=2}
        {data-prototype=EnergySystem_RPort_TripComputer.highVoltageBatteries, element-in-impl-datatype={root-data-prototype=highVoltageBatteries, target-data-prototype=isLoadingActive}, tlv-data-id=3}
        {data-prototype=EnergySystem_RPort_TripComputer.lowVoltageBatteries, element-in-impl-datatype={root-data-prototype=lowVoltageBatteries, target-data-prototype=elementId}, tlv-data-id=0}
        {data-prototype=EnergySystem_RPort_TripComputer.lowVoltageBatteries, element-in-impl-datatype={root-data-prototype=lowVoltageBatteries, target-data-prototype=relativeChargingStatePhysicalValue}, tlv-data-id=1}
        {data-prototype=EnergySystem_RPort_TripComputer.lowVoltageBatteries, element-in-impl-datatype={root-data-prototype=lowVoltageBatteries, target-data-prototype=relativeChargingStateValueType}, tlv-data-id=2}
        {data-prototype=EnergySystem_RPort_TripComputer.lowVoltageSystemInfo, element-in-impl-datatype={root-data-prototype=lowVoltageSystemInfo, target-data-prototype=elementId}, tlv-data-id=0}
        {data-prototype=EnergySystem_RPort_TripComputer.lowVoltageSystemInfo, element-in-impl-datatype={root-data-prototype=lowVoltageSystemInfo, target-data-prototype=consumption}, tlv-data-id=1}
        {data-prototype=EnergySystem_RPort_TripComputer.lowVoltageSystemInfo, element-in-impl-datatype={root-data-prototype=lowVoltageSystemInfo, target-data-prototype=consumptionHasOverflowed}, tlv-data-id=2}
        {data-prototype=EnergySystem_RPort_SoC.notifications, element-in-impl-datatype={root-data-prototype=notifications, target-data-prototype=type}, tlv-data-id=0}
        {data-prototype=EnergySystem_RPort_SoC.notifications, element-in-impl-datatype={root-data-prototype=notifications, target-data-prototype=value}, tlv-data-id=1}
        {data-prototype=EnergySystem_RPort_SoC.highVoltageBatteries, element-in-impl-datatype={root-data-prototype=highVoltageBatteries, target-data-prototype=elementId}, tlv-data-id=0}
        {data-prototype=EnergySystem_RPort_SoC.highVoltageBatteries, element-in-impl-datatype={root-data-prototype=highVoltageBatteries, target-data-prototype=relativeChargingStatePhysicalValue}, tlv-data-id=1}
        {data-prototype=EnergySystem_RPort_SoC.highVoltageBatteries, element-in-impl-datatype={root-data-prototype=highVoltageBatteries, target-data-prototype=relativeChargingStateValueType}, tlv-data-id=2}
        {data-prototype=EnergySystem_RPort_SoC.highVoltageBatteries, element-in-impl-datatype={root-data-prototype=highVoltageBatteries, target-data-prototype=isLoadingActive}, tlv-data-id=3}
        {data-prototype=EnergySystem_RPort_SoC.lowVoltageBatteries, element-in-impl-datatype={root-data-prototype=lowVoltageBatteries, target-data-prototype=elementId}, tlv-data-id=0}
        {data-prototype=EnergySystem_RPort_SoC.lowVoltageBatteries, element-in-impl-datatype={root-data-prototype=lowVoltageBatteries, target-data-prototype=relativeChargingStatePhysicalValue}, tlv-data-id=1}
        {data-prototype=EnergySystem_RPort_SoC.lowVoltageBatteries, element-in-impl-datatype={root-data-prototype=lowVoltageBatteries, target-data-prototype=relativeChargingStateValueType}, tlv-data-id=2}
        {data-prototype=EnergySystem_RPort_SoC.lowVoltageSystemInfo, element-in-impl-datatype={root-data-prototype=lowVoltageSystemInfo, target-data-prototype=elementId}, tlv-data-id=0}
        {data-prototype=EnergySystem_RPort_SoC.lowVoltageSystemInfo, element-in-impl-datatype={root-data-prototype=lowVoltageSystemInfo, target-data-prototype=consumption}, tlv-data-id=1}
        {data-prototype=EnergySystem_RPort_SoC.lowVoltageSystemInfo, element-in-impl-datatype={root-data-prototype=lowVoltageSystemInfo, target-data-prototype=consumptionHasOverflowed}, tlv-data-id=2}
    HighVoltageCoordinator_TLV
      data-prototypes:
        {data-prototype=HighVoltageCoordinator_RPort_Telltale.notifications, element-in-impl-datatype={root-data-prototype=notifications, target-data-prototype=type}, tlv-data-id=0}
        {data-prototype=HighVoltageCoordinator_RPort_Telltale.notifications, element-in-impl-datatype={root-data-prototype=notifications, target-data-prototype=value}, tlv-data-id=1}
    Immobilizer_TLV
      data-prototypes:
        {data-prototype=Immobilizer_RPort_Telltale.info, element-in-impl-datatype={root-data-prototype=info, target-data-prototype=elementId}, tlv-data-id=0}
        {data-prototype=Immobilizer_RPort_Telltale.info, element-in-impl-datatype={root-data-prototype=info, target-data-prototype=learningKeyValue}, tlv-data-id=1}
        {data-prototype=Immobilizer_RPort_Telltale.info, element-in-impl-datatype={root-data-prototype=info, target-data-prototype=learnedKeyValue}, tlv-data-id=2}
        {data-prototype=Immobilizer_RPort_Telltale.info, element-in-impl-datatype={root-data-prototype=info, target-data-prototype=isLocked}, tlv-data-id=3}
        {data-prototype=Immobilizer_RPort_Telltale.info, element-in-impl-datatype={root-data-prototype=info, target-data-prototype=stateOfLife}, tlv-data-id=4}
        {data-prototype=Immobilizer_RPort_Telltale.notifications, element-in-impl-datatype={root-data-prototype=notifications, target-data-prototype=type}, tlv-data-id=0}
        {data-prototype=Immobilizer_RPort_Telltale.notifications, element-in-impl-datatype={root-data-prototype=notifications, target-data-prototype=value}, tlv-data-id=1}
    Odometry_TLV
      data-prototypes:
        {data-prototype=Odometry_RPort_DrivingStatistics.velocities, element-in-impl-datatype={root-data-prototype=velocities, target-data-prototype=type}, tlv-data-id=0}
        {data-prototype=Odometry_RPort_DrivingStatistics.velocities, element-in-impl-datatype={root-data-prototype=velocities, target-data-prototype=physicalValue}, tlv-data-id=1}
        {data-prototype=Odometry_RPort_DrivingStatistics.velocities, element-in-impl-datatype={root-data-prototype=velocities, target-data-prototype=valueType}, tlv-data-id=2}
        {data-prototype=Odometry_RPort_DrivingStatistics.velocities, element-in-impl-datatype={root-data-prototype=velocities, target-data-prototype=unit}, tlv-data-id=3}
        {data-prototype=Odometry_RPort_DrivingStatistics.motion, element-in-impl-datatype={root-data-prototype=motion, target-data-prototype=type}, tlv-data-id=0}
        {data-prototype=Odometry_RPort_DrivingStatistics.motion, element-in-impl-datatype={root-data-prototype=motion, target-data-prototype=accelerationVarianceX}, tlv-data-id=1}
        {data-prototype=Odometry_RPort_DrivingStatistics.motion, element-in-impl-datatype={root-data-prototype=motion, target-data-prototype=accelerationVarianceY}, tlv-data-id=2}
        {data-prototype=Odometry_RPort_DrivingStatistics.motion, element-in-impl-datatype={root-data-prototype=motion, target-data-prototype=accelerationX}, tlv-data-id=3}
        {data-prototype=Odometry_RPort_DrivingStatistics.motion, element-in-impl-datatype={root-data-prototype=motion, target-data-prototype=type}, tlv-data-id=0}
        {data-prototype=Odometry_RPort_DrivingStatistics.motion, element-in-impl-datatype={root-data-prototype=motion, target-data-prototype=accelerationVarianceX}, tlv-data-id=1}
        {data-prototype=Odometry_RPort_DrivingStatistics.motion, element-in-impl-datatype={root-data-prototype=motion, target-data-prototype=accelerationVarianceY}, tlv-data-id=2}
        {data-prototype=Odometry_RPort_DrivingStatistics.motion, element-in-impl-datatype={root-data-prototype=motion, target-data-prototype=accelerationX}, tlv-data-id=3}
        {data-prototype=Odometry_RPort_DrivingStatistics.motion, element-in-impl-datatype={root-data-prototype=motion, target-data-prototype=accelerationXConfidence}, tlv-data-id=4}
        {data-prototype=Odometry_RPort_DrivingStatistics.motion, element-in-impl-datatype={root-data-prototype=motion, target-data-prototype=accelerationY}, tlv-data-id=5}
        {data-prototype=Odometry_RPort_DrivingStatistics.motion, element-in-impl-datatype={root-data-prototype=motion, target-data-prototype=accelerationYConfidence}, tlv-data-id=6}
        {data-prototype=Odometry_RPort_DrivingStatistics.motion, element-in-impl-datatype={root-data-prototype=motion, target-data-prototype=estimatorRange}, tlv-data-id=7}
        {data-prototype=Odometry_RPort_DrivingStatistics.motion, element-in-impl-datatype={root-data-prototype=motion, target-data-prototype=estimatorRangeConfidence}, tlv-data-id=8}
        {data-prototype=Odometry_RPort_DrivingStatistics.motion, element-in-impl-datatype={root-data-prototype=motion, target-data-prototype=velocityVarianceX}, tlv-data-id=9}
        {data-prototype=Odometry_RPort_DrivingStatistics.motion, element-in-impl-datatype={root-data-prototype=motion, target-data-prototype=velocityVarianceY}, tlv-data-id=10}
        {data-prototype=Odometry_RPort_DrivingStatistics.motion, element-in-impl-datatype={root-data-prototype=motion, target-data-prototype=velocityX}, tlv-data-id=11}
        {data-prototype=Odometry_RPort_DrivingStatistics.motion, element-in-impl-datatype={root-data-prototype=motion, target-data-prototype=velocityXConfidence}, tlv-data-id=12}
        {data-prototype=Odometry_RPort_DrivingStatistics.motion, element-in-impl-datatype={root-data-prototype=motion, target-data-prototype=velocityY}, tlv-data-id=13}
        {data-prototype=Odometry_RPort_DrivingStatistics.motion, element-in-impl-datatype={root-data-prototype=motion, target-data-prototype=velocityYConfidence}, tlv-data-id=14}
        {data-prototype=Odometry_RPort_DrivingStatistics.motion, element-in-impl-datatype={root-data-prototype=motion, target-data-prototype=yawRate}, tlv-data-id=15}
        {data-prototype=Odometry_RPort_DrivingStatistics.motion, element-in-impl-datatype={root-data-prototype=motion, target-data-prototype=yawRateConfidence}, tlv-data-id=16}
        {data-prototype=Odometry_RPort_DrivingStatistics.motion, element-in-impl-datatype={root-data-prototype=motion, target-data-prototype=yawRateVariance}, tlv-data-id=17}
        {data-prototype=Odometry_RPort_DrivingStatistics.motion, element-in-impl-datatype={root-data-prototype=motion, target-data-prototype=timestamp}, tlv-data-id=18}
        {data-prototype=Odometry_RPort_DrivingStatistics.motion, element-in-impl-datatype={root-data-prototype=motion, target-data-prototype=altitude}, tlv-data-id=19}
        {data-prototype=Odometry_RPort_DrivingStatistics.motion, element-in-impl-datatype={root-data-prototype=motion, target-data-prototype=altitudeConfidence}, tlv-data-id=20}
        {data-prototype=Odometry_RPort_DrivingStatistics.motion, element-in-impl-datatype={root-data-prototype=motion, target-data-prototype=heading}, tlv-data-id=21}
        {data-prototype=Odometry_RPort_DrivingStatistics.motion, element-in-impl-datatype={root-data-prototype=motion, target-data-prototype=headingConfidence}, tlv-data-id=22}
        {data-prototype=Odometry_RPort_DrivingStatistics.motion, element-in-impl-datatype={root-data-prototype=motion, target-data-prototype=positionX}, tlv-data-id=23}
        {data-prototype=Odometry_RPort_DrivingStatistics.motion, element-in-impl-datatype={root-data-prototype=motion, target-data-prototype=positionXConfidence}, tlv-data-id=24}
        {data-prototype=Odometry_RPort_DrivingStatistics.motion, element-in-impl-datatype={root-data-prototype=motion, target-data-prototype=positionXDeltaVariance}, tlv-data-id=25}
        {data-prototype=Odometry_RPort_DrivingStatistics.motion, element-in-impl-datatype={root-data-prototype=motion, target-data-prototype=positionY}, tlv-data-id=26}
        {data-prototype=Odometry_RPort_DrivingStatistics.motion, element-in-impl-datatype={root-data-prototype=motion, target-data-prototype=positionYConfidence}, tlv-data-id=27}
        {data-prototype=Odometry_RPort_DrivingStatistics.motion, element-in-impl-datatype={root-data-prototype=motion, target-data-prototype=positionYDeltaVariance}, tlv-data-id=28}
        {data-prototype=Odometry_RPort_DrivingStatistics.motion, element-in-impl-datatype={root-data-prototype=motion, target-data-prototype=standStillPRange}, tlv-data-id=29}
        {data-prototype=Odometry_RPort_DrivingStatistics.motion, element-in-impl-datatype={root-data-prototype=motion, target-data-prototype=standStillPRangeConfidence}, tlv-data-id=30}
        {data-prototype=Odometry_RPort_DrivingStatistics.motion, element-in-impl-datatype={root-data-prototype=motion, target-data-prototype=yawAngle}, tlv-data-id=31}
        {data-prototype=Odometry_RPort_DrivingStatistics.motion, element-in-impl-datatype={root-data-prototype=motion, target-data-prototype=yawAngleConfidence}, tlv-data-id=32}
        {data-prototype=Odometry_RPort_DrivingStatistics.motion, element-in-impl-datatype={root-data-prototype=motion, target-data-prototype=yawAngleDeltaVariance}, tlv-data-id=33}
        {data-prototype=Odometry_RPort_DrivingStatistics.motion, element-in-impl-datatype={root-data-prototype=motion, target-data-prototype=drivingDirectionPRange}, tlv-data-id=34}
        {data-prototype=Odometry_RPort_DrivingStatistics.motion, element-in-impl-datatype={root-data-prototype=motion, target-data-prototype=drivingDirectionPRangeConfidence}, tlv-data-id=35}
        {data-prototype=Odometry_RPort_Speed.velocities, element-in-impl-datatype={root-data-prototype=velocities, target-data-prototype=type}, tlv-data-id=0}
        {data-prototype=Odometry_RPort_Speed.velocities, element-in-impl-datatype={root-data-prototype=velocities, target-data-prototype=physicalValue}, tlv-data-id=1}
        {data-prototype=Odometry_RPort_Speed.velocities, element-in-impl-datatype={root-data-prototype=velocities, target-data-prototype=valueType}, tlv-data-id=2}
        {data-prototype=Odometry_RPort_Speed.velocities, element-in-impl-datatype={root-data-prototype=velocities, target-data-prototype=unit}, tlv-data-id=3}
        {data-prototype=Odometry_RPort_Speed.motion, element-in-impl-datatype={root-data-prototype=motion, target-data-prototype=type}, tlv-data-id=0}
        {data-prototype=Odometry_RPort_Speed.motion, element-in-impl-datatype={root-data-prototype=motion, target-data-prototype=accelerationVarianceX}, tlv-data-id=1}
        {data-prototype=Odometry_RPort_Speed.motion, element-in-impl-datatype={root-data-prototype=motion, target-data-prototype=accelerationVarianceY}, tlv-data-id=2}
        {data-prototype=Odometry_RPort_Speed.motion, element-in-impl-datatype={root-data-prototype=motion, target-data-prototype=accelerationX}, tlv-data-id=3}
        {data-prototype=Odometry_RPort_Speed.motion, element-in-impl-datatype={root-data-prototype=motion, target-data-prototype=type}, tlv-data-id=0}
        {data-prototype=Odometry_RPort_Speed.motion, element-in-impl-datatype={root-data-prototype=motion, target-data-prototype=accelerationVarianceX}, tlv-data-id=1}
        {data-prototype=Odometry_RPort_Speed.motion, element-in-impl-datatype={root-data-prototype=motion, target-data-prototype=accelerationVarianceY}, tlv-data-id=2}
        {data-prototype=Odometry_RPort_Speed.motion, element-in-impl-datatype={root-data-prototype=motion, target-data-prototype=accelerationX}, tlv-data-id=3}
        {data-prototype=Odometry_RPort_Speed.motion, element-in-impl-datatype={root-data-prototype=motion, target-data-prototype=accelerationXConfidence}, tlv-data-id=4}
        {data-prototype=Odometry_RPort_Speed.motion, element-in-impl-datatype={root-data-prototype=motion, target-data-prototype=accelerationY}, tlv-data-id=5}
        {data-prototype=Odometry_RPort_Speed.motion, element-in-impl-datatype={root-data-prototype=motion, target-data-prototype=accelerationYConfidence}, tlv-data-id=6}
        {data-prototype=Odometry_RPort_Speed.motion, element-in-impl-datatype={root-data-prototype=motion, target-data-prototype=estimatorRange}, tlv-data-id=7}
        {data-prototype=Odometry_RPort_Speed.motion, element-in-impl-datatype={root-data-prototype=motion, target-data-prototype=estimatorRangeConfidence}, tlv-data-id=8}
        {data-prototype=Odometry_RPort_Speed.motion, element-in-impl-datatype={root-data-prototype=motion, target-data-prototype=velocityVarianceX}, tlv-data-id=9}
        {data-prototype=Odometry_RPort_Speed.motion, element-in-impl-datatype={root-data-prototype=motion, target-data-prototype=velocityVarianceY}, tlv-data-id=10}
        {data-prototype=Odometry_RPort_Speed.motion, element-in-impl-datatype={root-data-prototype=motion, target-data-prototype=velocityX}, tlv-data-id=11}
        {data-prototype=Odometry_RPort_Speed.motion, element-in-impl-datatype={root-data-prototype=motion, target-data-prototype=velocityXConfidence}, tlv-data-id=12}
        {data-prototype=Odometry_RPort_Speed.motion, element-in-impl-datatype={root-data-prototype=motion, target-data-prototype=velocityY}, tlv-data-id=13}
        {data-prototype=Odometry_RPort_Speed.motion, element-in-impl-datatype={root-data-prototype=motion, target-data-prototype=velocityYConfidence}, tlv-data-id=14}
        {data-prototype=Odometry_RPort_Speed.motion, element-in-impl-datatype={root-data-prototype=motion, target-data-prototype=yawRate}, tlv-data-id=15}
        {data-prototype=Odometry_RPort_Speed.motion, element-in-impl-datatype={root-data-prototype=motion, target-data-prototype=yawRateConfidence}, tlv-data-id=16}
        {data-prototype=Odometry_RPort_Speed.motion, element-in-impl-datatype={root-data-prototype=motion, target-data-prototype=yawRateVariance}, tlv-data-id=17}
        {data-prototype=Odometry_RPort_Speed.motion, element-in-impl-datatype={root-data-prototype=motion, target-data-prototype=timestamp}, tlv-data-id=18}
        {data-prototype=Odometry_RPort_Speed.motion, element-in-impl-datatype={root-data-prototype=motion, target-data-prototype=altitude}, tlv-data-id=19}
        {data-prototype=Odometry_RPort_Speed.motion, element-in-impl-datatype={root-data-prototype=motion, target-data-prototype=altitudeConfidence}, tlv-data-id=20}
        {data-prototype=Odometry_RPort_Speed.motion, element-in-impl-datatype={root-data-prototype=motion, target-data-prototype=heading}, tlv-data-id=21}
        {data-prototype=Odometry_RPort_Speed.motion, element-in-impl-datatype={root-data-prototype=motion, target-data-prototype=headingConfidence}, tlv-data-id=22}
        {data-prototype=Odometry_RPort_Speed.motion, element-in-impl-datatype={root-data-prototype=motion, target-data-prototype=positionX}, tlv-data-id=23}
        {data-prototype=Odometry_RPort_Speed.motion, element-in-impl-datatype={root-data-prototype=motion, target-data-prototype=positionXConfidence}, tlv-data-id=24}
        {data-prototype=Odometry_RPort_Speed.motion, element-in-impl-datatype={root-data-prototype=motion, target-data-prototype=positionXDeltaVariance}, tlv-data-id=25}
        {data-prototype=Odometry_RPort_Speed.motion, element-in-impl-datatype={root-data-prototype=motion, target-data-prototype=positionY}, tlv-data-id=26}
        {data-prototype=Odometry_RPort_Speed.motion, element-in-impl-datatype={root-data-prototype=motion, target-data-prototype=positionYConfidence}, tlv-data-id=27}
        {data-prototype=Odometry_RPort_Speed.motion, element-in-impl-datatype={root-data-prototype=motion, target-data-prototype=positionYDeltaVariance}, tlv-data-id=28}
        {data-prototype=Odometry_RPort_Speed.motion, element-in-impl-datatype={root-data-prototype=motion, target-data-prototype=standStillPRange}, tlv-data-id=29}
        {data-prototype=Odometry_RPort_Speed.motion, element-in-impl-datatype={root-data-prototype=motion, target-data-prototype=standStillPRangeConfidence}, tlv-data-id=30}
        {data-prototype=Odometry_RPort_Speed.motion, element-in-impl-datatype={root-data-prototype=motion, target-data-prototype=yawAngle}, tlv-data-id=31}
        {data-prototype=Odometry_RPort_Speed.motion, element-in-impl-datatype={root-data-prototype=motion, target-data-prototype=yawAngleConfidence}, tlv-data-id=32}
        {data-prototype=Odometry_RPort_Speed.motion, element-in-impl-datatype={root-data-prototype=motion, target-data-prototype=yawAngleDeltaVariance}, tlv-data-id=33}
        {data-prototype=Odometry_RPort_Speed.motion, element-in-impl-datatype={root-data-prototype=motion, target-data-prototype=drivingDirectionPRange}, tlv-data-id=34}
        {data-prototype=Odometry_RPort_Speed.motion, element-in-impl-datatype={root-data-prototype=motion, target-data-prototype=drivingDirectionPRangeConfidence}, tlv-data-id=35}
        {data-prototype=Odometry_RPort_Temperature.velocities, element-in-impl-datatype={root-data-prototype=velocities, target-data-prototype=type}, tlv-data-id=0}
        {data-prototype=Odometry_RPort_Temperature.velocities, element-in-impl-datatype={root-data-prototype=velocities, target-data-prototype=physicalValue}, tlv-data-id=1}
        {data-prototype=Odometry_RPort_Temperature.velocities, element-in-impl-datatype={root-data-prototype=velocities, target-data-prototype=valueType}, tlv-data-id=2}
        {data-prototype=Odometry_RPort_Temperature.velocities, element-in-impl-datatype={root-data-prototype=velocities, target-data-prototype=unit}, tlv-data-id=3}
        {data-prototype=Odometry_RPort_Temperature.motion, element-in-impl-datatype={root-data-prototype=motion, target-data-prototype=type}, tlv-data-id=0}
        {data-prototype=Odometry_RPort_Temperature.motion, element-in-impl-datatype={root-data-prototype=motion, target-data-prototype=accelerationVarianceX}, tlv-data-id=1}
        {data-prototype=Odometry_RPort_Temperature.motion, element-in-impl-datatype={root-data-prototype=motion, target-data-prototype=accelerationVarianceY}, tlv-data-id=2}
        {data-prototype=Odometry_RPort_Temperature.motion, element-in-impl-datatype={root-data-prototype=motion, target-data-prototype=accelerationX}, tlv-data-id=3}
        {data-prototype=Odometry_RPort_Temperature.motion, element-in-impl-datatype={root-data-prototype=motion, target-data-prototype=accelerationXConfidence}, tlv-data-id=4}
        {data-prototype=Odometry_RPort_Temperature.motion, element-in-impl-datatype={root-data-prototype=motion, target-data-prototype=accelerationY}, tlv-data-id=5}
        {data-prototype=Odometry_RPort_Temperature.motion, element-in-impl-datatype={root-data-prototype=motion, target-data-prototype=accelerationYConfidence}, tlv-data-id=6}
        {data-prototype=Odometry_RPort_Temperature.motion, element-in-impl-datatype={root-data-prototype=motion, target-data-prototype=estimatorRange}, tlv-data-id=7}
        {data-prototype=Odometry_RPort_Temperature.motion, element-in-impl-datatype={root-data-prototype=motion, target-data-prototype=estimatorRangeConfidence}, tlv-data-id=8}
        {data-prototype=Odometry_RPort_Temperature.motion, element-in-impl-datatype={root-data-prototype=motion, target-data-prototype=velocityVarianceX}, tlv-data-id=9}
        {data-prototype=Odometry_RPort_Temperature.motion, element-in-impl-datatype={root-data-prototype=motion, target-data-prototype=velocityVarianceY}, tlv-data-id=10}
        {data-prototype=Odometry_RPort_Temperature.motion, element-in-impl-datatype={root-data-prototype=motion, target-data-prototype=velocityX}, tlv-data-id=11}
        {data-prototype=Odometry_RPort_Temperature.motion, element-in-impl-datatype={root-data-prototype=motion, target-data-prototype=velocityXConfidence}, tlv-data-id=12}
        {data-prototype=Odometry_RPort_Temperature.motion, element-in-impl-datatype={root-data-prototype=motion, target-data-prototype=velocityY}, tlv-data-id=13}
        {data-prototype=Odometry_RPort_Temperature.motion, element-in-impl-datatype={root-data-prototype=motion, target-data-prototype=velocityYConfidence}, tlv-data-id=14}
        {data-prototype=Odometry_RPort_Temperature.motion, element-in-impl-datatype={root-data-prototype=motion, target-data-prototype=yawRate}, tlv-data-id=15}
        {data-prototype=Odometry_RPort_Temperature.motion, element-in-impl-datatype={root-data-prototype=motion, target-data-prototype=yawRateConfidence}, tlv-data-id=16}
        {data-prototype=Odometry_RPort_Temperature.motion, element-in-impl-datatype={root-data-prototype=motion, target-data-prototype=yawRateVariance}, tlv-data-id=17}
        {data-prototype=Odometry_RPort_Temperature.motion, element-in-impl-datatype={root-data-prototype=motion, target-data-prototype=timestamp}, tlv-data-id=18}
        {data-prototype=Odometry_RPort_Temperature.motion, element-in-impl-datatype={root-data-prototype=motion, target-data-prototype=altitude}, tlv-data-id=19}
        {data-prototype=Odometry_RPort_Temperature.motion, element-in-impl-datatype={root-data-prototype=motion, target-data-prototype=altitudeConfidence}, tlv-data-id=20}
        {data-prototype=Odometry_RPort_Temperature.motion, element-in-impl-datatype={root-data-prototype=motion, target-data-prototype=heading}, tlv-data-id=21}
        {data-prototype=Odometry_RPort_Temperature.motion, element-in-impl-datatype={root-data-prototype=motion, target-data-prototype=headingConfidence}, tlv-data-id=22}
        {data-prototype=Odometry_RPort_Temperature.motion, element-in-impl-datatype={root-data-prototype=motion, target-data-prototype=positionX}, tlv-data-id=23}
        {data-prototype=Odometry_RPort_Temperature.motion, element-in-impl-datatype={root-data-prototype=motion, target-data-prototype=positionXConfidence}, tlv-data-id=24}
        {data-prototype=Odometry_RPort_Temperature.motion, element-in-impl-datatype={root-data-prototype=motion, target-data-prototype=positionXDeltaVariance}, tlv-data-id=25}
        {data-prototype=Odometry_RPort_Temperature.motion, element-in-impl-datatype={root-data-prototype=motion, target-data-prototype=positionY}, tlv-data-id=26}
        {data-prototype=Odometry_RPort_Temperature.motion, element-in-impl-datatype={root-data-prototype=motion, target-data-prototype=positionYConfidence}, tlv-data-id=27}
        {data-prototype=Odometry_RPort_Temperature.motion, element-in-impl-datatype={root-data-prototype=motion, target-data-prototype=positionYDeltaVariance}, tlv-data-id=28}
        {data-prototype=Odometry_RPort_Temperature.motion, element-in-impl-datatype={root-data-prototype=motion, target-data-prototype=standStillPRange}, tlv-data-id=29}
        {data-prototype=Odometry_RPort_Temperature.motion, element-in-impl-datatype={root-data-prototype=motion, target-data-prototype=standStillPRangeConfidence}, tlv-data-id=30}
        {data-prototype=Odometry_RPort_Temperature.motion, element-in-impl-datatype={root-data-prototype=motion, target-data-prototype=yawAngle}, tlv-data-id=31}
        {data-prototype=Odometry_RPort_Temperature.motion, element-in-impl-datatype={root-data-prototype=motion, target-data-prototype=yawAngleConfidence}, tlv-data-id=32}
        {data-prototype=Odometry_RPort_Temperature.motion, element-in-impl-datatype={root-data-prototype=motion, target-data-prototype=yawAngleDeltaVariance}, tlv-data-id=33}
        {data-prototype=Odometry_RPort_Temperature.motion, element-in-impl-datatype={root-data-prototype=motion, target-data-prototype=drivingDirectionPRange}, tlv-data-id=34}
        {data-prototype=Odometry_RPort_Temperature.motion, element-in-impl-datatype={root-data-prototype=motion, target-data-prototype=drivingDirectionPRangeConfidence}, tlv-data-id=35}
        {data-prototype=Odometry_RPort_TripComputer.velocities, element-in-impl-datatype={root-data-prototype=velocities, target-data-prototype=type}, tlv-data-id=0}
        {data-prototype=Odometry_RPort_TripComputer.velocities, element-in-impl-datatype={root-data-prototype=velocities, target-data-prototype=physicalValue}, tlv-data-id=1}
        {data-prototype=Odometry_RPort_TripComputer.velocities, element-in-impl-datatype={root-data-prototype=velocities, target-data-prototype=valueType}, tlv-data-id=2}
        {data-prototype=Odometry_RPort_TripComputer.velocities, element-in-impl-datatype={root-data-prototype=velocities, target-data-prototype=unit}, tlv-data-id=3}
        {data-prototype=Odometry_RPort_TripComputer.motion, element-in-impl-datatype={root-data-prototype=motion, target-data-prototype=type}, tlv-data-id=0}
        {data-prototype=Odometry_RPort_TripComputer.motion, element-in-impl-datatype={root-data-prototype=motion, target-data-prototype=accelerationVarianceX}, tlv-data-id=1}
        {data-prototype=Odometry_RPort_TripComputer.motion, element-in-impl-datatype={root-data-prototype=motion, target-data-prototype=accelerationVarianceY}, tlv-data-id=2}
        {data-prototype=Odometry_RPort_TripComputer.motion, element-in-impl-datatype={root-data-prototype=motion, target-data-prototype=accelerationX}, tlv-data-id=3}
        {data-prototype=Odometry_RPort_TripComputer.motion, element-in-impl-datatype={root-data-prototype=motion, target-data-prototype=accelerationXConfidence}, tlv-data-id=4}
        {data-prototype=Odometry_RPort_TripComputer.motion, element-in-impl-datatype={root-data-prototype=motion, target-data-prototype=accelerationY}, tlv-data-id=5}
        {data-prototype=Odometry_RPort_TripComputer.motion, element-in-impl-datatype={root-data-prototype=motion, target-data-prototype=accelerationYConfidence}, tlv-data-id=6}
        {data-prototype=Odometry_RPort_TripComputer.motion, element-in-impl-datatype={root-data-prototype=motion, target-data-prototype=estimatorRange}, tlv-data-id=7}
        {data-prototype=Odometry_RPort_TripComputer.motion, element-in-impl-datatype={root-data-prototype=motion, target-data-prototype=estimatorRangeConfidence}, tlv-data-id=8}
        {data-prototype=Odometry_RPort_TripComputer.motion, element-in-impl-datatype={root-data-prototype=motion, target-data-prototype=velocityVarianceX}, tlv-data-id=9}
        {data-prototype=Odometry_RPort_TripComputer.motion, element-in-impl-datatype={root-data-prototype=motion, target-data-prototype=velocityVarianceY}, tlv-data-id=10}
        {data-prototype=Odometry_RPort_TripComputer.motion, element-in-impl-datatype={root-data-prototype=motion, target-data-prototype=velocityX}, tlv-data-id=11}
        {data-prototype=Odometry_RPort_TripComputer.motion, element-in-impl-datatype={root-data-prototype=motion, target-data-prototype=velocityXConfidence}, tlv-data-id=12}
        {data-prototype=Odometry_RPort_TripComputer.motion, element-in-impl-datatype={root-data-prototype=motion, target-data-prototype=velocityY}, tlv-data-id=13}
        {data-prototype=Odometry_RPort_TripComputer.motion, element-in-impl-datatype={root-data-prototype=motion, target-data-prototype=velocityYConfidence}, tlv-data-id=14}
        {data-prototype=Odometry_RPort_TripComputer.motion, element-in-impl-datatype={root-data-prototype=motion, target-data-prototype=yawRate}, tlv-data-id=15}
        {data-prototype=Odometry_RPort_TripComputer.motion, element-in-impl-datatype={root-data-prototype=motion, target-data-prototype=yawRateConfidence}, tlv-data-id=16}
        {data-prototype=Odometry_RPort_TripComputer.motion, element-in-impl-datatype={root-data-prototype=motion, target-data-prototype=yawRateVariance}, tlv-data-id=17}
        {data-prototype=Odometry_RPort_TripComputer.motion, element-in-impl-datatype={root-data-prototype=motion, target-data-prototype=timestamp}, tlv-data-id=18}
        {data-prototype=Odometry_RPort_TripComputer.motion, element-in-impl-datatype={root-data-prototype=motion, target-data-prototype=altitude}, tlv-data-id=19}
        {data-prototype=Odometry_RPort_TripComputer.motion, element-in-impl-datatype={root-data-prototype=motion, target-data-prototype=altitudeConfidence}, tlv-data-id=20}
        {data-prototype=Odometry_RPort_TripComputer.motion, element-in-impl-datatype={root-data-prototype=motion, target-data-prototype=heading}, tlv-data-id=21}
        {data-prototype=Odometry_RPort_TripComputer.motion, element-in-impl-datatype={root-data-prototype=motion, target-data-prototype=headingConfidence}, tlv-data-id=22}
        {data-prototype=Odometry_RPort_TripComputer.motion, element-in-impl-datatype={root-data-prototype=motion, target-data-prototype=positionX}, tlv-data-id=23}
        {data-prototype=Odometry_RPort_TripComputer.motion, element-in-impl-datatype={root-data-prototype=motion, target-data-prototype=positionXConfidence}, tlv-data-id=24}
        {data-prototype=Odometry_RPort_TripComputer.motion, element-in-impl-datatype={root-data-prototype=motion, target-data-prototype=positionXDeltaVariance}, tlv-data-id=25}
        {data-prototype=Odometry_RPort_TripComputer.motion, element-in-impl-datatype={root-data-prototype=motion, target-data-prototype=positionY}, tlv-data-id=26}
        {data-prototype=Odometry_RPort_TripComputer.motion, element-in-impl-datatype={root-data-prototype=motion, target-data-prototype=positionYConfidence}, tlv-data-id=27}
        {data-prototype=Odometry_RPort_TripComputer.motion, element-in-impl-datatype={root-data-prototype=motion, target-data-prototype=positionYDeltaVariance}, tlv-data-id=28}
        {data-prototype=Odometry_RPort_TripComputer.motion, element-in-impl-datatype={root-data-prototype=motion, target-data-prototype=standStillPRange}, tlv-data-id=29}
        {data-prototype=Odometry_RPort_TripComputer.motion, element-in-impl-datatype={root-data-prototype=motion, target-data-prototype=standStillPRangeConfidence}, tlv-data-id=30}
        {data-prototype=Odometry_RPort_TripComputer.motion, element-in-impl-datatype={root-data-prototype=motion, target-data-prototype=yawAngle}, tlv-data-id=31}
        {data-prototype=Odometry_RPort_TripComputer.motion, element-in-impl-datatype={root-data-prototype=motion, target-data-prototype=yawAngleConfidence}, tlv-data-id=32}
        {data-prototype=Odometry_RPort_TripComputer.motion, element-in-impl-datatype={root-data-prototype=motion, target-data-prototype=yawAngleDeltaVariance}, tlv-data-id=33}
        {data-prototype=Odometry_RPort_TripComputer.motion, element-in-impl-datatype={root-data-prototype=motion, target-data-prototype=drivingDirectionPRange}, tlv-data-id=34}
        {data-prototype=Odometry_RPort_TripComputer.motion, element-in-impl-datatype={root-data-prototype=motion, target-data-prototype=drivingDirectionPRangeConfidence}, tlv-data-id=35}
    Powertrain_TLV
      data-prototypes:
        {data-prototype=Powertrain_RPort_Temperature.notifications, element-in-impl-datatype={root-data-prototype=notifications, target-data-prototype=type}, tlv-data-id=0}
        {data-prototype=Powertrain_RPort_Temperature.notifications, element-in-impl-datatype={root-data-prototype=notifications, target-data-prototype=value}, tlv-data-id=1}
        {data-prototype=Powertrain_RPort_Temperature.settings, element-in-impl-datatype={root-data-prototype=settings, target-data-prototype=elementId}, tlv-data-id=0}
        {data-prototype=Powertrain_RPort_Temperature.settings, element-in-impl-datatype={root-data-prototype=settings, target-data-prototype=gearShiftPositionDisplay}, tlv-data-id=1}
        {data-prototype=Powertrain_RPort_Temperature.settings, element-in-impl-datatype={root-data-prototype=settings, target-data-prototype=recuperationLevelDisplay}, tlv-data-id=2}
        {data-prototype=Powertrain_RPort_Temperature.status, element-in-impl-datatype={root-data-prototype=status, target-data-prototype=elementId}, tlv-data-id=0}
        {data-prototype=Powertrain_RPort_Temperature.status, element-in-impl-datatype={root-data-prototype=status, target-data-prototype=isDrivingReadyDisplay}, tlv-data-id=1}
        {data-prototype=Powertrain_RPort_Temperature.status, element-in-impl-datatype={root-data-prototype=status, target-data-prototype=isKickDown}, tlv-data-id=2}
    PowertrainConsumption_TLV
      data-prototypes:
        {data-prototype=PowertrainConsumption_RPort_ElectricalConsumptions.electricDriveMotors, element-in-impl-datatype={root-data-prototype=electricDriveMotors, target-data-prototype=elementId}, tlv-data-id=0}
        {data-prototype=PowertrainConsumption_RPort_ElectricalConsumptions.electricDriveMotors, element-in-impl-datatype={root-data-prototype=electricDriveMotors, target-data-prototype=totalConsumption}, tlv-data-id=1}
        {data-prototype=PowertrainConsumption_RPort_ElectricalConsumptions.electricDriveMotors, element-in-impl-datatype={root-data-prototype=electricDriveMotors, target-data-prototype=totalConsumptionHasOverflowed}, tlv-data-id=2}
        {data-prototype=PowertrainConsumption_RPort_ElectricalConsumptions.electricDriveMotors, element-in-impl-datatype={root-data-prototype=electricDriveMotors, target-data-prototype=totalRecuperation}, tlv-data-id=3}
        {data-prototype=PowertrainConsumption_RPort_ElectricalConsumptions.electricDriveMotors, element-in-impl-datatype={root-data-prototype=electricDriveMotors, target-data-prototype=totalRecuperationHasOverflowed}, tlv-data-id=4}
    SafetyBeltState_TLV
      data-prototypes:
        {data-prototype=SafetyBeltState_RPort_Telltale.notifications, element-in-impl-datatype={root-data-prototype=notifications, target-data-prototype=type}, tlv-data-id=0}
        {data-prototype=SafetyBeltState_RPort_Telltale.notifications, element-in-impl-datatype={root-data-prototype=notifications, target-data-prototype=value}, tlv-data-id=1}
        {data-prototype=SafetyBeltState_RPort_Telltale.belts, element-in-impl-datatype={root-data-prototype=belts, target-data-prototype=beltId}, tlv-data-id=0}
        {data-prototype=SafetyBeltState_RPort_Telltale.belts, element-in-impl-datatype={root-data-prototype=belts, target-data-prototype=plugged}, tlv-data-id=1}
    Time_TLV
      data-prototypes:
        {data-prototype=Time_Rport_DrivingStatistics.timeSettings, element-in-impl-datatype={root-data-prototype=timeSettings, target-data-prototype=id}, tlv-data-id=0}
        {data-prototype=Time_Rport_DrivingStatistics.timeSettings, element-in-impl-datatype={root-data-prototype=timeSettings, target-data-prototype=dstActive}, tlv-data-id=1}
        {data-prototype=Time_Rport_DrivingStatistics.timeSettings, element-in-impl-datatype={root-data-prototype=timeSettings, target-data-prototype=timeMode}, tlv-data-id=2}
        {data-prototype=Time_Rport_DrivingStatistics.timeSettings, element-in-impl-datatype={root-data-prototype=timeSettings, target-data-prototype=timeZoneOffset}, tlv-data-id=3}
        {data-prototype=Time_Rport_DrivingStatistics.times, element-in-impl-datatype={root-data-prototype=times, target-data-prototype=type}, tlv-data-id=0}
        {data-prototype=Time_Rport_DrivingStatistics.times, element-in-impl-datatype={root-data-prototype=times, target-data-prototype=date}, tlv-data-id=1}
        {data-prototype=Time_Rport_DrivingStatistics.times, element-in-impl-datatype={root-data-prototype=times, target-data-prototype=pltOffset}, tlv-data-id=2}
        {data-prototype=Time_Rport_DrivingStatistics.times, element-in-impl-datatype={root-data-prototype=times, target-data-prototype=time}, tlv-data-id=3}
        {data-prototype=Time_Rport_DrivingStatistics.times, element-in-impl-datatype={root-data-prototype=times, target-data-prototype=unix}, tlv-data-id=4}
        {data-prototype=Time_Rport_DrivingStatistics.times, element-in-impl-datatype={root-data-prototype=times, target-data-prototype=standby}, tlv-data-id=5}
        {data-prototype=Time_RPort_Temperature.timeSettings, element-in-impl-datatype={root-data-prototype=timeSettings, target-data-prototype=id}, tlv-data-id=0}
        {data-prototype=Time_RPort_Temperature.timeSettings, element-in-impl-datatype={root-data-prototype=timeSettings, target-data-prototype=dstActive}, tlv-data-id=1}
        {data-prototype=Time_RPort_Temperature.timeSettings, element-in-impl-datatype={root-data-prototype=timeSettings, target-data-prototype=timeMode}, tlv-data-id=2}
        {data-prototype=Time_RPort_Temperature.timeSettings, element-in-impl-datatype={root-data-prototype=timeSettings, target-data-prototype=timeZoneOffset}, tlv-data-id=3}
        {data-prototype=Time_RPort_Temperature.times, element-in-impl-datatype={root-data-prototype=times, target-data-prototype=type}, tlv-data-id=0}
        {data-prototype=Time_RPort_Temperature.times, element-in-impl-datatype={root-data-prototype=times, target-data-prototype=date}, tlv-data-id=1}
        {data-prototype=Time_RPort_Temperature.times, element-in-impl-datatype={root-data-prototype=times, target-data-prototype=pltOffset}, tlv-data-id=2}
        {data-prototype=Time_RPort_Temperature.times, element-in-impl-datatype={root-data-prototype=times, target-data-prototype=time}, tlv-data-id=3}
        {data-prototype=Time_RPort_Temperature.times, element-in-impl-datatype={root-data-prototype=times, target-data-prototype=unix}, tlv-data-id=4}
        {data-prototype=Time_RPort_Temperature.times, element-in-impl-datatype={root-data-prototype=times, target-data-prototype=standby}, tlv-data-id=5}
        {data-prototype=Time_RPort_TripComputer.timeSettings, element-in-impl-datatype={root-data-prototype=timeSettings, target-data-prototype=id}, tlv-data-id=0}
        {data-prototype=Time_RPort_TripComputer.timeSettings, element-in-impl-datatype={root-data-prototype=timeSettings, target-data-prototype=dstActive}, tlv-data-id=1}
        {data-prototype=Time_RPort_TripComputer.timeSettings, element-in-impl-datatype={root-data-prototype=timeSettings, target-data-prototype=timeMode}, tlv-data-id=2}
        {data-prototype=Time_RPort_TripComputer.timeSettings, element-in-impl-datatype={root-data-prototype=timeSettings, target-data-prototype=timeZoneOffset}, tlv-data-id=3}
        {data-prototype=Time_RPort_TripComputer.times, element-in-impl-datatype={root-data-prototype=times, target-data-prototype=type}, tlv-data-id=0}
        {data-prototype=Time_RPort_TripComputer.times, element-in-impl-datatype={root-data-prototype=times, target-data-prototype=date}, tlv-data-id=1}
        {data-prototype=Time_RPort_TripComputer.times, element-in-impl-datatype={root-data-prototype=times, target-data-prototype=pltOffset}, tlv-data-id=2}
        {data-prototype=Time_RPort_TripComputer.times, element-in-impl-datatype={root-data-prototype=times, target-data-prototype=time}, tlv-data-id=3}
        {data-prototype=Time_RPort_TripComputer.times, element-in-impl-datatype={root-data-prototype=times, target-data-prototype=unix}, tlv-data-id=4}
        {data-prototype=Time_RPort_TripComputer.times, element-in-impl-datatype={root-data-prototype=times, target-data-prototype=standby}, tlv-data-id=5}
    Temperature_TLV
      data-prototypes:
        {data-prototype=Temperature_PPort_Temperature.temperatures, element-in-impl-datatype={root-data-prototype=temperatures, target-data-prototype=type}, tlv-data-id=0}
        {data-prototype=Temperature_PPort_Temperature.temperatures, element-in-impl-datatype={root-data-prototype=temperatures, target-data-prototype=curentValue}, tlv-data-id=1}
        {data-prototype=Temperature_PPort_Temperature.temperatures, element-in-impl-datatype={root-data-prototype=temperatures, target-data-prototype=valueType}, tlv-data-id=2}
        {data-prototype=Temperature_PPort_Temperature.temperatures, element-in-impl-datatype={root-data-prototype=temperatures, target-data-prototype=unit}, tlv-data-id=3}
        {data-prototype=Temperature_PPort_Temperature.temperatures, element-in-impl-datatype={root-data-prototype=temperatures, target-data-prototype=minValue}, tlv-data-id=4}
        {data-prototype=Temperature_PPort_Temperature.temperatures, element-in-impl-datatype={root-data-prototype=temperatures, target-data-prototype=maxValue}, tlv-data-id=5}
        {data-prototype=Temperature_PPort_Temperature.temperatures, element-in-impl-datatype={root-data-prototype=temperatures, target-data-prototype=resolution}, tlv-data-id=6}
        {data-prototype=Temperature_PPort_Temperature.notifications, element-in-impl-datatype={root-data-prototype=notifications, target-data-prototype=type}, tlv-data-id=0}
        {data-prototype=Temperature_PPort_Temperature.notifications, element-in-impl-datatype={root-data-prototype=notifications, target-data-prototype=isActive}, tlv-data-id=1}
        {data-prototype=Temperature_PPort_Temperature.notifications, element-in-impl-datatype={root-data-prototype=notifications, target-data-prototype=threshold}, tlv-data-id=2}
        {data-prototype=Temperature_PPort_Temperature.notifications, element-in-impl-datatype={root-data-prototype=notifications, target-data-prototype=isNotifiable}, tlv-data-id=3}
        {data-prototype=Temperature_PPort_Temperature.notifications, element-in-impl-datatype={root-data-prototype=notifications, target-data-prototype=unit}, tlv-data-id=4}
    UnitMaster_TLV
      data-prototypes:
        {data-prototype=UnitMaster_RPort_Distance.units, element-in-impl-datatype={root-data-prototype=units, target-data-prototype=id}, tlv-data-id=0}
        {data-prototype=UnitMaster_RPort_Distance.units, element-in-impl-datatype={root-data-prototype=units, target-data-prototype=name}, tlv-data-id=1}
        {data-prototype=UnitMaster_RPort_Distance.units, element-in-impl-datatype={root-data-prototype=units, target-data-prototype=dateFormat}, tlv-data-id=2}
        {data-prototype=UnitMaster_RPort_Distance.units, element-in-impl-datatype={root-data-prototype=units, target-data-prototype=dateFormatConfiguration}, tlv-data-id=3}
        {data-prototype=UnitMaster_RPort_Distance.units, element-in-impl-datatype={root-data-prototype=units, target-data-prototype=distanceUnit}, tlv-data-id=4}
        {data-prototype=UnitMaster_RPort_Distance.units, element-in-impl-datatype={root-data-prototype=units, target-data-prototype=distanceUnitConfiguration}, tlv-data-id=5}
        {data-prototype=UnitMaster_RPort_Distance.units, element-in-impl-datatype={root-data-prototype=units, target-data-prototype=pressureUnit}, tlv-data-id=6}
        {data-prototype=UnitMaster_RPort_Distance.units, element-in-impl-datatype={root-data-prototype=units, target-data-prototype=pressureUnitConfiguration}, tlv-data-id=7}
        {data-prototype=UnitMaster_RPort_Distance.units, element-in-impl-datatype={root-data-prototype=units, target-data-prototype=restrictionReason}, tlv-data-id=8}
        {data-prototype=UnitMaster_RPort_Distance.units, element-in-impl-datatype={root-data-prototype=units, target-data-prototype=speedUnitTachometer}, tlv-data-id=9}
        {data-prototype=UnitMaster_RPort_Distance.units, element-in-impl-datatype={root-data-prototype=units, target-data-prototype=speedUnit}, tlv-data-id=10}
        {data-prototype=UnitMaster_RPort_Distance.units, element-in-impl-datatype={root-data-prototype=units, target-data-prototype=speedUnitConfiguration}, tlv-data-id=11}
        {data-prototype=UnitMaster_RPort_Distance.units, element-in-impl-datatype={root-data-prototype=units, target-data-prototype=temperatureUnit}, tlv-data-id=12}
        {data-prototype=UnitMaster_RPort_Distance.units, element-in-impl-datatype={root-data-prototype=units, target-data-prototype=temperatureUnitConfiguration}, tlv-data-id=13}
        {data-prototype=UnitMaster_RPort_Distance.units, element-in-impl-datatype={root-data-prototype=units, target-data-prototype=timeFormat}, tlv-data-id=14}
        {data-prototype=UnitMaster_RPort_Distance.units, element-in-impl-datatype={root-data-prototype=units, target-data-prototype=timeFormatConfiguration}, tlv-data-id=15}
        {data-prototype=UnitMaster_RPort_Distance.units, element-in-impl-datatype={root-data-prototype=units, target-data-prototype=volumeUnit}, tlv-data-id=16}
        {data-prototype=UnitMaster_RPort_Distance.units, element-in-impl-datatype={root-data-prototype=units, target-data-prototype=volumeUnitConfiguration}, tlv-data-id=17}
        {data-prototype=UnitMaster_RPort_Distance.units, element-in-impl-datatype={root-data-prototype=units, target-data-prototype=consumptionUnit}, tlv-data-id=18}
        {data-prototype=UnitMaster_RPort_Distance.units, element-in-impl-datatype={root-data-prototype=units, target-data-prototype=consumptionUnitConfiguration}, tlv-data-id=19}
        {data-prototype=UnitMaster_RPort_Distance.units, element-in-impl-datatype={root-data-prototype=units, target-data-prototype=consumptionUnitElectr}, tlv-data-id=20}
        {data-prototype=UnitMaster_RPort_Distance.units, element-in-impl-datatype={root-data-prototype=units, target-data-prototype=consumptionUnitElectrConfiguration}, tlv-data-id=21}
        {data-prototype=UnitMaster_RPort_Distance.units, element-in-impl-datatype={root-data-prototype=units, target-data-prototype=consumptionUnitGas}, tlv-data-id=22}
        {data-prototype=UnitMaster_RPort_Distance.units, element-in-impl-datatype={root-data-prototype=units, target-data-prototype=consumptionUnitGasConfiguration}, tlv-data-id=23}
        {data-prototype=UnitMaster_RPort_Distance.units, element-in-impl-datatype={root-data-prototype=units, target-data-prototype=massUnit}, tlv-data-id=24}
        {data-prototype=UnitMaster_RPort_Distance.units, element-in-impl-datatype={root-data-prototype=units, target-data-prototype=massUnitConfiguration}, tlv-data-id=25}
        {data-prototype=UnitMaster_RPort_Speed.units, element-in-impl-datatype={root-data-prototype=units, target-data-prototype=id}, tlv-data-id=0}
        {data-prototype=UnitMaster_RPort_Speed.units, element-in-impl-datatype={root-data-prototype=units, target-data-prototype=name}, tlv-data-id=1}
        {data-prototype=UnitMaster_RPort_Speed.units, element-in-impl-datatype={root-data-prototype=units, target-data-prototype=dateFormat}, tlv-data-id=2}
        {data-prototype=UnitMaster_RPort_Speed.units, element-in-impl-datatype={root-data-prototype=units, target-data-prototype=dateFormatConfiguration}, tlv-data-id=3}
        {data-prototype=UnitMaster_RPort_Speed.units, element-in-impl-datatype={root-data-prototype=units, target-data-prototype=distanceUnit}, tlv-data-id=4}
        {data-prototype=UnitMaster_RPort_Speed.units, element-in-impl-datatype={root-data-prototype=units, target-data-prototype=distanceUnitConfiguration}, tlv-data-id=5}
        {data-prototype=UnitMaster_RPort_Speed.units, element-in-impl-datatype={root-data-prototype=units, target-data-prototype=pressureUnit}, tlv-data-id=6}
        {data-prototype=UnitMaster_RPort_Speed.units, element-in-impl-datatype={root-data-prototype=units, target-data-prototype=pressureUnitConfiguration}, tlv-data-id=7}
        {data-prototype=UnitMaster_RPort_Speed.units, element-in-impl-datatype={root-data-prototype=units, target-data-prototype=restrictionReason}, tlv-data-id=8}
        {data-prototype=UnitMaster_RPort_Speed.units, element-in-impl-datatype={root-data-prototype=units, target-data-prototype=speedUnitTachometer}, tlv-data-id=9}
        {data-prototype=UnitMaster_RPort_Speed.units, element-in-impl-datatype={root-data-prototype=units, target-data-prototype=speedUnit}, tlv-data-id=10}
        {data-prototype=UnitMaster_RPort_Speed.units, element-in-impl-datatype={root-data-prototype=units, target-data-prototype=speedUnitConfiguration}, tlv-data-id=11}
        {data-prototype=UnitMaster_RPort_Speed.units, element-in-impl-datatype={root-data-prototype=units, target-data-prototype=temperatureUnit}, tlv-data-id=12}
        {data-prototype=UnitMaster_RPort_Speed.units, element-in-impl-datatype={root-data-prototype=units, target-data-prototype=temperatureUnitConfiguration}, tlv-data-id=13}
        {data-prototype=UnitMaster_RPort_Speed.units, element-in-impl-datatype={root-data-prototype=units, target-data-prototype=timeFormat}, tlv-data-id=14}
        {data-prototype=UnitMaster_RPort_Speed.units, element-in-impl-datatype={root-data-prototype=units, target-data-prototype=timeFormatConfiguration}, tlv-data-id=15}
        {data-prototype=UnitMaster_RPort_Speed.units, element-in-impl-datatype={root-data-prototype=units, target-data-prototype=volumeUnit}, tlv-data-id=16}
        {data-prototype=UnitMaster_RPort_Speed.units, element-in-impl-datatype={root-data-prototype=units, target-data-prototype=volumeUnitConfiguration}, tlv-data-id=17}
        {data-prototype=UnitMaster_RPort_Speed.units, element-in-impl-datatype={root-data-prototype=units, target-data-prototype=consumptionUnit}, tlv-data-id=18}
        {data-prototype=UnitMaster_RPort_Speed.units, element-in-impl-datatype={root-data-prototype=units, target-data-prototype=consumptionUnitConfiguration}, tlv-data-id=19}
        {data-prototype=UnitMaster_RPort_Speed.units, element-in-impl-datatype={root-data-prototype=units, target-data-prototype=consumptionUnitElectr}, tlv-data-id=20}
        {data-prototype=UnitMaster_RPort_Speed.units, element-in-impl-datatype={root-data-prototype=units, target-data-prototype=consumptionUnitElectrConfiguration}, tlv-data-id=21}
        {data-prototype=UnitMaster_RPort_Speed.units, element-in-impl-datatype={root-data-prototype=units, target-data-prototype=consumptionUnitGas}, tlv-data-id=22}
        {data-prototype=UnitMaster_RPort_Speed.units, element-in-impl-datatype={root-data-prototype=units, target-data-prototype=consumptionUnitGasConfiguration}, tlv-data-id=23}
        {data-prototype=UnitMaster_RPort_Speed.units, element-in-impl-datatype={root-data-prototype=units, target-data-prototype=massUnit}, tlv-data-id=24}
        {data-prototype=UnitMaster_RPort_Speed.units, element-in-impl-datatype={root-data-prototype=units, target-data-prototype=massUnitConfiguration}, tlv-data-id=25}
        {data-prototype=UnitMaster_PPort_UnitMaster.units, element-in-impl-datatype={root-data-prototype=units, target-data-prototype=id}, tlv-data-id=0}
        {data-prototype=UnitMaster_PPort_UnitMaster.units, element-in-impl-datatype={root-data-prototype=units, target-data-prototype=name}, tlv-data-id=1}
        {data-prototype=UnitMaster_PPort_UnitMaster.units, element-in-impl-datatype={root-data-prototype=units, target-data-prototype=dateFormat}, tlv-data-id=2}
        {data-prototype=UnitMaster_PPort_UnitMaster.units, element-in-impl-datatype={root-data-prototype=units, target-data-prototype=dateFormatConfiguration}, tlv-data-id=3}
        {data-prototype=UnitMaster_PPort_UnitMaster.units, element-in-impl-datatype={root-data-prototype=units, target-data-prototype=distanceUnit}, tlv-data-id=4}
        {data-prototype=UnitMaster_PPort_UnitMaster.units, element-in-impl-datatype={root-data-prototype=units, target-data-prototype=distanceUnitConfiguration}, tlv-data-id=5}
        {data-prototype=UnitMaster_PPort_UnitMaster.units, element-in-impl-datatype={root-data-prototype=units, target-data-prototype=pressureUnit}, tlv-data-id=6}
        {data-prototype=UnitMaster_PPort_UnitMaster.units, element-in-impl-datatype={root-data-prototype=units, target-data-prototype=pressureUnitConfiguration}, tlv-data-id=7}
        {data-prototype=UnitMaster_PPort_UnitMaster.units, element-in-impl-datatype={root-data-prototype=units, target-data-prototype=restrictionReason}, tlv-data-id=8}
        {data-prototype=UnitMaster_PPort_UnitMaster.units, element-in-impl-datatype={root-data-prototype=units, target-data-prototype=speedUnitTachometer}, tlv-data-id=9}
        {data-prototype=UnitMaster_PPort_UnitMaster.units, element-in-impl-datatype={root-data-prototype=units, target-data-prototype=speedUnit}, tlv-data-id=10}
        {data-prototype=UnitMaster_PPort_UnitMaster.units, element-in-impl-datatype={root-data-prototype=units, target-data-prototype=speedUnitConfiguration}, tlv-data-id=11}
        {data-prototype=UnitMaster_PPort_UnitMaster.units, element-in-impl-datatype={root-data-prototype=units, target-data-prototype=temperatureUnit}, tlv-data-id=12}
        {data-prototype=UnitMaster_PPort_UnitMaster.units, element-in-impl-datatype={root-data-prototype=units, target-data-prototype=temperatureUnitConfiguration}, tlv-data-id=13}
        {data-prototype=UnitMaster_PPort_UnitMaster.units, element-in-impl-datatype={root-data-prototype=units, target-data-prototype=timeFormat}, tlv-data-id=14}
        {data-prototype=UnitMaster_PPort_UnitMaster.units, element-in-impl-datatype={root-data-prototype=units, target-data-prototype=timeFormatConfiguration}, tlv-data-id=15}
        {data-prototype=UnitMaster_PPort_UnitMaster.units, element-in-impl-datatype={root-data-prototype=units, target-data-prototype=volumeUnit}, tlv-data-id=16}
        {data-prototype=UnitMaster_PPort_UnitMaster.units, element-in-impl-datatype={root-data-prototype=units, target-data-prototype=volumeUnitConfiguration}, tlv-data-id=17}
        {data-prototype=UnitMaster_PPort_UnitMaster.units, element-in-impl-datatype={root-data-prototype=units, target-data-prototype=consumptionUnit}, tlv-data-id=18}
        {data-prototype=UnitMaster_PPort_UnitMaster.units, element-in-impl-datatype={root-data-prototype=units, target-data-prototype=consumptionUnitConfiguration}, tlv-data-id=19}
        {data-prototype=UnitMaster_PPort_UnitMaster.units, element-in-impl-datatype={root-data-prototype=units, target-data-prototype=consumptionUnitElectr}, tlv-data-id=20}
        {data-prototype=UnitMaster_PPort_UnitMaster.units, element-in-impl-datatype={root-data-prototype=units, target-data-prototype=consumptionUnitElectrConfiguration}, tlv-data-id=21}
        {data-prototype=UnitMaster_PPort_UnitMaster.units, element-in-impl-datatype={root-data-prototype=units, target-data-prototype=consumptionUnitGas}, tlv-data-id=22}
        {data-prototype=UnitMaster_PPort_UnitMaster.units, element-in-impl-datatype={root-data-prototype=units, target-data-prototype=consumptionUnitGasConfiguration}, tlv-data-id=23}
        {data-prototype=UnitMaster_PPort_UnitMaster.units, element-in-impl-datatype={root-data-prototype=units, target-data-prototype=massUnit}, tlv-data-id=24}
        {data-prototype=UnitMaster_PPort_UnitMaster.units, element-in-impl-datatype={root-data-prototype=units, target-data-prototype=massUnitConfiguration}, tlv-data-id=25}
        {data-prototype=UnitMaster_RPort_Temperature.units, element-in-impl-datatype={root-data-prototype=units, target-data-prototype=id}, tlv-data-id=0}
        {data-prototype=UnitMaster_RPort_Temperature.units, element-in-impl-datatype={root-data-prototype=units, target-data-prototype=name}, tlv-data-id=1}
        {data-prototype=UnitMaster_RPort_Temperature.units, element-in-impl-datatype={root-data-prototype=units, target-data-prototype=dateFormat}, tlv-data-id=2}
        {data-prototype=UnitMaster_RPort_Temperature.units, element-in-impl-datatype={root-data-prototype=units, target-data-prototype=dateFormatConfiguration}, tlv-data-id=3}
        {data-prototype=UnitMaster_RPort_Temperature.units, element-in-impl-datatype={root-data-prototype=units, target-data-prototype=distanceUnit}, tlv-data-id=4}
        {data-prototype=UnitMaster_RPort_Temperature.units, element-in-impl-datatype={root-data-prototype=units, target-data-prototype=distanceUnitConfiguration}, tlv-data-id=5}
        {data-prototype=UnitMaster_RPort_Temperature.units, element-in-impl-datatype={root-data-prototype=units, target-data-prototype=pressureUnit}, tlv-data-id=6}
        {data-prototype=UnitMaster_RPort_Temperature.units, element-in-impl-datatype={root-data-prototype=units, target-data-prototype=pressureUnitConfiguration}, tlv-data-id=7}
        {data-prototype=UnitMaster_RPort_Temperature.units, element-in-impl-datatype={root-data-prototype=units, target-data-prototype=restrictionReason}, tlv-data-id=8}
        {data-prototype=UnitMaster_RPort_Temperature.units, element-in-impl-datatype={root-data-prototype=units, target-data-prototype=speedUnitTachometer}, tlv-data-id=9}
        {data-prototype=UnitMaster_RPort_Temperature.units, element-in-impl-datatype={root-data-prototype=units, target-data-prototype=speedUnit}, tlv-data-id=10}
        {data-prototype=UnitMaster_RPort_Temperature.units, element-in-impl-datatype={root-data-prototype=units, target-data-prototype=speedUnitConfiguration}, tlv-data-id=11}
        {data-prototype=UnitMaster_RPort_Temperature.units, element-in-impl-datatype={root-data-prototype=units, target-data-prototype=temperatureUnit}, tlv-data-id=12}
        {data-prototype=UnitMaster_RPort_Temperature.units, element-in-impl-datatype={root-data-prototype=units, target-data-prototype=temperatureUnitConfiguration}, tlv-data-id=13}
        {data-prototype=UnitMaster_RPort_Temperature.units, element-in-impl-datatype={root-data-prototype=units, target-data-prototype=timeFormat}, tlv-data-id=14}
        {data-prototype=UnitMaster_RPort_Temperature.units, element-in-impl-datatype={root-data-prototype=units, target-data-prototype=timeFormatConfiguration}, tlv-data-id=15}
        {data-prototype=UnitMaster_RPort_Temperature.units, element-in-impl-datatype={root-data-prototype=units, target-data-prototype=volumeUnit}, tlv-data-id=16}
        {data-prototype=UnitMaster_RPort_Temperature.units, element-in-impl-datatype={root-data-prototype=units, target-data-prototype=volumeUnitConfiguration}, tlv-data-id=17}
        {data-prototype=UnitMaster_RPort_Temperature.units, element-in-impl-datatype={root-data-prototype=units, target-data-prototype=consumptionUnit}, tlv-data-id=18}
        {data-prototype=UnitMaster_RPort_Temperature.units, element-in-impl-datatype={root-data-prototype=units, target-data-prototype=consumptionUnitConfiguration}, tlv-data-id=19}
        {data-prototype=UnitMaster_RPort_Temperature.units, element-in-impl-datatype={root-data-prototype=units, target-data-prototype=consumptionUnitElectr}, tlv-data-id=20}
        {data-prototype=UnitMaster_RPort_Temperature.units, element-in-impl-datatype={root-data-prototype=units, target-data-prototype=consumptionUnitElectrConfiguration}, tlv-data-id=21}
        {data-prototype=UnitMaster_RPort_Temperature.units, element-in-impl-datatype={root-data-prototype=units, target-data-prototype=consumptionUnitGas}, tlv-data-id=22}
        {data-prototype=UnitMaster_RPort_Temperature.units, element-in-impl-datatype={root-data-prototype=units, target-data-prototype=consumptionUnitGasConfiguration}, tlv-data-id=23}
        {data-prototype=UnitMaster_RPort_Temperature.units, element-in-impl-datatype={root-data-prototype=units, target-data-prototype=massUnit}, tlv-data-id=24}
        {data-prototype=UnitMaster_RPort_Temperature.units, element-in-impl-datatype={root-data-prototype=units, target-data-prototype=massUnitConfiguration}, tlv-data-id=25}
        {data-prototype=UnitMaster_RPort_TripComputer.units, element-in-impl-datatype={root-data-prototype=units, target-data-prototype=id}, tlv-data-id=0}
        {data-prototype=UnitMaster_RPort_TripComputer.units, element-in-impl-datatype={root-data-prototype=units, target-data-prototype=name}, tlv-data-id=1}
        {data-prototype=UnitMaster_RPort_TripComputer.units, element-in-impl-datatype={root-data-prototype=units, target-data-prototype=dateFormat}, tlv-data-id=2}
        {data-prototype=UnitMaster_RPort_TripComputer.units, element-in-impl-datatype={root-data-prototype=units, target-data-prototype=dateFormatConfiguration}, tlv-data-id=3}
        {data-prototype=UnitMaster_RPort_TripComputer.units, element-in-impl-datatype={root-data-prototype=units, target-data-prototype=distanceUnit}, tlv-data-id=4}
        {data-prototype=UnitMaster_RPort_TripComputer.units, element-in-impl-datatype={root-data-prototype=units, target-data-prototype=distanceUnitConfiguration}, tlv-data-id=5}
        {data-prototype=UnitMaster_RPort_TripComputer.units, element-in-impl-datatype={root-data-prototype=units, target-data-prototype=pressureUnit}, tlv-data-id=6}
        {data-prototype=UnitMaster_RPort_TripComputer.units, element-in-impl-datatype={root-data-prototype=units, target-data-prototype=pressureUnitConfiguration}, tlv-data-id=7}
        {data-prototype=UnitMaster_RPort_TripComputer.units, element-in-impl-datatype={root-data-prototype=units, target-data-prototype=restrictionReason}, tlv-data-id=8}
        {data-prototype=UnitMaster_RPort_TripComputer.units, element-in-impl-datatype={root-data-prototype=units, target-data-prototype=speedUnitTachometer}, tlv-data-id=9}
        {data-prototype=UnitMaster_RPort_TripComputer.units, element-in-impl-datatype={root-data-prototype=units, target-data-prototype=speedUnit}, tlv-data-id=10}
        {data-prototype=UnitMaster_RPort_TripComputer.units, element-in-impl-datatype={root-data-prototype=units, target-data-prototype=speedUnitConfiguration}, tlv-data-id=11}
        {data-prototype=UnitMaster_RPort_TripComputer.units, element-in-impl-datatype={root-data-prototype=units, target-data-prototype=temperatureUnit}, tlv-data-id=12}
        {data-prototype=UnitMaster_RPort_TripComputer.units, element-in-impl-datatype={root-data-prototype=units, target-data-prototype=temperatureUnitConfiguration}, tlv-data-id=13}
        {data-prototype=UnitMaster_RPort_TripComputer.units, element-in-impl-datatype={root-data-prototype=units, target-data-prototype=timeFormat}, tlv-data-id=14}
        {data-prototype=UnitMaster_RPort_TripComputer.units, element-in-impl-datatype={root-data-prototype=units, target-data-prototype=timeFormatConfiguration}, tlv-data-id=15}
        {data-prototype=UnitMaster_RPort_TripComputer.units, element-in-impl-datatype={root-data-prototype=units, target-data-prototype=volumeUnit}, tlv-data-id=16}
        {data-prototype=UnitMaster_RPort_TripComputer.units, element-in-impl-datatype={root-data-prototype=units, target-data-prototype=volumeUnitConfiguration}, tlv-data-id=17}
        {data-prototype=UnitMaster_RPort_TripComputer.units, element-in-impl-datatype={root-data-prototype=units, target-data-prototype=consumptionUnit}, tlv-data-id=18}
        {data-prototype=UnitMaster_RPort_TripComputer.units, element-in-impl-datatype={root-data-prototype=units, target-data-prototype=consumptionUnitConfiguration}, tlv-data-id=19}
        {data-prototype=UnitMaster_RPort_TripComputer.units, element-in-impl-datatype={root-data-prototype=units, target-data-prototype=consumptionUnitElectr}, tlv-data-id=20}
        {data-prototype=UnitMaster_RPort_TripComputer.units, element-in-impl-datatype={root-data-prototype=units, target-data-prototype=consumptionUnitElectrConfiguration}, tlv-data-id=21}
        {data-prototype=UnitMaster_RPort_TripComputer.units, element-in-impl-datatype={root-data-prototype=units, target-data-prototype=consumptionUnitGas}, tlv-data-id=22}
        {data-prototype=UnitMaster_RPort_TripComputer.units, element-in-impl-datatype={root-data-prototype=units, target-data-prototype=consumptionUnitGasConfiguration}, tlv-data-id=23}
        {data-prototype=UnitMaster_RPort_TripComputer.units, element-in-impl-datatype={root-data-prototype=units, target-data-prototype=massUnit}, tlv-data-id=24}
        {data-prototype=UnitMaster_RPort_TripComputer.units, element-in-impl-datatype={root-data-prototype=units, target-data-prototype=massUnitConfiguration}, tlv-data-id=25}
    VehicleBasicData_TLV
      data-prototypes:
        {data-prototype=VehicleBasicData_RPort_Distance.installations, element-in-impl-datatype={root-data-prototype=installations, target-data-prototype=elementId}, tlv-data-id=0}
        {data-prototype=VehicleBasicData_RPort_Distance.installations, element-in-impl-datatype={root-data-prototype=installations, target-data-prototype=rainSensor}, tlv-data-id=1}
        {data-prototype=VehicleBasicData_RPort_Distance.installations, element-in-impl-datatype={root-data-prototype=installations, target-data-prototype=exteriorSound}, tlv-data-id=2}
        {data-prototype=VehicleBasicData_RPort_Distance.installations, element-in-impl-datatype={root-data-prototype=installations, target-data-prototype=allWheelDrive}, tlv-data-id=3}
        {data-prototype=VehicleBasicData_RPort_Distance.installations, element-in-impl-datatype={root-data-prototype=installations, target-data-prototype=speedLimiterButton}, tlv-data-id=4}
        {data-prototype=VehicleBasicData_RPort_Distance.installations, element-in-impl-datatype={root-data-prototype=installations, target-data-prototype=rearSeatOccupiedSensor}, tlv-data-id=5}
        {data-prototype=VehicleBasicData_RPort_Distance.variants, element-in-impl-datatype={root-data-prototype=variants, target-data-prototype=elementId}, tlv-data-id=0}
        {data-prototype=VehicleBasicData_RPort_Distance.variants, element-in-impl-datatype={root-data-prototype=variants, target-data-prototype=adaptiveCruiseControlType}, tlv-data-id=1}
        {data-prototype=VehicleBasicData_RPort_Distance.variants, element-in-impl-datatype={root-data-prototype=variants, target-data-prototype=engineType}, tlv-data-id=2}
        {data-prototype=VehicleBasicData_RPort_Distance.variants, element-in-impl-datatype={root-data-prototype=variants, target-data-prototype=steeringWheelPosition}, tlv-data-id=3}
        {data-prototype=VehicleBasicData_RPort_Distance.variants, element-in-impl-datatype={root-data-prototype=variants, target-data-prototype=fuelType}, tlv-data-id=4}
        {data-prototype=VehicleBasicData_RPort_Distance.parameters, element-in-impl-datatype={root-data-prototype=parameters, target-data-prototype=elementId}, tlv-data-id=0}
        {data-prototype=VehicleBasicData_RPort_Distance.parameters, element-in-impl-datatype={root-data-prototype=parameters, target-data-prototype=tyreCircumference}, tlv-data-id=1}
        {data-prototype=VehicleBasicData_RPort_UnitMaster.installations, element-in-impl-datatype={root-data-prototype=installations, target-data-prototype=elementId}, tlv-data-id=0}
        {data-prototype=VehicleBasicData_RPort_UnitMaster.installations, element-in-impl-datatype={root-data-prototype=installations, target-data-prototype=rainSensor}, tlv-data-id=1}
        {data-prototype=VehicleBasicData_RPort_UnitMaster.installations, element-in-impl-datatype={root-data-prototype=installations, target-data-prototype=exteriorSound}, tlv-data-id=2}
        {data-prototype=VehicleBasicData_RPort_UnitMaster.installations, element-in-impl-datatype={root-data-prototype=installations, target-data-prototype=allWheelDrive}, tlv-data-id=3}
        {data-prototype=VehicleBasicData_RPort_UnitMaster.installations, element-in-impl-datatype={root-data-prototype=installations, target-data-prototype=speedLimiterButton}, tlv-data-id=4}
        {data-prototype=VehicleBasicData_RPort_UnitMaster.installations, element-in-impl-datatype={root-data-prototype=installations, target-data-prototype=rearSeatOccupiedSensor}, tlv-data-id=5}
        {data-prototype=VehicleBasicData_RPort_UnitMaster.variants, element-in-impl-datatype={root-data-prototype=variants, target-data-prototype=elementId}, tlv-data-id=0}
        {data-prototype=VehicleBasicData_RPort_UnitMaster.variants, element-in-impl-datatype={root-data-prototype=variants, target-data-prototype=adaptiveCruiseControlType}, tlv-data-id=1}
        {data-prototype=VehicleBasicData_RPort_UnitMaster.variants, element-in-impl-datatype={root-data-prototype=variants, target-data-prototype=engineType}, tlv-data-id=2}
        {data-prototype=VehicleBasicData_RPort_UnitMaster.variants, element-in-impl-datatype={root-data-prototype=variants, target-data-prototype=steeringWheelPosition}, tlv-data-id=3}
        {data-prototype=VehicleBasicData_RPort_UnitMaster.variants, element-in-impl-datatype={root-data-prototype=variants, target-data-prototype=fuelType}, tlv-data-id=4}
        {data-prototype=VehicleBasicData_RPort_UnitMaster.parameters, element-in-impl-datatype={root-data-prototype=parameters, target-data-prototype=elementId}, tlv-data-id=0}
        {data-prototype=VehicleBasicData_RPort_UnitMaster.parameters, element-in-impl-datatype={root-data-prototype=parameters, target-data-prototype=tyreCircumference}, tlv-data-id=1}
        {data-prototype=VehicleBasicData_RPort_Temperature.installations, element-in-impl-datatype={root-data-prototype=installations, target-data-prototype=elementId}, tlv-data-id=0}
        {data-prototype=VehicleBasicData_RPort_Temperature.installations, element-in-impl-datatype={root-data-prototype=installations, target-data-prototype=rainSensor}, tlv-data-id=1}
        {data-prototype=VehicleBasicData_RPort_Temperature.installations, element-in-impl-datatype={root-data-prototype=installations, target-data-prototype=exteriorSound}, tlv-data-id=2}
        {data-prototype=VehicleBasicData_RPort_Temperature.installations, element-in-impl-datatype={root-data-prototype=installations, target-data-prototype=allWheelDrive}, tlv-data-id=3}
        {data-prototype=VehicleBasicData_RPort_Temperature.installations, element-in-impl-datatype={root-data-prototype=installations, target-data-prototype=speedLimiterButton}, tlv-data-id=4}
        {data-prototype=VehicleBasicData_RPort_Temperature.installations, element-in-impl-datatype={root-data-prototype=installations, target-data-prototype=rearSeatOccupiedSensor}, tlv-data-id=5}
        {data-prototype=VehicleBasicData_RPort_Temperature.variants, element-in-impl-datatype={root-data-prototype=variants, target-data-prototype=elementId}, tlv-data-id=0}
        {data-prototype=VehicleBasicData_RPort_Temperature.variants, element-in-impl-datatype={root-data-prototype=variants, target-data-prototype=adaptiveCruiseControlType}, tlv-data-id=1}
        {data-prototype=VehicleBasicData_RPort_Temperature.variants, element-in-impl-datatype={root-data-prototype=variants, target-data-prototype=engineType}, tlv-data-id=2}
        {data-prototype=VehicleBasicData_RPort_Temperature.variants, element-in-impl-datatype={root-data-prototype=variants, target-data-prototype=steeringWheelPosition}, tlv-data-id=3}
        {data-prototype=VehicleBasicData_RPort_Temperature.variants, element-in-impl-datatype={root-data-prototype=variants, target-data-prototype=fuelType}, tlv-data-id=4}
        {data-prototype=VehicleBasicData_RPort_Temperature.parameters, element-in-impl-datatype={root-data-prototype=parameters, target-data-prototype=elementId}, tlv-data-id=0}
        {data-prototype=VehicleBasicData_RPort_Temperature.parameters, element-in-impl-datatype={root-data-prototype=parameters, target-data-prototype=tyreCircumference}, tlv-data-id=1}
        {data-prototype=VehicleBasicData_RPort_TripComputer.installations, element-in-impl-datatype={root-data-prototype=installations, target-data-prototype=elementId}, tlv-data-id=0}
        {data-prototype=VehicleBasicData_RPort_TripComputer.installations, element-in-impl-datatype={root-data-prototype=installations, target-data-prototype=rainSensor}, tlv-data-id=1}
        {data-prototype=VehicleBasicData_RPort_TripComputer.installations, element-in-impl-datatype={root-data-prototype=installations, target-data-prototype=exteriorSound}, tlv-data-id=2}
        {data-prototype=VehicleBasicData_RPort_TripComputer.installations, element-in-impl-datatype={root-data-prototype=installations, target-data-prototype=allWheelDrive}, tlv-data-id=3}
        {data-prototype=VehicleBasicData_RPort_TripComputer.installations, element-in-impl-datatype={root-data-prototype=installations, target-data-prototype=speedLimiterButton}, tlv-data-id=4}
        {data-prototype=VehicleBasicData_RPort_TripComputer.installations, element-in-impl-datatype={root-data-prototype=installations, target-data-prototype=rearSeatOccupiedSensor}, tlv-data-id=5}
        {data-prototype=VehicleBasicData_RPort_TripComputer.variants, element-in-impl-datatype={root-data-prototype=variants, target-data-prototype=elementId}, tlv-data-id=0}
        {data-prototype=VehicleBasicData_RPort_TripComputer.variants, element-in-impl-datatype={root-data-prototype=variants, target-data-prototype=adaptiveCruiseControlType}, tlv-data-id=1}
        {data-prototype=VehicleBasicData_RPort_TripComputer.variants, element-in-impl-datatype={root-data-prototype=variants, target-data-prototype=engineType}, tlv-data-id=2}
        {data-prototype=VehicleBasicData_RPort_TripComputer.variants, element-in-impl-datatype={root-data-prototype=variants, target-data-prototype=steeringWheelPosition}, tlv-data-id=3}
        {data-prototype=VehicleBasicData_RPort_TripComputer.variants, element-in-impl-datatype={root-data-prototype=variants, target-data-prototype=fuelType}, tlv-data-id=4}
        {data-prototype=VehicleBasicData_RPort_TripComputer.parameters, element-in-impl-datatype={root-data-prototype=parameters, target-data-prototype=elementId}, tlv-data-id=0}
        {data-prototype=VehicleBasicData_RPort_TripComputer.parameters, element-in-impl-datatype={root-data-prototype=parameters, target-data-prototype=tyreCircumference}, tlv-data-id=1}
  someip service interface deployment DrivePerformance_Someip: service-interface=DrivePerformance, service-interface-id=24659, service-interface-version={major-version=1, minor-version=0}
    someip field deployment displayParameters: field=displayParameters
      get getter: method-id=16400, transport-protocol=UDP
      notifier notifier: event-id=49168, transport-protocol=UDP
    someip event group displayParameters_EventGroup: event-group-id=49168, event=notifier
  someip data prototype transformation props DrivePerformance_TLV
    data-prototypes:
      {data-prototype=DrivePerformance_RPort_Telltale.displayParameters, element-in-impl-datatype={root-data-prototype=displayParameters, target-data-prototype=elementId}, tlv-data-id=0}
      {data-prototype=DrivePerformance_RPort_Telltale.displayParameters, element-in-impl-datatype={root-data-prototype=displayParameters, target-data-prototype=powerMeter}, tlv-data-id=1}
      {data-prototype=DrivePerformance_RPort_Telltale.displayParameters, element-in-impl-datatype={root-data-prototype=displayParameters, target-data-prototype=powerMeterValueType}, tlv-data-id=2}
      {data-prototype=DrivePerformance_RPort_Telltale.displayParameters, element-in-impl-datatype={root-data-prototype=displayParameters, target-data-prototype=powerMeterLimit}, tlv-data-id=3}
      {data-prototype=DrivePerformance_RPort_Telltale.displayParameters, element-in-impl-datatype={root-data-prototype=displayParameters, target-data-prototype=powerMeterLimitValueType}, tlv-data-id=4}
      {data-prototype=DrivePerformance_RPort_Telltale.displayParameters, element-in-impl-datatype={root-data-prototype=displayParameters, target-data-prototype=powerMeterStrategicLimit}, tlv-data-id=5}
      {data-prototype=DrivePerformance_RPort_Telltale.displayParameters, element-in-impl-datatype={root-data-prototype=displayParameters, target-data-prototype=powerMeterStrategicLimitValueType}, tlv-data-id=6}
      {data-prototype=DrivePerformance_RPort_Telltale.displayParameters, element-in-impl-datatype={root-data-prototype=displayParameters, target-data-prototype=powerMeterChargeLimit}, tlv-data-id=7}
      {data-prototype=DrivePerformance_RPort_Telltale.displayParameters, element-in-impl-datatype={root-data-prototype=displayParameters, target-data-prototype=powerMeterChargeLimitValueType}, tlv-data-id=8}
      {data-prototype=DrivePerformance_RPort_Telltale.displayParameters, element-in-impl-datatype={root-data-prototype=displayParameters, target-data-prototype=electricPerformancePhysicalValue}, tlv-data-id=9}
      {data-prototype=DrivePerformance_RPort_Telltale.displayParameters, element-in-impl-datatype={root-data-prototype=displayParameters, target-data-prototype=electricPerformanceLogicalValue}, tlv-data-id=10}
      {data-prototype=DrivePerformance_RPort_Telltale.displayParameters, element-in-impl-datatype={root-data-prototype=displayParameters, target-data-prototype=electricPerformanceValueType}, tlv-data-id=11}
      {data-prototype=DrivePerformance_RPort_Telltale.displayParameters, element-in-impl-datatype={root-data-prototype=displayParameters, target-data-prototype=turtleModeLampIsActivated}, tlv-data-id=12}
package /vwg/applications/ICAS3/instance
  22 x required someip service instance, all with required-service-instance-id=1:
    Chassis_Required_SomeipServiceInstance: service-interface=Chassis_Someip, required-service-version={major-version=1, minor-version=0}, sd-client-config={initial-find-behavior={initial-delay-max-value=0.01, initial-delay-min-value=0.01, initial-repetitions-base-delay=0.2, initial-repetitions-max=3}, service-find-time-to-live=5}
      5 x someip required event group:
        axes__EventGroup: event-group=axes_EventGroup
        velocityInfo__EventGroup: event-group=velocityInfo_EventGroup
        notifications__EventGroup: event-group=Chassis_Someip/notifications_EventGroup
        wheels__EventGroup: event-group=wheels_EventGroup
        espSystemInfo__EventGroup: event-group=espSystemInfo_EventGroup
    ClampControl_Required_SomeipServiceInstance: service-interface=ClampControl_Someip, required-service-version={major-version=3, minor-version=0}, sd-client-config={initial-find-behavior={initial-delay-max-value=0.01, initial-delay-min-value=0.01, initial-repetitions-base-delay=0.2, initial-repetitions-max=3}, service-find-time-to-live=5}
      someip required event group clamps__EventGroup: event-group=clamps_EventGroup
      someip required event group notifications__EventGroup: event-group=ClampControl_Someip/notifications_EventGroup
    ClimateControl_Required_SomeipServiceInstance: service-interface=ClimateControl_Someip, required-service-version={major-version=3, minor-version=0}, sd-client-config={initial-find-behavior={initial-delay-max-value=0.01, initial-delay-min-value=0.01, initial-repetitions-base-delay=0.2, initial-repetitions-max=3}, service-find-time-to-live=5}
      someip required event group notifications__EventGroup: event-group=ClimateControl_Someip/notifications_EventGroup
      someip required event group status__EventGroup: event-group=ClimateControl_Someip/status_EventGroup
      someip required event group consumptions__EventGroup: event-group=consumptions_EventGroup
    Distance_Required_SomeipServiceInstance: service-interface=Distance_Someip, required-service-version={major-version=3, minor-version=1}, sd-client-config={initial-find-behavior={initial-delay-max-value=0.01, initial-delay-min-value=0.01, initial-repetitions-base-delay=0.2, initial-repetitions-max=3}, service-find-time-to-live=5}
      someip required event group distances__EventGroup: event-group=Distance_Someip/distances_EventGroup
    DisplaySpeed_Required_SomeipServiceInstance: service-interface=DisplaySpeed_Someip, required-service-version={major-version=2, minor-version=1}, sd-client-config={initial-find-behavior={initial-delay-max-value=0.01, initial-delay-min-value=0.01, initial-repetitions-base-delay=0.2, initial-repetitions-max=3}, service-find-time-to-live=5}
      someip required event group velocities__EventGroup: event-group=DisplaySpeed_Someip/velocities_EventGroup
      someip required event group notifications__EventGroup: event-group=DisplaySpeed_Someip/notifications_EventGroup
    DrivingStatistics_Required_SomeipServiceInstance: service-interface=DrivingStatistics_Someip, required-service-version={major-version=2, minor-version=1}, sd-client-config={initial-find-behavior={initial-delay-max-value=0.01, initial-delay-min-value=0.01, initial-repetitions-base-delay=0.2, initial-repetitions-max=3}, service-find-time-to-live=5}
      someip required event group velocities__EventGroup: event-group=DrivingStatistics_Someip/velocities_EventGroup
      someip required event group distances__EventGroup: event-group=DrivingStatistics_Someip/distances_EventGroup
      someip required event group durations__EventGroup: event-group=durations_EventGroup
    DiagnosticDataDistribution_Required_SomeipServiceInstance: service-interface=DiagnosticDataDistribution_Someip, required-service-version={major-version=1, minor-version=0}, sd-client-config={initial-find-behavior={initial-delay-max-value=0.01, initial-delay-min-value=0.01, initial-repetitions-base-delay=0.2, initial-repetitions-max=3}, service-find-time-to-live=5}
      someip required event group dataValuesHash__EventGroup: event-group=dataValuesHash_EventGroup
    ElectricalConsumptions_Required_SomeipServiceInstance: service-interface=ElectricalConsumptions_Someip, required-service-version={major-version=2, minor-version=0}, sd-client-config={initial-find-behavior={initial-delay-max-value=0.01, initial-delay-min-value=0.01, initial-repetitions-base-delay=0.2, initial-repetitions-max=3}, service-find-time-to-live=5}
      someip required event group averageConsumptions__EventGroup: event-group=averageConsumptions_EventGroup
      someip required event group currentConsumptions__EventGroup: event-group=currentConsumptions_EventGroup
    Engine_Required_SomeipServiceInstance: service-interface=Engine_Someip, required-service-version={major-version=1, minor-version=0}, sd-client-config={initial-find-behavior={initial-delay-max-value=0.01, initial-delay-min-value=0.01, initial-repetitions-base-delay=0.2, initial-repetitions-max=3}, service-find-time-to-live=5}
      4 x someip required event group:
        powerMeterParameters_EventGroup: event-group=powerMeterParameters_EventGroup
        electricPerformanceCharacteristics_EventGroup: event-group=electricPerformanceCharacteristics_EventGroup
        engineInformation_EventGroup: event-group=engineInformation_EventGroup
        notifications_EventGroup: event-group=Engine_Someip/notifications_EventGroup
    ExteriorLight_Required_SomeipServiceInstance: service-interface=ExteriorLight_Someip, required-service-version={major-version=3, minor-version=0}, sd-client-config={initial-find-behavior={initial-delay-max-value=0.01, initial-delay-min-value=0.01, initial-repetitions-base-delay=0.2, initial-repetitions-max=3}, service-find-time-to-live=5}
      6 x someip required event group:
        lightFunctions__EventGroup: event-group=lightFunctions_EventGroup
        lightFunctionControls__EventGroup: event-group=lightFunctionControls_EventGroup
        lamps__EventGroup: event-group=lamps_EventGroup
        notifications__EventGroup: event-group=ExteriorLight_Someip/notifications_EventGroup
        info__EventGroup: event-group=ExteriorLight_Someip/info_EventGroup
        lightButtonModules__EventGroup: event-group=lightButtonModules_EventGroup
    ExteriorSound_Required_SomeipServiceInstance: service-interface=ExteriorSound_Someip, required-service-version={major-version=2, minor-version=0}, sd-client-config={initial-find-behavior={initial-delay-max-value=0.01, initial-delay-min-value=0.01, initial-repetitions-base-delay=0.2, initial-repetitions-max=3}, service-find-time-to-live=5}
      someip required event group notifications_EventGroup: event-group=ExteriorSound_Someip/notifications_EventGroup
    EnergySystem_Required_SomeipServiceInstance: service-interface=EnergySystem_Someip, required-service-version={major-version=4, minor-version=1}, sd-client-config={initial-find-behavior={initial-delay-max-value=0.01, initial-delay-min-value=0.01, initial-repetitions-base-delay=0.2, initial-repetitions-max=3}, service-find-time-to-live=5}
      4 x someip required event group:
        notifications__EventGroup: event-group=EnergySystem_Someip/notifications_EventGroup
        highVoltageBatteries__EventGroup: event-group=highVoltageBatteries_EventGroup
        lowVoltageBatteries__EventGroup: event-group=lowVoltageBatteries_EventGroup
        lowVoltageSystemInfo__EventGroup: event-group=lowVoltageSystemInfo_EventGroup
    EnvironmentalSensorData__Required_SomeipServiceInstance: service-interface=EnvironmentalSensorData_Someip, required-service-version={major-version=ANY, minor-version=ANY}, sd-client-config=initial-find-behavior={initial-delay-max-value=0.01, initial-delay-min-value=0.01, initial-repetitions-base-delay=0.2, initial-repetitions-max=3}
      someip required event group sensorData__EventGroup: event-group=sensorData_EventGroup
    HighVoltageCoordinator_Required_SomeipServiceInstance: service-interface=HighVoltageCoordinator_Someip, required-service-version={major-version=1, minor-version=0}, sd-client-config={initial-find-behavior={initial-delay-max-value=0.01, initial-delay-min-value=0.01, initial-repetitions-base-delay=0.2, initial-repetitions-max=3}, service-find-time-to-live=5}
      someip required event group notifications__EventGroup: event-group=HighVoltageCoordinator_Someip/notifications_EventGroup
    Immobilizer_Required_SomeipServiceInstance: service-interface=Immobilizer_Someip, required-service-version={major-version=3, minor-version=0}, sd-client-config={initial-find-behavior={initial-delay-max-value=0.01, initial-delay-min-value=0.01, initial-repetitions-base-delay=0.2, initial-repetitions-max=3}, service-find-time-to-live=5}
      someip required event group info__EventGroup: event-group=Immobilizer_Someip/info_EventGroup
      someip required event group notifications__EventGroup: event-group=Immobilizer_Someip/notifications_EventGroup
    Odometry_Required_SomeipServiceInstance: service-interface=Odometry_Someip, required-service-version={major-version=2, minor-version=ANY}, sd-client-config={initial-find-behavior={initial-delay-max-value=0.01, initial-delay-min-value=0.01, initial-repetitions-base-delay=0.2, initial-repetitions-max=3}, service-find-time-to-live=5}
      someip required event group motion__EventGroup: event-group=motion_EventGroup
      someip required event group velocities__EventGroup: event-group=Odometry_Someip/velocities_EventGroup
    Powertrain_Required_SomeipServiceInstance: service-interface=Powertrain_Someip, required-service-version={major-version=1, minor-version=0}, sd-client-config={initial-find-behavior={initial-delay-max-value=0.01, initial-delay-min-value=0.01, initial-repetitions-base-delay=0.2, initial-repetitions-max=3}, service-find-time-to-live=5}
      someip required event group notifications__EventGroup: event-group=Powertrain_Someip/notifications_EventGroup
      someip required event group settings__EventGroup: event-group=settings_EventGroup
      someip required event group status__EventGroup: event-group=Powertrain_Someip/status_EventGroup
    PowertrainConsumption_Required_SomeipServiceInstance: service-interface=PowertrainConsumption_Someip, required-service-version={major-version=1, minor-version=0}, sd-client-config={initial-find-behavior={initial-delay-max-value=0.01, initial-delay-min-value=0.01, initial-repetitions-base-delay=0.2, initial-repetitions-max=3}, service-find-time-to-live=5}
      someip required event group electricDriveMotors__EventGroup: event-group=electricDriveMotors_EventGroup
    SafetyBeltState_Required_SomeipServiceInstance: service-interface=SafetyBeltState_Someip, required-service-version={major-version=2, minor-version=1}, sd-client-config={initial-find-behavior={initial-delay-max-value=0.01, initial-delay-min-value=0.01, initial-repetitions-base-delay=0.2, initial-repetitions-max=3}, service-find-time-to-live=5}
      someip required event group notifications__EventGroup: event-group=SafetyBeltState_Someip/notifications_EventGroup
      someip required event group belts__EventGroup: event-group=belts_EventGroup
    Time_Required_SomeipServiceInstance: service-interface=Time_Someip, required-service-version={major-version=3, minor-version=1}, sd-client-config={initial-find-behavior={initial-delay-max-value=0.01, initial-delay-min-value=0.01, initial-repetitions-base-delay=0.2, initial-repetitions-max=3}, service-find-time-to-live=5}
      someip required event group timeSettings__EventGroup: event-group=timeSettings_EventGroup
      someip required event group times__EventGroup: event-group=times_EventGroup
    UnitMaster_Required_SomeipServiceInstance: service-interface=UnitMaster_Someip, required-service-version={major-version=2, minor-version=0}, sd-client-config={initial-find-behavior={initial-delay-max-value=0.01, initial-delay-min-value=0.01, initial-repetitions-base-delay=0.2, initial-repetitions-max=3}, service-find-time-to-live=5}
      someip required event group units__EventGroup: event-group=units_EventGroup
    VehicleBasicData_Required_SomeipServiceInstance: service-interface=VehicleBasicData_Someip, required-service-version={major-version=1, minor-version=0}, sd-client-config={initial-find-behavior={initial-delay-max-value=0.01, initial-delay-min-value=0.01, initial-repetitions-base-delay=0.2, initial-repetitions-max=3}, service-find-time-to-live=5}
      someip required event group installations__EventGroup: event-group=installations_EventGroup
      someip required event group variants__EventGroup: event-group=variants_EventGroup
      someip required event group parameters__EventGroup: event-group=parameters_EventGroup
  6 x provided someip service instance, all with sd-server-config={initial-offer-behavior={initial-delay-max-value=0, initial-delay-min-value=0, initial-repetitions-base-delay=0.1, initial-repetitions-max=3}, offer-cyclic-delay=1, request-response-delay={max-value=0, min-value=0}, service-offer-time-to-live=3}, service-instance-id=1:
    Distance_Provided_SomeipServiceInstance: service-interface=Distance_Someip
      someip provided event group distances__EventGroup: event-group=Distance_Someip/distances_EventGroup, multicast-threshold=0
    DisplaySpeed_Provided_SomeipServiceInstance: service-interface=DisplaySpeed_Someip
      someip provided event group velocities__EventGroup: event-group=DisplaySpeed_Someip/velocities_EventGroup, multicast-threshold=0
      someip provided event group notifications__EventGroup: event-group=DisplaySpeed_Someip/notifications_EventGroup, multicast-threshold=0
    DrivingStatistics_Provided_SomeipServiceInstance: service-interface=DrivingStatistics_Someip
      someip provided event group velocities__EventGroup: event-group=DrivingStatistics_Someip/velocities_EventGroup, multicast-threshold=0
      someip provided event group distances__EventGroup: event-group=DrivingStatistics_Someip/distances_EventGroup, multicast-threshold=0
      someip provided event group durations__EventGroup: event-group=durations_EventGroup, multicast-threshold=0
    ElectricalConsumptions_Provided_SomeipServiceInstance: service-interface=ElectricalConsumptions_Someip
      someip provided event group averageConsumptions__EventGroup: event-group=averageConsumptions_EventGroup, multicast-threshold=0
      someip provided event group currentConsumptions__EventGroup: event-group=currentConsumptions_EventGroup, multicast-threshold=0
    UnitMaster_Provided_SomeipServiceInstance: service-interface=UnitMaster_Someip
      someip provided event group units__EventGroup: event-group=units_EventGroup, multicast-threshold=0
    Temperature_ProvidedSomeipServiceInstance: service-interface=Temperature_Someip
      someip provided event group temperatures__EventGroup: event-group=temperatures_EventGroup, multicast-threshold=0
      someip provided event group notifications__EventGroup: event-group=Temperature_Someip/notifications_EventGroup, multicast-threshold=0
package /vwg/applications/ICAS3/mapping
  service instance to port prototype mapping Chassis_ServiceInstance_toPort_Distance: port-prototype=ICAS3_Distance.Chassis_RPort_Distance, process=distance_app, service-instance=Chassis_Required_SomeipServiceInstance
  someip service instance to machine mapping Chassis_Required_ServiceInstance_toMachine: communication-connector=myCommunicationConnector, service-instance=Chassis_Required_SomeipServiceInstance, udp-port=42814
  service instance to port prototype mapping ClampControl_ServiceInstance_toPort_Distance: port-prototype=ICAS3_Distance.ClampControl_RPort_Distance, process=distance_app, service-instance=ClampControl_Required_SomeipServiceInstance
  someip service instance to machine mapping ClampControl_Required_ServiceInstance_toMachine: communication-connector=myCommunicationConnector, service-instance=ClampControl_Required_SomeipServiceInstance, udp-port=42814
  service instance to port prototype mapping ClimateControl_ServiceInstance_toPort_ElectricalConsumptions: port-prototype=ICAS3_ElectricalConsumptions.ClimateControl_RPort_ElectricalConsumptions, process=electricalConsumptions_app, service-instance=ClimateControl_Required_SomeipServiceInstance
  someip service instance to machine mapping ClimateControl_Required_ServiceInstance_toMachine: communication-connector=myCommunicationConnector, service-instance=ClimateControl_Required_SomeipServiceInstance, udp-port=42814
  service instance to port prototype mapping Distance_ServiceInstance_toPort_ElectricalConsumptions: port-prototype=ICAS3_ElectricalConsumptions.Distance_RPort_ElectricalConsumptions, process=electricalConsumptions_app, service-instance=Distance_Required_SomeipServiceInstance
  someip service instance to machine mapping Distance_Required_ServiceInstance_toMachine: communication-connector=myCommunicationConnector, service-instance=Distance_Required_SomeipServiceInstance, udp-port=42814
  service instance to port prototype mapping DisplaySpeed_ServiceInstance_toPort_ElectricalConsumptions: port-prototype=ICAS3_ElectricalConsumptions.DisplaySpeed_RPort_ElectricalConsumptions, process=electricalConsumptions_app, service-instance=DisplaySpeed_Required_SomeipServiceInstance
  someip service instance to machine mapping DisplaySpeed_Required_ServiceInstance_toMachine: communication-connector=myCommunicationConnector, service-instance=DisplaySpeed_Required_SomeipServiceInstance, udp-port=42814
  service instance to port prototype mapping DrivingStatistics_ServiceInstance_toPort_TripComupter: port-prototype=ICAS3_TripComputer.DrivingStatistics_RPort_TripComputer, process=tripComputer_app, service-instance=DrivingStatistics_Required_SomeipServiceInstance
  someip service instance to machine mapping DrivingStatistics_Required_ServiceInstance_toMachine: communication-connector=myCommunicationConnector, service-instance=DrivingStatistics_Required_SomeipServiceInstance, udp-port=42814
  service instance to port prototype mapping DiagDataDistribution_ServiceInstance_toPort_Distance: port-prototype=ICAS3_Distance.DiagnosticDataDistribution_RPort_Distance, process=distance_app, service-instance=DiagnosticDataDistribution_Required_SomeipServiceInstance
  someip service instance to machine mapping DiagnosticDataDistribution_Required_ServiceInstance_toMachine: communication-connector=myCommunicationConnector, service-instance=DiagnosticDataDistribution_Required_SomeipServiceInstance, udp-port=42814
  service instance to port prototype mapping ElectricalConsumptions_ServiceInstance_toPort_TripComupter: port-prototype=ICAS3_TripComputer.ElectricalConsumptions_RPort_TripComputer, process=tripComputer_app, service-instance=ElectricalConsumptions_Required_SomeipServiceInstance
  someip service instance to machine mapping ElectricalConsumptions_Required_ServiceInstance_toMachine: communication-connector=myCommunicationConnector, service-instance=ElectricalConsumptions_Required_SomeipServiceInstance, udp-port=42814
  service instance to port prototype mapping Engine_ServiceInstance_toPort_Telltale: port-prototype=ICAS3_Telltale.Engine_RPort_Telltale, process=telltale_app, service-instance=Engine_Required_SomeipServiceInstance
  someip service instance to machine mapping Engine_Required_ServiceInstance_toMachine: communication-connector=myCommunicationConnector, service-instance=Engine_Required_SomeipServiceInstance, udp-port=42814
  service instance to port prototype mapping ExteriorLight_ServiceInstance_toPort_Telltale: port-prototype=ICAS3_Telltale.ExteriorLight_RPort_Telltale, process=telltale_app, service-instance=ExteriorLight_Required_SomeipServiceInstance
  someip service instance to machine mapping ExteriorLight_Required_ServiceInstance_toMachine: communication-connector=myCommunicationConnector, service-instance=ExteriorLight_Required_SomeipServiceInstance, udp-port=42814
  service instance to port prototype mapping EnteriorSound_ServiceInstance_toPort_Telltale: port-prototype=ICAS3_Telltale.ExteriorSound_RPort_Telltale, process=telltale_app, service-instance=ExteriorSound_Required_SomeipServiceInstance
  someip service instance to machine mapping ExteriorSound_Required_ServiceInstance_toMachine: communication-connector=myCommunicationConnector, service-instance=ExteriorSound_Required_SomeipServiceInstance, udp-port=42814
  service instance to port prototype mapping EnergySystem_ServiceInstance_toPort_ElectricalConsumptions: port-prototype=ICAS3_ElectricalConsumptions.EnergySystem_RPort_ElectricalConsumptions, process=electricalConsumptions_app, service-instance=EnergySystem_Required_SomeipServiceInstance
  someip service instance to machine mapping EnergySystem_Required_ServiceInstance_toMachine: communication-connector=myCommunicationConnector, service-instance=EnergySystem_Required_SomeipServiceInstance, udp-port=42814
  someip service instance to machine mapping EnviromentSensorData_Requrired_ServiceInterface_toMachine: communication-connector=myCommunicationConnector, service-instance=EnvironmentalSensorData__Required_SomeipServiceInstance, udp-port=42814
  service instance to port prototype mapping HighVoltageCoordinator_ServiceInstance_toPort_Telltale: port-prototype=ICAS3_Telltale.HighVoltageCoordinator_RPort_Telltale, process=telltale_app, service-instance=HighVoltageCoordinator_Required_SomeipServiceInstance
  someip service instance to machine mapping HighVoltageCoordinator_Required_ServiceInstance_toMachine: communication-connector=myCommunicationConnector, service-instance=HighVoltageCoordinator_Required_SomeipServiceInstance, udp-port=42814
  service instance to port prototype mapping Immobilizer_ServiceInstance_toPort_Telltale: port-prototype=ICAS3_Telltale.Immobilizer_RPort_Telltale, process=telltale_app, service-instance=Immobilizer_Required_SomeipServiceInstance
  someip service instance to machine mapping Immobilizer_Required_ServiceInstance_toMachine: communication-connector=myCommunicationConnector, service-instance=Immobilizer_Required_SomeipServiceInstance, udp-port=42814
  service instance to port prototype mapping Odometrie_ServiceInstance_toPort_DrivingStatistics: port-prototype=ICAS3_DrivingStatistics.Odometry_RPort_DrivingStatistics, process=drivingstatistics_app, service-instance=Odometry_Required_SomeipServiceInstance
  someip service instance to machine mapping Odometry_Required_ServiceInstance_toMachine: communication-connector=myCommunicationConnector, service-instance=Odometry_Required_SomeipServiceInstance, udp-port=42814
  service instance to port prototype mapping Powertrain_ServiceInstance_toPort_Temperature: port-prototype=ICAS3_Temperature.Powertrain_RPort_Temperature, process=temperature_app, service-instance=Powertrain_Required_SomeipServiceInstance
  someip service instance to machine mapping Powertrain_Required_ServiceInstance_toMachine: communication-connector=myCommunicationConnector, service-instance=Powertrain_Required_SomeipServiceInstance, udp-port=42814
  service instance to port prototype mapping PowertrainConsumption_ServiceInstance_toPort_ElectricalConsumptions: port-prototype=ICAS3_ElectricalConsumptions.PowertrainConsumption_RPort_ElectricalConsumptions, process=electricalConsumptions_app, service-instance=PowertrainConsumption_Required_SomeipServiceInstance
  someip service instance to machine mapping PowertrainConsumption_Required_ServiceInstance_toMachine_ElectricalConsumptions: communication-connector=myCommunicationConnector, service-instance=PowertrainConsumption_Required_SomeipServiceInstance, udp-port=42814
  service instance to port prototype mapping SafetyBeltState_ServiceInstance_toPort_Telltale: port-prototype=ICAS3_Telltale.SafetyBeltState_RPort_Telltale, process=telltale_app, service-instance=SafetyBeltState_Required_SomeipServiceInstance
  someip service instance to machine mapping SafetyBeltState_Required_ServiceInstance_toMachine: communication-connector=myCommunicationConnector, service-instance=SafetyBeltState_Required_SomeipServiceInstance, udp-port=42814
  service instance to port prototype mapping Time_ServiceInstance_toPort_DrivingStatistics: port-prototype=ICAS3_DrivingStatistics.Time_Rport_DrivingStatistics, process=drivingstatistics_app, service-instance=Time_Required_SomeipServiceInstance
  someip service instance to machine mapping Time_Required_ServiceInstance_toMachine: communication-connector=myCommunicationConnector, service-instance=Time_Required_SomeipServiceInstance, udp-port=42814
  service instance to port prototype mapping UnitMaster_ServiceInstance_toPort_Distance: port-prototype=ICAS3_Distance.UnitMaster_RPort_Distance, process=distance_app, service-instance=UnitMaster_Required_SomeipServiceInstance
  someip service instance to machine mapping UnitMaster_Required_ServiceInstance_toMachine: communication-connector=myCommunicationConnector, service-instance=UnitMaster_Required_SomeipServiceInstance, udp-port=42814
  service instance to port prototype mapping VechicleBasicData_ServiceInstance_toPort_Distance: port-prototype=ICAS3_Distance.VehicleBasicData_RPort_Distance, process=distance_app, service-instance=VehicleBasicData_Required_SomeipServiceInstance
  someip service instance to machine mapping VechicleBasicData_Requrired_ServiceInterface_toMachine: communication-connector=myCommunicationConnector, service-instance=VehicleBasicData_Required_SomeipServiceInstance, udp-port=42814
  service instance to port prototype mapping Distance_ServiceInstance_toPort_Distance: port-prototype=ICAS3_Distance.Distance_PPort_Distance, process=distance_app, service-instance=Distance_Provided_SomeipServiceInstance
  someip service instance to machine mapping Distance_Provided_ServiceInstance_toMachine: communication-connector=myCommunicationConnector, service-instance=Distance_Provided_SomeipServiceInstance, udp-port=42814
  service instance to port prototype mapping DisplaySpeed_ServiceInstance_toPort_Speed: port-prototype=ICAS3_Speed.DisplaySpeed_PPort_Speed, process=speed_app, service-instance=DisplaySpeed_Provided_SomeipServiceInstance
  someip service instance to machine mapping DisplaySpeed_Provided_ServiceInstance_toMachine: communication-connector=myCommunicationConnector, service-instance=DisplaySpeed_Provided_SomeipServiceInstance, udp-port=42814
  service instance to port prototype mapping DrivingStatistics_ServiceInstance_toPort_DrivingStatistics: port-prototype=ICAS3_DrivingStatistics.DrivingStatistics_PPort_DrivingStatistics, process=drivingstatistics_app, service-instance=DrivingStatistics_Provided_SomeipServiceInstance
  someip service instance to machine mapping DrivingStatistics_Provided_ServiceInstance_toMachine: communication-connector=myCommunicationConnector, service-instance=DrivingStatistics_Provided_SomeipServiceInstance, udp-port=42814
  service instance to port prototype mapping ElectricalConsumptions_ServiceInstance_toPort_ElectricalConsumptions: port-prototype=ICAS3_ElectricalConsumptions.ElectricalConsumptions_PPort_ElectricalConsumptions, process=electricalConsumptions_app, service-instance=ElectricalConsumptions_Provided_SomeipServiceInstance
  someip service instance to machine mapping ElectricalConsumptions_Provided_ServiceInstance_toMachine: communication-connector=myCommunicationConnector, service-instance=ElectricalConsumptions_Provided_SomeipServiceInstance, udp-port=42814
  service instance to port prototype mapping UnitMaster_ServiceInstance_toPort_UnitMaster: port-prototype=ICAS3_UnitMaster.UnitMaster_PPort_UnitMaster, process=unitmaster_app, service-instance=UnitMaster_Provided_SomeipServiceInstance
  someip service instance to machine mapping UnitMaster_Provided_ServiceInstance_toMachine: communication-connector=myCommunicationConnector, service-instance=UnitMaster_Provided_SomeipServiceInstance, udp-port=42814
  service instance to port prototype mapping Temperature_ServiceInstance_toPort_Temperature: port-prototype=ICAS3_Temperature.Temperature_PPort_Temperature, process=temperature_app, service-instance=Temperature_ProvidedSomeipServiceInstance
  someip service instance to machine mapping Temperature_Provided_ServiceInstance_toMachine: communication-connector=myCommunicationConnector, service-instance=Temperature_ProvidedSomeipServiceInstance, udp-port=42814
  31 x service instance to port prototype mapping:
    ClampControl_ServiceInstance_toPort_ElectricalConsumptions: port-prototype=ICAS3_ElectricalConsumptions.ClampControl_RPort_ElectricalConsumptions, process=electricalConsumptions_app, service-instance=ClampControl_Required_SomeipServiceInstance
    DiagDataDistribution_ServiceInstance_toPort_ElectricalConsumptions: port-prototype=ICAS3_ElectricalConsumptions.DiagnosticDataDistribution_RPort_ElectricalConsumptions, process=electricalConsumptions_app, service-instance=DiagnosticDataDistribution_Required_SomeipServiceInstance
    ClampControl_ServiceInstance_toPort_DrivingStatistics: port-prototype=ICAS3_DrivingStatistics.ClampControl_RPort_DrivingStatistics, process=drivingstatistics_app, service-instance=ClampControl_Required_SomeipServiceInstance
    DiagDataDistribution_ServiceInstance_toPort_DrivingStatistics: port-prototype=ICAS3_DrivingStatistics.DiagnosticDataDistribution_RPort_DrivingStatistics, process=drivingstatistics_app, service-instance=DiagnosticDataDistribution_Required_SomeipServiceInstance
    Distance_SerivceInstance_toPort_DrivingStatistics: port-prototype=ICAS3_DrivingStatistics.Distance_Rport_DrivingStatistics, process=drivingstatistics_app, service-instance=Distance_Required_SomeipServiceInstance
    ClampControl_ServiceInstance_toPort_Telltale: port-prototype=ICAS3_Telltale.ClampControl_RPort_Telltale, process=telltale_app, service-instance=ClampControl_Required_SomeipServiceInstance
    EnergySystem_ServiceInstance_toPort_SoC: port-prototype=ICAS3_SoC.EnergySystem_RPort_SoC, process=soc_app, service-instance=EnergySystem_Required_SomeipServiceInstance
    ClampControl_ServiceInstance_toPort_Speed: port-prototype=ICAS3_Speed.ClampControl_RPort_Speed, process=speed_app, service-instance=ClampControl_Required_SomeipServiceInstance
    UnitMaster_ServiceInstance_toPort_Speed: port-prototype=ICAS3_Speed.UnitMaster_RPort_Speed, process=speed_app, service-instance=UnitMaster_Required_SomeipServiceInstance
    Odometrie_ServiceInstance_toPort_Speed: port-prototype=ICAS3_Speed.Odometry_RPort_Speed, process=speed_app, service-instance=Odometry_Required_SomeipServiceInstance
    DiagDataDistribution_ServiceInstance_toPort_Speed: port-prototype=ICAS3_Speed.DiagnosticDataDistribution_RPort_Speed, process=speed_app, service-instance=DiagnosticDataDistribution_Required_SomeipServiceInstance
    ClampControl_ServiceInstance_toPort_UnitMaster: port-prototype=ICAS3_UnitMaster.ClampControl_RPort_UnitMaster, process=unitmaster_app, service-instance=ClampControl_Required_SomeipServiceInstance
    VehicleBasicData_ServiceInstance_toPort_UnitMaster: port-prototype=ICAS3_UnitMaster.VehicleBasicData_RPort_UnitMaster, process=unitmaster_app, service-instance=VehicleBasicData_Required_SomeipServiceInstance
    DiagDataDistribution_ServiceInstance_toPort_UnitMaster: port-prototype=ICAS3_UnitMaster.DiagnosticDataDistribution_RPort_UnitMaster, process=unitmaster_app, service-instance=DiagnosticDataDistribution_Required_SomeipServiceInstance
    ClampControl_ServiceInstance_toPort_Temperature: port-prototype=ICAS3_Temperature.ClampControl_RPort_Temperature, process=temperature_app, service-instance=ClampControl_Required_SomeipServiceInstance
    Distance_ServiceInstance_toPort_Temperature: port-prototype=ICAS3_Temperature.Distance_RPort_Temperature, process=temperature_app, service-instance=Distance_Required_SomeipServiceInstance
    UnitMaster_ServiceInstance_toPort_Temperature: port-prototype=ICAS3_Temperature.UnitMaster_RPort_Temperature, process=temperature_app, service-instance=UnitMaster_Required_SomeipServiceInstance
    VechicleBasicData_ServiceInstance_toPort_Temperature: port-prototype=ICAS3_Temperature.VehicleBasicData_RPort_Temperature, process=temperature_app, service-instance=VehicleBasicData_Required_SomeipServiceInstance
    DiagDataDistribution_ServiceInstance_toPort_Temperature: port-prototype=ICAS3_Temperature.DiagnosticDataDistribution_RPort_Temperature, process=temperature_app, service-instance=DiagnosticDataDistribution_Required_SomeipServiceInstance
    EnviromentSensorData_ServiceInstance_toPort_Temperature: port-prototype=ICAS3_Temperature.EnvironmentalSensorData_RPort_Temperature, process=temperature_app, service-instance=DiagnosticDataDistribution_Required_SomeipServiceInstance
    Odometrie_ServiceInstance_toPort_Temperature: port-prototype=ICAS3_Temperature.Odometry_RPort_Temperature, process=temperature_app, service-instance=Odometry_Required_SomeipServiceInstance
    Time_ServiceInstance_toPort_Temperature: port-prototype=ICAS3_Temperature.Time_RPort_Temperature, process=temperature_app, service-instance=Time_Required_SomeipServiceInstance
    ClampControl_ServiceInstance_toPort_TripComupter: port-prototype=ICAS3_TripComputer.ClampControl_RPort_TripComputer, process=tripComputer_app, service-instance=ClampControl_Required_SomeipServiceInstance
    DisplaySpeed_ServiceInstance_toPort_TripComupter: port-prototype=ICAS3_TripComputer.DisplaySpeed_RPort_TripComputer, process=tripComputer_app, service-instance=DisplaySpeed_Required_SomeipServiceInstance
    Distance_ServiceInstance_toPort_TripComupter: port-prototype=ICAS3_TripComputer.Distance_RPort_TripComputer, process=tripComputer_app, service-instance=Distance_Required_SomeipServiceInstance
    UnitMaster_ServiceInstance_toPort_TripComupter: port-prototype=ICAS3_TripComputer.UnitMaster_RPort_TripComputer, process=tripComputer_app, service-instance=UnitMaster_Required_SomeipServiceInstance
    VechicleBasicData_ServiceInstance_toPort_TripComupter: port-prototype=ICAS3_TripComputer.VehicleBasicData_RPort_TripComputer, process=tripComputer_app, service-instance=VehicleBasicData_Required_SomeipServiceInstance
    DiagDataDistribution_ServiceInstance_toPort_TripComupter: port-prototype=ICAS3_TripComputer.DiagnosticDataDistribution_RPort_TripComputer, process=tripComputer_app, service-instance=DiagnosticDataDistribution_Required_SomeipServiceInstance
    Odometrie_ServiceInstance_toPort_TripComupter: port-prototype=ICAS3_TripComputer.Odometry_RPort_TripComputer, process=tripComputer_app, service-instance=Odometry_Required_SomeipServiceInstance
    Time_ServiceInstance_toPort_TripComupter: port-prototype=ICAS3_TripComputer.Time_RPort_TripComputer, process=tripComputer_app, service-instance=Time_Required_SomeipServiceInstance
    EnergySystem_ServiceInstance_toPort_TripComupter: port-prototype=ICAS3_TripComputer.EnergySystem_RPort_TripComputer, process=tripComputer_app, service-instance=EnergySystem_Required_SomeipServiceInstance
